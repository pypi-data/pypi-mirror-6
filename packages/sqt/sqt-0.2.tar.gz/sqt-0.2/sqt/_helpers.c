/* Generated by Cython 0.19 on Fri Apr  4 09:38:17 2014 */

#define PY_SSIZE_T_CLEAN
#ifndef CYTHON_USE_PYLONG_INTERNALS
#ifdef PYLONG_BITS_IN_DIGIT
#define CYTHON_USE_PYLONG_INTERNALS 0
#else
#include "pyconfig.h"
#ifdef PYLONG_BITS_IN_DIGIT
#define CYTHON_USE_PYLONG_INTERNALS 1
#else
#define CYTHON_USE_PYLONG_INTERNALS 0
#endif
#endif
#endif
#include "Python.h"
#ifndef Py_PYTHON_H
    #error Python headers needed to compile C extensions, please install development version of Python.
#elif PY_VERSION_HEX < 0x02040000
    #error Cython requires Python 2.4+.
#else
#include <stddef.h> /* For offsetof */
#ifndef offsetof
#define offsetof(type, member) ( (size_t) & ((type*)0) -> member )
#endif
#if !defined(WIN32) && !defined(MS_WINDOWS)
  #ifndef __stdcall
    #define __stdcall
  #endif
  #ifndef __cdecl
    #define __cdecl
  #endif
  #ifndef __fastcall
    #define __fastcall
  #endif
#endif
#ifndef DL_IMPORT
  #define DL_IMPORT(t) t
#endif
#ifndef DL_EXPORT
  #define DL_EXPORT(t) t
#endif
#ifndef PY_LONG_LONG
  #define PY_LONG_LONG LONG_LONG
#endif
#ifndef Py_HUGE_VAL
  #define Py_HUGE_VAL HUGE_VAL
#endif
#ifdef PYPY_VERSION
#define CYTHON_COMPILING_IN_PYPY 1
#define CYTHON_COMPILING_IN_CPYTHON 0
#else
#define CYTHON_COMPILING_IN_PYPY 0
#define CYTHON_COMPILING_IN_CPYTHON 1
#endif
#if PY_VERSION_HEX < 0x02050000
  typedef int Py_ssize_t;
  #define PY_SSIZE_T_MAX INT_MAX
  #define PY_SSIZE_T_MIN INT_MIN
  #define PY_FORMAT_SIZE_T ""
  #define CYTHON_FORMAT_SSIZE_T ""
  #define PyInt_FromSsize_t(z) PyInt_FromLong(z)
  #define PyInt_AsSsize_t(o)   __Pyx_PyInt_AsInt(o)
  #define PyNumber_Index(o)    ((PyNumber_Check(o) && !PyFloat_Check(o)) ? PyNumber_Int(o) : \
                                (PyErr_Format(PyExc_TypeError, \
                                              "expected index value, got %.200s", Py_TYPE(o)->tp_name), \
                                 (PyObject*)0))
  #define __Pyx_PyIndex_Check(o) (PyNumber_Check(o) && !PyFloat_Check(o) && \
                                  !PyComplex_Check(o))
  #define PyIndex_Check __Pyx_PyIndex_Check
  #define PyErr_WarnEx(category, message, stacklevel) PyErr_Warn(category, message)
  #define __PYX_BUILD_PY_SSIZE_T "i"
#else
  #define __PYX_BUILD_PY_SSIZE_T "n"
  #define CYTHON_FORMAT_SSIZE_T "z"
  #define __Pyx_PyIndex_Check PyIndex_Check
#endif
#if PY_VERSION_HEX < 0x02060000
  #define Py_REFCNT(ob) (((PyObject*)(ob))->ob_refcnt)
  #define Py_TYPE(ob)   (((PyObject*)(ob))->ob_type)
  #define Py_SIZE(ob)   (((PyVarObject*)(ob))->ob_size)
  #define PyVarObject_HEAD_INIT(type, size) \
          PyObject_HEAD_INIT(type) size,
  #define PyType_Modified(t)
  typedef struct {
     void *buf;
     PyObject *obj;
     Py_ssize_t len;
     Py_ssize_t itemsize;
     int readonly;
     int ndim;
     char *format;
     Py_ssize_t *shape;
     Py_ssize_t *strides;
     Py_ssize_t *suboffsets;
     void *internal;
  } Py_buffer;
  #define PyBUF_SIMPLE 0
  #define PyBUF_WRITABLE 0x0001
  #define PyBUF_FORMAT 0x0004
  #define PyBUF_ND 0x0008
  #define PyBUF_STRIDES (0x0010 | PyBUF_ND)
  #define PyBUF_C_CONTIGUOUS (0x0020 | PyBUF_STRIDES)
  #define PyBUF_F_CONTIGUOUS (0x0040 | PyBUF_STRIDES)
  #define PyBUF_ANY_CONTIGUOUS (0x0080 | PyBUF_STRIDES)
  #define PyBUF_INDIRECT (0x0100 | PyBUF_STRIDES)
  #define PyBUF_RECORDS (PyBUF_STRIDES | PyBUF_FORMAT | PyBUF_WRITABLE)
  #define PyBUF_FULL (PyBUF_INDIRECT | PyBUF_FORMAT | PyBUF_WRITABLE)
  typedef int (*getbufferproc)(PyObject *, Py_buffer *, int);
  typedef void (*releasebufferproc)(PyObject *, Py_buffer *);
#endif
#if PY_MAJOR_VERSION < 3
  #define __Pyx_BUILTIN_MODULE_NAME "__builtin__"
  #define __Pyx_PyCode_New(a, k, l, s, f, code, c, n, v, fv, cell, fn, name, fline, lnos) \
          PyCode_New(a, l, s, f, code, c, n, v, fv, cell, fn, name, fline, lnos)
#else
  #define __Pyx_BUILTIN_MODULE_NAME "builtins"
  #define __Pyx_PyCode_New(a, k, l, s, f, code, c, n, v, fv, cell, fn, name, fline, lnos) \
          PyCode_New(a, k, l, s, f, code, c, n, v, fv, cell, fn, name, fline, lnos)
#endif
#if PY_MAJOR_VERSION < 3 && PY_MINOR_VERSION < 6
  #define PyUnicode_FromString(s) PyUnicode_Decode(s, strlen(s), "UTF-8", "strict")
#endif
#if PY_MAJOR_VERSION >= 3
  #define Py_TPFLAGS_CHECKTYPES 0
  #define Py_TPFLAGS_HAVE_INDEX 0
#endif
#if (PY_VERSION_HEX < 0x02060000) || (PY_MAJOR_VERSION >= 3)
  #define Py_TPFLAGS_HAVE_NEWBUFFER 0
#endif
#if PY_VERSION_HEX < 0x02060000
  #define Py_TPFLAGS_HAVE_VERSION_TAG 0
#endif
#if PY_VERSION_HEX > 0x03030000 && defined(PyUnicode_KIND)
  #define CYTHON_PEP393_ENABLED 1
  #define __Pyx_PyUnicode_READY(op)       (likely(PyUnicode_IS_READY(op)) ? \
                                              0 : _PyUnicode_Ready((PyObject *)(op)))
  #define __Pyx_PyUnicode_GET_LENGTH(u)   PyUnicode_GET_LENGTH(u)
  #define __Pyx_PyUnicode_READ_CHAR(u, i) PyUnicode_READ_CHAR(u, i)
  #define __Pyx_PyUnicode_READ(k, d, i)   PyUnicode_READ(k, d, i)
#else
  #define CYTHON_PEP393_ENABLED 0
  #define __Pyx_PyUnicode_READY(op)       (0)
  #define __Pyx_PyUnicode_GET_LENGTH(u)   PyUnicode_GET_SIZE(u)
  #define __Pyx_PyUnicode_READ_CHAR(u, i) ((Py_UCS4)(PyUnicode_AS_UNICODE(u)[i]))
  #define __Pyx_PyUnicode_READ(k, d, i)   ((k=k), (Py_UCS4)(((Py_UNICODE*)d)[i]))
#endif
#if PY_MAJOR_VERSION >= 3
  #define PyBaseString_Type            PyUnicode_Type
  #define PyStringObject               PyUnicodeObject
  #define PyString_Type                PyUnicode_Type
  #define PyString_Check               PyUnicode_Check
  #define PyString_CheckExact          PyUnicode_CheckExact
#endif
#if PY_VERSION_HEX < 0x02060000
  #define PyBytesObject                PyStringObject
  #define PyBytes_Type                 PyString_Type
  #define PyBytes_Check                PyString_Check
  #define PyBytes_CheckExact           PyString_CheckExact
  #define PyBytes_FromString           PyString_FromString
  #define PyBytes_FromStringAndSize    PyString_FromStringAndSize
  #define PyBytes_FromFormat           PyString_FromFormat
  #define PyBytes_DecodeEscape         PyString_DecodeEscape
  #define PyBytes_AsString             PyString_AsString
  #define PyBytes_AsStringAndSize      PyString_AsStringAndSize
  #define PyBytes_Size                 PyString_Size
  #define PyBytes_AS_STRING            PyString_AS_STRING
  #define PyBytes_GET_SIZE             PyString_GET_SIZE
  #define PyBytes_Repr                 PyString_Repr
  #define PyBytes_Concat               PyString_Concat
  #define PyBytes_ConcatAndDel         PyString_ConcatAndDel
#endif
#if PY_MAJOR_VERSION >= 3
  #define __Pyx_PyBaseString_Check(obj) PyUnicode_Check(obj)
  #define __Pyx_PyBaseString_CheckExact(obj) PyUnicode_CheckExact(obj)
#else
  #define __Pyx_PyBaseString_Check(obj) (PyString_CheckExact(obj) || PyUnicode_CheckExact(obj) || \
                                         PyString_Check(obj) || PyUnicode_Check(obj))
  #define __Pyx_PyBaseString_CheckExact(obj) (Py_TYPE(obj) == &PyBaseString_Type)
#endif
#if PY_VERSION_HEX < 0x02060000
  #define PySet_Check(obj)             PyObject_TypeCheck(obj, &PySet_Type)
  #define PyFrozenSet_Check(obj)       PyObject_TypeCheck(obj, &PyFrozenSet_Type)
#endif
#ifndef PySet_CheckExact
  #define PySet_CheckExact(obj)        (Py_TYPE(obj) == &PySet_Type)
#endif
#define __Pyx_TypeCheck(obj, type) PyObject_TypeCheck(obj, (PyTypeObject *)type)
#if PY_MAJOR_VERSION >= 3
  #define PyIntObject                  PyLongObject
  #define PyInt_Type                   PyLong_Type
  #define PyInt_Check(op)              PyLong_Check(op)
  #define PyInt_CheckExact(op)         PyLong_CheckExact(op)
  #define PyInt_FromString             PyLong_FromString
  #define PyInt_FromUnicode            PyLong_FromUnicode
  #define PyInt_FromLong               PyLong_FromLong
  #define PyInt_FromSize_t             PyLong_FromSize_t
  #define PyInt_FromSsize_t            PyLong_FromSsize_t
  #define PyInt_AsLong                 PyLong_AsLong
  #define PyInt_AS_LONG                PyLong_AS_LONG
  #define PyInt_AsSsize_t              PyLong_AsSsize_t
  #define PyInt_AsUnsignedLongMask     PyLong_AsUnsignedLongMask
  #define PyInt_AsUnsignedLongLongMask PyLong_AsUnsignedLongLongMask
#endif
#if PY_MAJOR_VERSION >= 3
  #define PyBoolObject                 PyLongObject
#endif
#if PY_VERSION_HEX < 0x03020000
  typedef long Py_hash_t;
  #define __Pyx_PyInt_FromHash_t PyInt_FromLong
  #define __Pyx_PyInt_AsHash_t   PyInt_AsLong
#else
  #define __Pyx_PyInt_FromHash_t PyInt_FromSsize_t
  #define __Pyx_PyInt_AsHash_t   PyInt_AsSsize_t
#endif
#if (PY_MAJOR_VERSION < 3) || (PY_VERSION_HEX >= 0x03010300)
  #define __Pyx_PySequence_GetSlice(obj, a, b) PySequence_GetSlice(obj, a, b)
  #define __Pyx_PySequence_SetSlice(obj, a, b, value) PySequence_SetSlice(obj, a, b, value)
  #define __Pyx_PySequence_DelSlice(obj, a, b) PySequence_DelSlice(obj, a, b)
#else
  #define __Pyx_PySequence_GetSlice(obj, a, b) (unlikely(!(obj)) ? \
        (PyErr_SetString(PyExc_SystemError, "null argument to internal routine"), (PyObject*)0) : \
        (likely((obj)->ob_type->tp_as_mapping) ? (PySequence_GetSlice(obj, a, b)) : \
            (PyErr_Format(PyExc_TypeError, "'%.200s' object is unsliceable", (obj)->ob_type->tp_name), (PyObject*)0)))
  #define __Pyx_PySequence_SetSlice(obj, a, b, value) (unlikely(!(obj)) ? \
        (PyErr_SetString(PyExc_SystemError, "null argument to internal routine"), -1) : \
        (likely((obj)->ob_type->tp_as_mapping) ? (PySequence_SetSlice(obj, a, b, value)) : \
            (PyErr_Format(PyExc_TypeError, "'%.200s' object doesn't support slice assignment", (obj)->ob_type->tp_name), -1)))
  #define __Pyx_PySequence_DelSlice(obj, a, b) (unlikely(!(obj)) ? \
        (PyErr_SetString(PyExc_SystemError, "null argument to internal routine"), -1) : \
        (likely((obj)->ob_type->tp_as_mapping) ? (PySequence_DelSlice(obj, a, b)) : \
            (PyErr_Format(PyExc_TypeError, "'%.200s' object doesn't support slice deletion", (obj)->ob_type->tp_name), -1)))
#endif
#if PY_MAJOR_VERSION >= 3
  #define PyMethod_New(func, self, klass) ((self) ? PyMethod_New(func, self) : PyInstanceMethod_New(func))
#endif
#if PY_VERSION_HEX < 0x02050000
  #define __Pyx_GetAttrString(o,n)   PyObject_GetAttrString((o),((char *)(n)))
  #define __Pyx_SetAttrString(o,n,a) PyObject_SetAttrString((o),((char *)(n)),(a))
  #define __Pyx_DelAttrString(o,n)   PyObject_DelAttrString((o),((char *)(n)))
#else
  #define __Pyx_GetAttrString(o,n)   PyObject_GetAttrString((o),(n))
  #define __Pyx_SetAttrString(o,n,a) PyObject_SetAttrString((o),(n),(a))
  #define __Pyx_DelAttrString(o,n)   PyObject_DelAttrString((o),(n))
#endif
#if PY_VERSION_HEX < 0x02050000
  #define __Pyx_NAMESTR(n) ((char *)(n))
  #define __Pyx_DOCSTR(n)  ((char *)(n))
#else
  #define __Pyx_NAMESTR(n) (n)
  #define __Pyx_DOCSTR(n)  (n)
#endif
#ifndef CYTHON_INLINE
  #if defined(__GNUC__)
    #define CYTHON_INLINE __inline__
  #elif defined(_MSC_VER)
    #define CYTHON_INLINE __inline
  #elif defined (__STDC_VERSION__) && __STDC_VERSION__ >= 199901L
    #define CYTHON_INLINE inline
  #else
    #define CYTHON_INLINE
  #endif
#endif
#ifndef CYTHON_RESTRICT
  #if defined(__GNUC__)
    #define CYTHON_RESTRICT __restrict__
  #elif defined(_MSC_VER)
    #define CYTHON_RESTRICT __restrict
  #elif defined (__STDC_VERSION__) && __STDC_VERSION__ >= 199901L
    #define CYTHON_RESTRICT restrict
  #else
    #define CYTHON_RESTRICT
  #endif
#endif
#ifdef NAN
#define __PYX_NAN() ((float) NAN)
#else
static CYTHON_INLINE float __PYX_NAN() {
  /* Initialize NaN. The sign is irrelevant, an exponent with all bits 1 and
   a nonzero mantissa means NaN. If the first bit in the mantissa is 1, it is
   a quiet NaN. */
  float value;
  memset(&value, 0xFF, sizeof(value));
  return value;
}
#endif


#if PY_MAJOR_VERSION >= 3
  #define __Pyx_PyNumber_Divide(x,y)         PyNumber_TrueDivide(x,y)
  #define __Pyx_PyNumber_InPlaceDivide(x,y)  PyNumber_InPlaceTrueDivide(x,y)
#else
  #define __Pyx_PyNumber_Divide(x,y)         PyNumber_Divide(x,y)
  #define __Pyx_PyNumber_InPlaceDivide(x,y)  PyNumber_InPlaceDivide(x,y)
#endif

#ifndef __PYX_EXTERN_C
  #ifdef __cplusplus
    #define __PYX_EXTERN_C extern "C"
  #else
    #define __PYX_EXTERN_C extern
  #endif
#endif

#if defined(WIN32) || defined(MS_WINDOWS)
#define _USE_MATH_DEFINES
#endif
#include <math.h>
#define __PYX_HAVE__sqt___helpers
#define __PYX_HAVE_API__sqt___helpers
#ifdef _OPENMP
#include <omp.h>
#endif /* _OPENMP */

#ifdef PYREX_WITHOUT_ASSERTIONS
#define CYTHON_WITHOUT_ASSERTIONS
#endif

#ifndef CYTHON_UNUSED
# if defined(__GNUC__)
#   if !(defined(__cplusplus)) || (__GNUC__ > 3 || (__GNUC__ == 3 && __GNUC_MINOR__ >= 4))
#     define CYTHON_UNUSED __attribute__ ((__unused__))
#   else
#     define CYTHON_UNUSED
#   endif
# elif defined(__ICC) || (defined(__INTEL_COMPILER) && !defined(_MSC_VER))
#   define CYTHON_UNUSED __attribute__ ((__unused__))
# else
#   define CYTHON_UNUSED
# endif
#endif
typedef struct {PyObject **p; char *s; const Py_ssize_t n; const char* encoding;
                const char is_unicode; const char is_str; const char intern; } __Pyx_StringTabEntry; /*proto*/

#define __PYX_DEFAULT_STRING_ENCODING_IS_ASCII 0
#define __PYX_DEFAULT_STRING_ENCODING_IS_DEFAULT 0
#define __PYX_DEFAULT_STRING_ENCODING ""
#define __Pyx_PyObject_FromString __Pyx_PyBytes_FromString
#define __Pyx_PyObject_FromStringAndSize __Pyx_PyBytes_FromStringAndSize
static CYTHON_INLINE char* __Pyx_PyObject_AsString(PyObject*);
static CYTHON_INLINE char* __Pyx_PyObject_AsStringAndSize(PyObject*, Py_ssize_t* length);
#define __Pyx_PyBytes_FromString        PyBytes_FromString
#define __Pyx_PyBytes_FromStringAndSize PyBytes_FromStringAndSize
static CYTHON_INLINE PyObject* __Pyx_PyUnicode_FromString(char*);
#if PY_MAJOR_VERSION < 3
    #define __Pyx_PyStr_FromString        __Pyx_PyBytes_FromString
    #define __Pyx_PyStr_FromStringAndSize __Pyx_PyBytes_FromStringAndSize
#else
    #define __Pyx_PyStr_FromString        __Pyx_PyUnicode_FromString
    #define __Pyx_PyStr_FromStringAndSize __Pyx_PyUnicode_FromStringAndSize
#endif
#define __Pyx_PyObject_AsUString(s)    ((unsigned char*) __Pyx_PyObject_AsString(s))
#define __Pyx_PyObject_FromUString(s)  __Pyx_PyObject_FromString((char*)s)
#define __Pyx_PyBytes_FromUString(s)   __Pyx_PyBytes_FromString((char*)s)
#define __Pyx_PyStr_FromUString(s)     __Pyx_PyStr_FromString((char*)s)
#define __Pyx_PyUnicode_FromUString(s) __Pyx_PyUnicode_FromString((char*)s)
#if PY_MAJOR_VERSION < 3
static CYTHON_INLINE size_t __Pyx_Py_UNICODE_strlen(const Py_UNICODE *u)
{
    const Py_UNICODE *u_end = u;
    while (*u_end++) ;
    return u_end - u - 1;
}
#else
#define __Pyx_Py_UNICODE_strlen Py_UNICODE_strlen
#endif
#define __Pyx_PyUnicode_FromUnicode(u)       PyUnicode_FromUnicode(u, __Pyx_Py_UNICODE_strlen(u))
#define __Pyx_PyUnicode_FromUnicodeAndLength PyUnicode_FromUnicode
#define __Pyx_PyUnicode_AsUnicode            PyUnicode_AsUnicode
#define __Pyx_Owned_Py_None(b) (Py_INCREF(Py_None), Py_None)
#define __Pyx_PyBool_FromLong(b) ((b) ? (Py_INCREF(Py_True), Py_True) : (Py_INCREF(Py_False), Py_False))
static CYTHON_INLINE int __Pyx_PyObject_IsTrue(PyObject*);
static CYTHON_INLINE PyObject* __Pyx_PyNumber_Int(PyObject* x);
static CYTHON_INLINE Py_ssize_t __Pyx_PyIndex_AsSsize_t(PyObject*);
static CYTHON_INLINE PyObject * __Pyx_PyInt_FromSize_t(size_t);
static CYTHON_INLINE size_t __Pyx_PyInt_AsSize_t(PyObject*);
#if CYTHON_COMPILING_IN_CPYTHON
#define __pyx_PyFloat_AsDouble(x) (PyFloat_CheckExact(x) ? PyFloat_AS_DOUBLE(x) : PyFloat_AsDouble(x))
#else
#define __pyx_PyFloat_AsDouble(x) PyFloat_AsDouble(x)
#endif
#define __pyx_PyFloat_AsFloat(x) ((float) __pyx_PyFloat_AsDouble(x))
#if PY_MAJOR_VERSION < 3 && __PYX_DEFAULT_STRING_ENCODING_IS_ASCII
static int __Pyx_sys_getdefaultencoding_not_ascii;
static int __Pyx_init_sys_getdefaultencoding_params() {
    PyObject* sys = NULL;
    PyObject* default_encoding = NULL;
    PyObject* ascii_chars_u = NULL;
    PyObject* ascii_chars_b = NULL;
    sys = PyImport_ImportModule("sys");
    if (sys == NULL) goto bad;
    default_encoding = PyObject_CallMethod(sys, (char*) (const char*) "getdefaultencoding", NULL);
    if (default_encoding == NULL) goto bad;
    if (strcmp(PyBytes_AsString(default_encoding), "ascii") == 0) {
        __Pyx_sys_getdefaultencoding_not_ascii = 0;
    } else {
        const char* default_encoding_c = PyBytes_AS_STRING(default_encoding);
        char ascii_chars[128];
        int c;
        for (c = 0; c < 128; c++) {
            ascii_chars[c] = c;
        }
        __Pyx_sys_getdefaultencoding_not_ascii = 1;
        ascii_chars_u = PyUnicode_DecodeASCII(ascii_chars, 128, NULL);
        if (ascii_chars_u == NULL) goto bad;
        ascii_chars_b = PyUnicode_AsEncodedString(ascii_chars_u, default_encoding_c, NULL);
        if (ascii_chars_b == NULL || strncmp(ascii_chars, PyBytes_AS_STRING(ascii_chars_b), 128) != 0) {
            PyErr_Format(
                PyExc_ValueError,
                "This module compiled with c_string_encoding=ascii, but default encoding '%s' is not a superset of ascii.",
                default_encoding_c);
            goto bad;
        }
    }
    Py_XDECREF(sys);
    Py_XDECREF(default_encoding);
    Py_XDECREF(ascii_chars_u);
    Py_XDECREF(ascii_chars_b);
    return 0;
bad:
    Py_XDECREF(sys);
    Py_XDECREF(default_encoding);
    Py_XDECREF(ascii_chars_u);
    Py_XDECREF(ascii_chars_b);
    return -1;
}
#endif
#if __PYX_DEFAULT_STRING_ENCODING_IS_DEFAULT && PY_MAJOR_VERSION >= 3
#define __Pyx_PyUnicode_FromStringAndSize(c_str, size) PyUnicode_DecodeUTF8(c_str, size, NULL)
#else
#define __Pyx_PyUnicode_FromStringAndSize(c_str, size) PyUnicode_Decode(c_str, size, __PYX_DEFAULT_STRING_ENCODING, NULL)
#if __PYX_DEFAULT_STRING_ENCODING_IS_DEFAULT
static char* __PYX_DEFAULT_STRING_ENCODING;
static int __Pyx_init_sys_getdefaultencoding_params() {
    PyObject* sys = NULL;
    PyObject* default_encoding = NULL;
    char* default_encoding_c;
    sys = PyImport_ImportModule("sys");
    if (sys == NULL) goto bad;
    default_encoding = PyObject_CallMethod(sys, (char*) (const char*) "getdefaultencoding", NULL);
    if (default_encoding == NULL) goto bad;
    default_encoding_c = PyBytes_AS_STRING(default_encoding);
    __PYX_DEFAULT_STRING_ENCODING = (char*) malloc(strlen(default_encoding_c));
    strcpy(__PYX_DEFAULT_STRING_ENCODING, default_encoding_c);
    Py_DECREF(sys);
    Py_DECREF(default_encoding);
    return 0;
bad:
    Py_XDECREF(sys);
    Py_XDECREF(default_encoding);
    return -1;
}
#endif
#endif


#ifdef __GNUC__
  /* Test for GCC > 2.95 */
  #if __GNUC__ > 2 || (__GNUC__ == 2 && (__GNUC_MINOR__ > 95))
    #define likely(x)   __builtin_expect(!!(x), 1)
    #define unlikely(x) __builtin_expect(!!(x), 0)
  #else /* __GNUC__ > 2 ... */
    #define likely(x)   (x)
    #define unlikely(x) (x)
  #endif /* __GNUC__ > 2 ... */
#else /* __GNUC__ */
  #define likely(x)   (x)
  #define unlikely(x) (x)
#endif /* __GNUC__ */

static PyObject *__pyx_m;
static PyObject *__pyx_d;
static PyObject *__pyx_b;
static PyObject *__pyx_empty_tuple;
static PyObject *__pyx_empty_bytes;
static int __pyx_lineno;
static int __pyx_clineno = 0;
static const char * __pyx_cfilenm= __FILE__;
static const char *__pyx_filename;


static const char *__pyx_f[] = {
  "_helpers.pyx",
};

/*--- Type declarations ---*/
struct __pyx_t_3sqt_8_helpers_ScoreEntry;
typedef struct __pyx_t_3sqt_8_helpers_ScoreEntry __pyx_t_3sqt_8_helpers_ScoreEntry;

/* "sqt/_helpers.pyx":20
 * 
 * # structure for a DP matrix entry
 * ctypedef struct ScoreEntry:             # <<<<<<<<<<<<<<
 * 	int score
 * 	int backtrace
 */
struct __pyx_t_3sqt_8_helpers_ScoreEntry {
  int score;
  int backtrace;
};
#ifndef CYTHON_REFNANNY
  #define CYTHON_REFNANNY 0
#endif
#if CYTHON_REFNANNY
  typedef struct {
    void (*INCREF)(void*, PyObject*, int);
    void (*DECREF)(void*, PyObject*, int);
    void (*GOTREF)(void*, PyObject*, int);
    void (*GIVEREF)(void*, PyObject*, int);
    void* (*SetupContext)(const char*, int, const char*);
    void (*FinishContext)(void**);
  } __Pyx_RefNannyAPIStruct;
  static __Pyx_RefNannyAPIStruct *__Pyx_RefNanny = NULL;
  static __Pyx_RefNannyAPIStruct *__Pyx_RefNannyImportAPI(const char *modname); /*proto*/
  #define __Pyx_RefNannyDeclarations void *__pyx_refnanny = NULL;
#ifdef WITH_THREAD
  #define __Pyx_RefNannySetupContext(name, acquire_gil) \
          if (acquire_gil) { \
              PyGILState_STATE __pyx_gilstate_save = PyGILState_Ensure(); \
              __pyx_refnanny = __Pyx_RefNanny->SetupContext((name), __LINE__, __FILE__); \
              PyGILState_Release(__pyx_gilstate_save); \
          } else { \
              __pyx_refnanny = __Pyx_RefNanny->SetupContext((name), __LINE__, __FILE__); \
          }
#else
  #define __Pyx_RefNannySetupContext(name, acquire_gil) \
          __pyx_refnanny = __Pyx_RefNanny->SetupContext((name), __LINE__, __FILE__)
#endif
  #define __Pyx_RefNannyFinishContext() \
          __Pyx_RefNanny->FinishContext(&__pyx_refnanny)
  #define __Pyx_INCREF(r)  __Pyx_RefNanny->INCREF(__pyx_refnanny, (PyObject *)(r), __LINE__)
  #define __Pyx_DECREF(r)  __Pyx_RefNanny->DECREF(__pyx_refnanny, (PyObject *)(r), __LINE__)
  #define __Pyx_GOTREF(r)  __Pyx_RefNanny->GOTREF(__pyx_refnanny, (PyObject *)(r), __LINE__)
  #define __Pyx_GIVEREF(r) __Pyx_RefNanny->GIVEREF(__pyx_refnanny, (PyObject *)(r), __LINE__)
  #define __Pyx_XINCREF(r)  do { if((r) != NULL) {__Pyx_INCREF(r); }} while(0)
  #define __Pyx_XDECREF(r)  do { if((r) != NULL) {__Pyx_DECREF(r); }} while(0)
  #define __Pyx_XGOTREF(r)  do { if((r) != NULL) {__Pyx_GOTREF(r); }} while(0)
  #define __Pyx_XGIVEREF(r) do { if((r) != NULL) {__Pyx_GIVEREF(r);}} while(0)
#else
  #define __Pyx_RefNannyDeclarations
  #define __Pyx_RefNannySetupContext(name, acquire_gil)
  #define __Pyx_RefNannyFinishContext()
  #define __Pyx_INCREF(r) Py_INCREF(r)
  #define __Pyx_DECREF(r) Py_DECREF(r)
  #define __Pyx_GOTREF(r)
  #define __Pyx_GIVEREF(r)
  #define __Pyx_XINCREF(r) Py_XINCREF(r)
  #define __Pyx_XDECREF(r) Py_XDECREF(r)
  #define __Pyx_XGOTREF(r)
  #define __Pyx_XGIVEREF(r)
#endif /* CYTHON_REFNANNY */
#define __Pyx_CLEAR(r)    do { PyObject* tmp = ((PyObject*)(r)); r = NULL; __Pyx_DECREF(tmp);} while(0)
#define __Pyx_XCLEAR(r)   do { if((r) != NULL) {PyObject* tmp = ((PyObject*)(r)); r = NULL; __Pyx_DECREF(tmp);}} while(0)

#if CYTHON_COMPILING_IN_CPYTHON
static CYTHON_INLINE PyObject* __Pyx_PyObject_GetAttrStr(PyObject* obj, PyObject* attr_name) {
    PyTypeObject* tp = Py_TYPE(obj);
    if (likely(tp->tp_getattro))
        return tp->tp_getattro(obj, attr_name);
#if PY_MAJOR_VERSION < 3
    if (likely(tp->tp_getattr))
        return tp->tp_getattr(obj, PyString_AS_STRING(attr_name));
#endif
    return PyObject_GetAttr(obj, attr_name);
}
#else
#define __Pyx_PyObject_GetAttrStr(o,n) PyObject_GetAttr(o,n)
#endif

static PyObject *__Pyx_GetBuiltinName(PyObject *name); /*proto*/

static void __Pyx_RaiseArgtupleInvalid(const char* func_name, int exact,
    Py_ssize_t num_min, Py_ssize_t num_max, Py_ssize_t num_found); /*proto*/

static void __Pyx_RaiseDoubleKeywordsError(const char* func_name, PyObject* kw_name); /*proto*/

static int __Pyx_ParseOptionalKeywords(PyObject *kwds, PyObject **argnames[], \
    PyObject *kwds2, PyObject *values[], Py_ssize_t num_pos_args, \
    const char* function_name); /*proto*/

#include <string.h>

static int __Pyx_ArgTypeTest(PyObject *obj, PyTypeObject *type, int none_allowed,
    const char *name, int exact); /*proto*/

static CYTHON_INLINE PyObject *__Pyx_GetModuleGlobalName(PyObject *name); /*proto*/

#define __Pyx_SetItemInt(o, i, v, size, to_py_func, is_list, wraparound, boundscheck) \
    (((size) <= sizeof(Py_ssize_t)) ? \
    __Pyx_SetItemInt_Fast(o, i, v, is_list, wraparound, boundscheck) : \
    __Pyx_SetItemInt_Generic(o, to_py_func(i), v))
static CYTHON_INLINE int __Pyx_SetItemInt_Generic(PyObject *o, PyObject *j, PyObject *v);
static CYTHON_INLINE int __Pyx_SetItemInt_Fast(PyObject *o, Py_ssize_t i, PyObject *v,
                                               int is_list, int wraparound, int boundscheck);

static PyObject* __Pyx_ImportFrom(PyObject* module, PyObject* name); /*proto*/

static PyObject *__Pyx_Import(PyObject *name, PyObject *from_list, int level); /*proto*/

static CYTHON_INLINE unsigned char __Pyx_PyInt_AsUnsignedChar(PyObject *);

static CYTHON_INLINE unsigned short __Pyx_PyInt_AsUnsignedShort(PyObject *);

static CYTHON_INLINE unsigned int __Pyx_PyInt_AsUnsignedInt(PyObject *);

static CYTHON_INLINE char __Pyx_PyInt_AsChar(PyObject *);

static CYTHON_INLINE short __Pyx_PyInt_AsShort(PyObject *);

static CYTHON_INLINE int __Pyx_PyInt_AsInt(PyObject *);

static CYTHON_INLINE signed char __Pyx_PyInt_AsSignedChar(PyObject *);

static CYTHON_INLINE signed short __Pyx_PyInt_AsSignedShort(PyObject *);

static CYTHON_INLINE signed int __Pyx_PyInt_AsSignedInt(PyObject *);

static CYTHON_INLINE int __Pyx_PyInt_AsLongDouble(PyObject *);

static CYTHON_INLINE unsigned long __Pyx_PyInt_AsUnsignedLong(PyObject *);

static CYTHON_INLINE unsigned PY_LONG_LONG __Pyx_PyInt_AsUnsignedLongLong(PyObject *);

static CYTHON_INLINE long __Pyx_PyInt_AsLong(PyObject *);

static CYTHON_INLINE PY_LONG_LONG __Pyx_PyInt_AsLongLong(PyObject *);

static CYTHON_INLINE signed long __Pyx_PyInt_AsSignedLong(PyObject *);

static CYTHON_INLINE signed PY_LONG_LONG __Pyx_PyInt_AsSignedLongLong(PyObject *);

static int __Pyx_check_binary_version(void);

typedef struct {
    int code_line;
    PyCodeObject* code_object;
} __Pyx_CodeObjectCacheEntry;
struct __Pyx_CodeObjectCache {
    int count;
    int max_count;
    __Pyx_CodeObjectCacheEntry* entries;
};
static struct __Pyx_CodeObjectCache __pyx_code_cache = {0,0,NULL};
static int __pyx_bisect_code_objects(__Pyx_CodeObjectCacheEntry* entries, int count, int code_line);
static PyCodeObject *__pyx_find_code_object(int code_line);
static void __pyx_insert_code_object(int code_line, PyCodeObject* code_object);

static void __Pyx_AddTraceback(const char *funcname, int c_line,
                               int py_line, const char *filename); /*proto*/

static int __Pyx_InitStrings(__Pyx_StringTabEntry *t); /*proto*/


/* Module declarations from 'cpython.mem' */

/* Module declarations from 'sqt._helpers' */
#define __Pyx_MODULE_NAME "sqt._helpers"
int __pyx_module_is_main_sqt___helpers = 0;

/* Implementation of 'sqt._helpers' */
static PyObject *__pyx_builtin_MemoryError;
static PyObject *__pyx_builtin_range;
static PyObject *__pyx_pf_3sqt_8_helpers_edit_distance(CYTHON_UNUSED PyObject *__pyx_self, char *__pyx_v_s, char *__pyx_v_t); /* proto */
static PyObject *__pyx_pf_3sqt_8_helpers_2globalalign(CYTHON_UNUSED PyObject *__pyx_self, char *__pyx_v_s1, char *__pyx_v_s2, int __pyx_v_flags, int __pyx_v_match, int __pyx_v_mismatch, int __pyx_v_insertion, int __pyx_v_deletion); /* proto */
static PyObject *__pyx_pf_3sqt_8_helpers_4byte_frequencies(CYTHON_UNUSED PyObject *__pyx_self, PyObject *__pyx_v_s); /* proto */
static char __pyx_k_5[] = "/home/marcel/scm/sqt/sqt/_helpers.pyx";
static char __pyx_k_6[] = "sqt._helpers";
static char __pyx_k__c[] = "c";
static char __pyx_k__i[] = "i";
static char __pyx_k__j[] = "j";
static char __pyx_k__m[] = "m";
static char __pyx_k__n[] = "n";
static char __pyx_k__s[] = "s";
static char __pyx_k__t[] = "t";
static char __pyx_k__UP[] = "UP";
static char __pyx_k__bt[] = "bt";
static char __pyx_k__p1[] = "p1";
static char __pyx_k__p2[] = "p2";
static char __pyx_k__s1[] = "s1";
static char __pyx_k__s2[] = "s2";
static char __pyx_k__tmp[] = "tmp";
static char __pyx_k__DIAG[] = "DIAG";
static char __pyx_k__LEFT[] = "LEFT";
static char __pyx_k__best[] = "best";
static char __pyx_k__prev[] = "prev";
static char __pyx_k__costs[] = "costs";
static char __pyx_k__flags[] = "flags";
static char __pyx_k__match[] = "match";
static char __pyx_k__range[] = "range";
static char __pyx_k__score[] = "score";
static char __pyx_k__align1[] = "align1";
static char __pyx_k__align2[] = "align2";
static char __pyx_k__best_i[] = "best_i";
static char __pyx_k__best_j[] = "best_j";
static char __pyx_k__errors[] = "errors";
static char __pyx_k__start1[] = "start1";
static char __pyx_k__start2[] = "start2";
static char __pyx_k__Counter[] = "Counter";
static char __pyx_k__columns[] = "columns";
static char __pyx_k__counter[] = "counter";
static char __pyx_k____main__[] = "__main__";
static char __pyx_k____test__[] = "__test__";
static char __pyx_k__deletion[] = "deletion";
static char __pyx_k__mismatch[] = "mismatch";
static char __pyx_k__direction[] = "direction";
static char __pyx_k__insertion[] = "insertion";
static char __pyx_k____import__[] = "__import__";
static char __pyx_k__alignment1[] = "alignment1";
static char __pyx_k__alignment2[] = "alignment2";
static char __pyx_k__cur_column[] = "cur_column";
static char __pyx_k__MemoryError[] = "MemoryError";
static char __pyx_k__collections[] = "collections";
static char __pyx_k__frequencies[] = "frequencies";
static char __pyx_k__globalalign[] = "globalalign";
static char __pyx_k__last_column[] = "last_column";
static char __pyx_k__prev_column[] = "prev_column";
static char __pyx_k__edit_distance[] = "edit_distance";
static char __pyx_k__gaps_are_errors[] = "gaps_are_errors";
static char __pyx_k__byte_frequencies[] = "byte_frequencies";
static PyObject *__pyx_kp_s_5;
static PyObject *__pyx_n_s_6;
static PyObject *__pyx_n_s__Counter;
static PyObject *__pyx_n_s__DIAG;
static PyObject *__pyx_n_s__LEFT;
static PyObject *__pyx_n_s__MemoryError;
static PyObject *__pyx_n_s__UP;
static PyObject *__pyx_n_s____import__;
static PyObject *__pyx_n_s____main__;
static PyObject *__pyx_n_s____test__;
static PyObject *__pyx_n_s__align1;
static PyObject *__pyx_n_s__align2;
static PyObject *__pyx_n_s__alignment1;
static PyObject *__pyx_n_s__alignment2;
static PyObject *__pyx_n_s__best;
static PyObject *__pyx_n_s__best_i;
static PyObject *__pyx_n_s__best_j;
static PyObject *__pyx_n_s__bt;
static PyObject *__pyx_n_s__byte_frequencies;
static PyObject *__pyx_n_s__c;
static PyObject *__pyx_n_s__collections;
static PyObject *__pyx_n_s__columns;
static PyObject *__pyx_n_s__costs;
static PyObject *__pyx_n_s__counter;
static PyObject *__pyx_n_s__cur_column;
static PyObject *__pyx_n_s__deletion;
static PyObject *__pyx_n_s__direction;
static PyObject *__pyx_n_s__edit_distance;
static PyObject *__pyx_n_s__errors;
static PyObject *__pyx_n_s__flags;
static PyObject *__pyx_n_s__frequencies;
static PyObject *__pyx_n_s__gaps_are_errors;
static PyObject *__pyx_n_s__globalalign;
static PyObject *__pyx_n_s__i;
static PyObject *__pyx_n_s__insertion;
static PyObject *__pyx_n_s__j;
static PyObject *__pyx_n_s__last_column;
static PyObject *__pyx_n_s__m;
static PyObject *__pyx_n_s__match;
static PyObject *__pyx_n_s__mismatch;
static PyObject *__pyx_n_s__n;
static PyObject *__pyx_n_s__p1;
static PyObject *__pyx_n_s__p2;
static PyObject *__pyx_n_s__prev;
static PyObject *__pyx_n_s__prev_column;
static PyObject *__pyx_n_s__range;
static PyObject *__pyx_n_s__s;
static PyObject *__pyx_n_s__s1;
static PyObject *__pyx_n_s__s2;
static PyObject *__pyx_n_s__score;
static PyObject *__pyx_n_s__start1;
static PyObject *__pyx_n_s__start2;
static PyObject *__pyx_n_s__t;
static PyObject *__pyx_n_s__tmp;
static PyObject *__pyx_int_neg_1;
static PyObject *__pyx_k_slice_1;
static PyObject *__pyx_k_slice_2;
static PyObject *__pyx_k_tuple_3;
static PyObject *__pyx_k_tuple_7;
static PyObject *__pyx_k_tuple_9;
static PyObject *__pyx_k_codeobj_4;
static PyObject *__pyx_k_codeobj_8;
static PyObject *__pyx_k_codeobj_10;

/* Python wrapper */
static PyObject *__pyx_pw_3sqt_8_helpers_1edit_distance(PyObject *__pyx_self, PyObject *__pyx_args, PyObject *__pyx_kwds); /*proto*/
static char __pyx_doc_3sqt_8_helpers_edit_distance[] = "\n\tReturn the edit distance between the strings s and t.\n\tThe edit distance is the sum of the numbers of insertions, deletions,\n\tand mismatches that is minimally necessary to transform one string\n\tinto the other.\n\t";
static PyMethodDef __pyx_mdef_3sqt_8_helpers_1edit_distance = {__Pyx_NAMESTR("edit_distance"), (PyCFunction)__pyx_pw_3sqt_8_helpers_1edit_distance, METH_VARARGS|METH_KEYWORDS, __Pyx_DOCSTR(__pyx_doc_3sqt_8_helpers_edit_distance)};
static PyObject *__pyx_pw_3sqt_8_helpers_1edit_distance(PyObject *__pyx_self, PyObject *__pyx_args, PyObject *__pyx_kwds) {
  char *__pyx_v_s;
  char *__pyx_v_t;
  int __pyx_lineno = 0;
  const char *__pyx_filename = NULL;
  int __pyx_clineno = 0;
  PyObject *__pyx_r = 0;
  __Pyx_RefNannyDeclarations
  __Pyx_RefNannySetupContext("edit_distance (wrapper)", 0);
  {
    static PyObject **__pyx_pyargnames[] = {&__pyx_n_s__s,&__pyx_n_s__t,0};
    PyObject* values[2] = {0,0};
    if (unlikely(__pyx_kwds)) {
      Py_ssize_t kw_args;
      const Py_ssize_t pos_args = PyTuple_GET_SIZE(__pyx_args);
      switch (pos_args) {
        case  2: values[1] = PyTuple_GET_ITEM(__pyx_args, 1);
        case  1: values[0] = PyTuple_GET_ITEM(__pyx_args, 0);
        case  0: break;
        default: goto __pyx_L5_argtuple_error;
      }
      kw_args = PyDict_Size(__pyx_kwds);
      switch (pos_args) {
        case  0:
        if (likely((values[0] = PyDict_GetItem(__pyx_kwds, __pyx_n_s__s)) != 0)) kw_args--;
        else goto __pyx_L5_argtuple_error;
        case  1:
        if (likely((values[1] = PyDict_GetItem(__pyx_kwds, __pyx_n_s__t)) != 0)) kw_args--;
        else {
          __Pyx_RaiseArgtupleInvalid("edit_distance", 1, 2, 2, 1); {__pyx_filename = __pyx_f[0]; __pyx_lineno = 29; __pyx_clineno = __LINE__; goto __pyx_L3_error;}
        }
      }
      if (unlikely(kw_args > 0)) {
        if (unlikely(__Pyx_ParseOptionalKeywords(__pyx_kwds, __pyx_pyargnames, 0, values, pos_args, "edit_distance") < 0)) {__pyx_filename = __pyx_f[0]; __pyx_lineno = 29; __pyx_clineno = __LINE__; goto __pyx_L3_error;}
      }
    } else if (PyTuple_GET_SIZE(__pyx_args) != 2) {
      goto __pyx_L5_argtuple_error;
    } else {
      values[0] = PyTuple_GET_ITEM(__pyx_args, 0);
      values[1] = PyTuple_GET_ITEM(__pyx_args, 1);
    }
    __pyx_v_s = __Pyx_PyObject_AsString(values[0]); if (unlikely((!__pyx_v_s) && PyErr_Occurred())) {__pyx_filename = __pyx_f[0]; __pyx_lineno = 29; __pyx_clineno = __LINE__; goto __pyx_L3_error;}
    __pyx_v_t = __Pyx_PyObject_AsString(values[1]); if (unlikely((!__pyx_v_t) && PyErr_Occurred())) {__pyx_filename = __pyx_f[0]; __pyx_lineno = 29; __pyx_clineno = __LINE__; goto __pyx_L3_error;}
  }
  goto __pyx_L4_argument_unpacking_done;
  __pyx_L5_argtuple_error:;
  __Pyx_RaiseArgtupleInvalid("edit_distance", 1, 2, 2, PyTuple_GET_SIZE(__pyx_args)); {__pyx_filename = __pyx_f[0]; __pyx_lineno = 29; __pyx_clineno = __LINE__; goto __pyx_L3_error;}
  __pyx_L3_error:;
  __Pyx_AddTraceback("sqt._helpers.edit_distance", __pyx_clineno, __pyx_lineno, __pyx_filename);
  __Pyx_RefNannyFinishContext();
  return NULL;
  __pyx_L4_argument_unpacking_done:;
  __pyx_r = __pyx_pf_3sqt_8_helpers_edit_distance(__pyx_self, __pyx_v_s, __pyx_v_t);
  __Pyx_RefNannyFinishContext();
  return __pyx_r;
}

/* "sqt/_helpers.pyx":29
 * 
 * 
 * def edit_distance(char* s, char* t):             # <<<<<<<<<<<<<<
 * 	"""
 * 	Return the edit distance between the strings s and t.
 */

static PyObject *__pyx_pf_3sqt_8_helpers_edit_distance(CYTHON_UNUSED PyObject *__pyx_self, char *__pyx_v_s, char *__pyx_v_t) {
  int __pyx_v_m;
  int __pyx_v_n;
  int __pyx_v_i;
  int __pyx_v_j;
  int __pyx_v_c;
  int *__pyx_v_costs;
  int __pyx_v_prev;
  PyObject *__pyx_r = NULL;
  __Pyx_RefNannyDeclarations
  size_t __pyx_t_1;
  int __pyx_t_2;
  PyObject *__pyx_t_3 = NULL;
  long __pyx_t_4;
  int __pyx_t_5;
  long __pyx_t_6;
  int __pyx_t_7;
  long __pyx_t_8;
  long __pyx_t_9;
  PyObject *__pyx_t_10 = NULL;
  PyObject *__pyx_t_11 = NULL;
  PyObject *__pyx_t_12 = NULL;
  int __pyx_t_13;
  int __pyx_lineno = 0;
  const char *__pyx_filename = NULL;
  int __pyx_clineno = 0;
  __Pyx_RefNannySetupContext("edit_distance", 0);

  /* "sqt/_helpers.pyx":36
 * 	into the other.
 * 	"""
 * 	cdef int m = len(s) # index: i             # <<<<<<<<<<<<<<
 * 	cdef int n = len(t) # index: j
 * 	cdef int i, j, c
 */
  __pyx_t_1 = strlen(__pyx_v_s); 
  __pyx_v_m = __pyx_t_1;

  /* "sqt/_helpers.pyx":37
 * 	"""
 * 	cdef int m = len(s) # index: i
 * 	cdef int n = len(t) # index: j             # <<<<<<<<<<<<<<
 * 	cdef int i, j, c
 * 
 */
  __pyx_t_1 = strlen(__pyx_v_t); 
  __pyx_v_n = __pyx_t_1;

  /* "sqt/_helpers.pyx":40
 * 	cdef int i, j, c
 * 
 * 	cdef int* costs = <int*> PyMem_Malloc((m+1) * sizeof(int))             # <<<<<<<<<<<<<<
 * 	if not costs:
 * 		return MemoryError()
 */
  __pyx_v_costs = ((int *)PyMem_Malloc(((__pyx_v_m + 1) * (sizeof(int)))));

  /* "sqt/_helpers.pyx":41
 * 
 * 	cdef int* costs = <int*> PyMem_Malloc((m+1) * sizeof(int))
 * 	if not costs:             # <<<<<<<<<<<<<<
 * 		return MemoryError()
 * 	for i in range(m+1):
 */
  __pyx_t_2 = ((!(__pyx_v_costs != 0)) != 0);
  if (__pyx_t_2) {

    /* "sqt/_helpers.pyx":42
 * 	cdef int* costs = <int*> PyMem_Malloc((m+1) * sizeof(int))
 * 	if not costs:
 * 		return MemoryError()             # <<<<<<<<<<<<<<
 * 	for i in range(m+1):
 * 		costs[i] = i
 */
    __Pyx_XDECREF(__pyx_r);
    __pyx_t_3 = PyObject_Call(__pyx_builtin_MemoryError, ((PyObject *)__pyx_empty_tuple), NULL); if (unlikely(!__pyx_t_3)) {__pyx_filename = __pyx_f[0]; __pyx_lineno = 42; __pyx_clineno = __LINE__; goto __pyx_L1_error;}
    __Pyx_GOTREF(__pyx_t_3);
    __pyx_r = __pyx_t_3;
    __pyx_t_3 = 0;
    goto __pyx_L0;
    goto __pyx_L3;
  }
  __pyx_L3:;

  /* "sqt/_helpers.pyx":43
 * 	if not costs:
 * 		return MemoryError()
 * 	for i in range(m+1):             # <<<<<<<<<<<<<<
 * 		costs[i] = i
 * 
 */
  __pyx_t_4 = (__pyx_v_m + 1);
  for (__pyx_t_5 = 0; __pyx_t_5 < __pyx_t_4; __pyx_t_5+=1) {
    __pyx_v_i = __pyx_t_5;

    /* "sqt/_helpers.pyx":44
 * 		return MemoryError()
 * 	for i in range(m+1):
 * 		costs[i] = i             # <<<<<<<<<<<<<<
 * 
 * 	# compute columns of the alignment matrix (using unit costs)
 */
    (__pyx_v_costs[__pyx_v_i]) = __pyx_v_i;
  }

  /* "sqt/_helpers.pyx":47
 * 
 * 	# compute columns of the alignment matrix (using unit costs)
 * 	cdef int prev = 0             # <<<<<<<<<<<<<<
 * 	for j in range(1, n+1):
 * 		prev = costs[0]
 */
  __pyx_v_prev = 0;

  /* "sqt/_helpers.pyx":48
 * 	# compute columns of the alignment matrix (using unit costs)
 * 	cdef int prev = 0
 * 	for j in range(1, n+1):             # <<<<<<<<<<<<<<
 * 		prev = costs[0]
 * 		costs[0] += 1
 */
  __pyx_t_4 = (__pyx_v_n + 1);
  for (__pyx_t_5 = 1; __pyx_t_5 < __pyx_t_4; __pyx_t_5+=1) {
    __pyx_v_j = __pyx_t_5;

    /* "sqt/_helpers.pyx":49
 * 	cdef int prev = 0
 * 	for j in range(1, n+1):
 * 		prev = costs[0]             # <<<<<<<<<<<<<<
 * 		costs[0] += 1
 * 		for i in range(1, m+1):
 */
    __pyx_v_prev = (__pyx_v_costs[0]);

    /* "sqt/_helpers.pyx":50
 * 	for j in range(1, n+1):
 * 		prev = costs[0]
 * 		costs[0] += 1             # <<<<<<<<<<<<<<
 * 		for i in range(1, m+1):
 * 			c = min(
 */
    __pyx_t_6 = 0;
    (__pyx_v_costs[__pyx_t_6]) = ((__pyx_v_costs[__pyx_t_6]) + 1);

    /* "sqt/_helpers.pyx":51
 * 		prev = costs[0]
 * 		costs[0] += 1
 * 		for i in range(1, m+1):             # <<<<<<<<<<<<<<
 * 			c = min(
 * 				prev + int(s[i-1] != t[j-1]),
 */
    __pyx_t_6 = (__pyx_v_m + 1);
    for (__pyx_t_7 = 1; __pyx_t_7 < __pyx_t_6; __pyx_t_7+=1) {
      __pyx_v_i = __pyx_t_7;

      /* "sqt/_helpers.pyx":54
 * 			c = min(
 * 				prev + int(s[i-1] != t[j-1]),
 * 				costs[i] + 1,             # <<<<<<<<<<<<<<
 * 				costs[i-1] + 1)
 * 			prev = costs[i]
 */
      __pyx_t_8 = ((__pyx_v_costs[__pyx_v_i]) + 1);

      /* "sqt/_helpers.pyx":55
 * 				prev + int(s[i-1] != t[j-1]),
 * 				costs[i] + 1,
 * 				costs[i-1] + 1)             # <<<<<<<<<<<<<<
 * 			prev = costs[i]
 * 			costs[i] = c
 */
      __pyx_t_9 = ((__pyx_v_costs[(__pyx_v_i - 1)]) + 1);

      /* "sqt/_helpers.pyx":53
 * 		for i in range(1, m+1):
 * 			c = min(
 * 				prev + int(s[i-1] != t[j-1]),             # <<<<<<<<<<<<<<
 * 				costs[i] + 1,
 * 				costs[i-1] + 1)
 */
      __pyx_t_3 = PyInt_FromLong(__pyx_v_prev); if (unlikely(!__pyx_t_3)) {__pyx_filename = __pyx_f[0]; __pyx_lineno = 53; __pyx_clineno = __LINE__; goto __pyx_L1_error;}
      __Pyx_GOTREF(__pyx_t_3);
      __pyx_t_10 = __Pyx_PyBool_FromLong(((__pyx_v_s[(__pyx_v_i - 1)]) != (__pyx_v_t[(__pyx_v_j - 1)]))); if (unlikely(!__pyx_t_10)) {__pyx_filename = __pyx_f[0]; __pyx_lineno = 53; __pyx_clineno = __LINE__; goto __pyx_L1_error;}
      __Pyx_GOTREF(__pyx_t_10);
      __pyx_t_11 = PyTuple_New(1); if (unlikely(!__pyx_t_11)) {__pyx_filename = __pyx_f[0]; __pyx_lineno = 53; __pyx_clineno = __LINE__; goto __pyx_L1_error;}
      __Pyx_GOTREF(__pyx_t_11);
      PyTuple_SET_ITEM(__pyx_t_11, 0, __pyx_t_10);
      __Pyx_GIVEREF(__pyx_t_10);
      __pyx_t_10 = 0;
      __pyx_t_10 = PyObject_Call(((PyObject *)((PyObject*)(&PyInt_Type))), ((PyObject *)__pyx_t_11), NULL); if (unlikely(!__pyx_t_10)) {__pyx_filename = __pyx_f[0]; __pyx_lineno = 53; __pyx_clineno = __LINE__; goto __pyx_L1_error;}
      __Pyx_GOTREF(__pyx_t_10);
      __Pyx_DECREF(((PyObject *)__pyx_t_11)); __pyx_t_11 = 0;
      __pyx_t_11 = PyNumber_Add(__pyx_t_3, __pyx_t_10); if (unlikely(!__pyx_t_11)) {__pyx_filename = __pyx_f[0]; __pyx_lineno = 53; __pyx_clineno = __LINE__; goto __pyx_L1_error;}
      __Pyx_GOTREF(__pyx_t_11);
      __Pyx_DECREF(__pyx_t_3); __pyx_t_3 = 0;
      __Pyx_DECREF(__pyx_t_10); __pyx_t_10 = 0;

      /* "sqt/_helpers.pyx":54
 * 			c = min(
 * 				prev + int(s[i-1] != t[j-1]),
 * 				costs[i] + 1,             # <<<<<<<<<<<<<<
 * 				costs[i-1] + 1)
 * 			prev = costs[i]
 */
      __pyx_t_3 = PyInt_FromLong(__pyx_t_8); if (unlikely(!__pyx_t_3)) {__pyx_filename = __pyx_f[0]; __pyx_lineno = 54; __pyx_clineno = __LINE__; goto __pyx_L1_error;}
      __Pyx_GOTREF(__pyx_t_3);
      __pyx_t_12 = PyObject_RichCompare(__pyx_t_3, __pyx_t_11, Py_LT); __Pyx_XGOTREF(__pyx_t_12); if (unlikely(!__pyx_t_12)) {__pyx_filename = __pyx_f[0]; __pyx_lineno = 54; __pyx_clineno = __LINE__; goto __pyx_L1_error;}
      __Pyx_DECREF(__pyx_t_3); __pyx_t_3 = 0;
      __pyx_t_2 = __Pyx_PyObject_IsTrue(__pyx_t_12); if (unlikely(__pyx_t_2 < 0)) {__pyx_filename = __pyx_f[0]; __pyx_lineno = 54; __pyx_clineno = __LINE__; goto __pyx_L1_error;}
      __Pyx_DECREF(__pyx_t_12); __pyx_t_12 = 0;
      if (__pyx_t_2) {
        __pyx_t_12 = PyInt_FromLong(__pyx_t_8); if (unlikely(!__pyx_t_12)) {__pyx_filename = __pyx_f[0]; __pyx_lineno = 54; __pyx_clineno = __LINE__; goto __pyx_L1_error;}
        __Pyx_GOTREF(__pyx_t_12);
        __pyx_t_10 = __pyx_t_12;
        __pyx_t_12 = 0;
      } else {
        __Pyx_INCREF(__pyx_t_11);
        __pyx_t_10 = __pyx_t_11;
      }
      __Pyx_DECREF(__pyx_t_11); __pyx_t_11 = 0;
      __Pyx_INCREF(__pyx_t_10);
      __pyx_t_11 = __pyx_t_10;
      __Pyx_DECREF(__pyx_t_10); __pyx_t_10 = 0;

      /* "sqt/_helpers.pyx":55
 * 				prev + int(s[i-1] != t[j-1]),
 * 				costs[i] + 1,
 * 				costs[i-1] + 1)             # <<<<<<<<<<<<<<
 * 			prev = costs[i]
 * 			costs[i] = c
 */
      __pyx_t_12 = PyInt_FromLong(__pyx_t_9); if (unlikely(!__pyx_t_12)) {__pyx_filename = __pyx_f[0]; __pyx_lineno = 55; __pyx_clineno = __LINE__; goto __pyx_L1_error;}
      __Pyx_GOTREF(__pyx_t_12);
      __pyx_t_3 = PyObject_RichCompare(__pyx_t_12, __pyx_t_11, Py_LT); __Pyx_XGOTREF(__pyx_t_3); if (unlikely(!__pyx_t_3)) {__pyx_filename = __pyx_f[0]; __pyx_lineno = 55; __pyx_clineno = __LINE__; goto __pyx_L1_error;}
      __Pyx_DECREF(__pyx_t_12); __pyx_t_12 = 0;
      __pyx_t_2 = __Pyx_PyObject_IsTrue(__pyx_t_3); if (unlikely(__pyx_t_2 < 0)) {__pyx_filename = __pyx_f[0]; __pyx_lineno = 55; __pyx_clineno = __LINE__; goto __pyx_L1_error;}
      __Pyx_DECREF(__pyx_t_3); __pyx_t_3 = 0;
      if (__pyx_t_2) {
        __pyx_t_3 = PyInt_FromLong(__pyx_t_9); if (unlikely(!__pyx_t_3)) {__pyx_filename = __pyx_f[0]; __pyx_lineno = 55; __pyx_clineno = __LINE__; goto __pyx_L1_error;}
        __Pyx_GOTREF(__pyx_t_3);
        __pyx_t_10 = __pyx_t_3;
        __pyx_t_3 = 0;
      } else {
        __Pyx_INCREF(__pyx_t_11);
        __pyx_t_10 = __pyx_t_11;
      }
      __Pyx_DECREF(__pyx_t_11); __pyx_t_11 = 0;
      __pyx_t_13 = __Pyx_PyInt_AsInt(__pyx_t_10); if (unlikely((__pyx_t_13 == (int)-1) && PyErr_Occurred())) {__pyx_filename = __pyx_f[0]; __pyx_lineno = 55; __pyx_clineno = __LINE__; goto __pyx_L1_error;}
      __Pyx_DECREF(__pyx_t_10); __pyx_t_10 = 0;
      __pyx_v_c = __pyx_t_13;

      /* "sqt/_helpers.pyx":56
 * 				costs[i] + 1,
 * 				costs[i-1] + 1)
 * 			prev = costs[i]             # <<<<<<<<<<<<<<
 * 			costs[i] = c
 * 	return costs[m]
 */
      __pyx_v_prev = (__pyx_v_costs[__pyx_v_i]);

      /* "sqt/_helpers.pyx":57
 * 				costs[i-1] + 1)
 * 			prev = costs[i]
 * 			costs[i] = c             # <<<<<<<<<<<<<<
 * 	return costs[m]
 * 
 */
      (__pyx_v_costs[__pyx_v_i]) = __pyx_v_c;
    }
  }

  /* "sqt/_helpers.pyx":58
 * 			prev = costs[i]
 * 			costs[i] = c
 * 	return costs[m]             # <<<<<<<<<<<<<<
 * 
 * 
 */
  __Pyx_XDECREF(__pyx_r);
  __pyx_t_10 = PyInt_FromLong((__pyx_v_costs[__pyx_v_m])); if (unlikely(!__pyx_t_10)) {__pyx_filename = __pyx_f[0]; __pyx_lineno = 58; __pyx_clineno = __LINE__; goto __pyx_L1_error;}
  __Pyx_GOTREF(__pyx_t_10);
  __pyx_r = __pyx_t_10;
  __pyx_t_10 = 0;
  goto __pyx_L0;

  __pyx_r = Py_None; __Pyx_INCREF(Py_None);
  goto __pyx_L0;
  __pyx_L1_error:;
  __Pyx_XDECREF(__pyx_t_3);
  __Pyx_XDECREF(__pyx_t_10);
  __Pyx_XDECREF(__pyx_t_11);
  __Pyx_XDECREF(__pyx_t_12);
  __Pyx_AddTraceback("sqt._helpers.edit_distance", __pyx_clineno, __pyx_lineno, __pyx_filename);
  __pyx_r = NULL;
  __pyx_L0:;
  __Pyx_XGIVEREF(__pyx_r);
  __Pyx_RefNannyFinishContext();
  return __pyx_r;
}

/* Python wrapper */
static PyObject *__pyx_pw_3sqt_8_helpers_3globalalign(PyObject *__pyx_self, PyObject *__pyx_args, PyObject *__pyx_kwds); /*proto*/
static char __pyx_doc_3sqt_8_helpers_2globalalign[] = "Compute a global or semiglobal alignment of strings s1 and s2.\n\n\tReturn ... -> (r1, r2, start1, stop1, start2, stop2, errors)\n\n\tTODO\n\n\tThis is a direct translation of the C code and should be re-written to make\n\tit more readable. (Use Cython's memoryview for the matrix, avoid pointer-like\n\taccess to p1 and p2.)\n\n\tFIXME THE REMAINDER OF THIS DOCSTRING\n\n\tReturn a tuple (row1, row2, start1, stop1, start2, stop2, errors)\n\twhere row1 and row2 are strings of the same length containing the alignment\n\t(an INDEL is marked by a null byte ('\\0').\n\n\tstart1 is the position within row1 at which the part of s1, that is aligned, starts.\n\tstart2 is the position within row1 at which the part of s1, that is aligned, ends.\n\tThe same holds for start2, stop2.\n\n\tIt is always the case that at least one of start1 and start2 is zero.\n\n\tIt is always the case that either stop1==len(row1) or stop2==len(row2) or both\n\t(note that len(row1)==len(row2)). This is a property of semiglobal alignments.\n\n\terrors is the number of errors in the alignment.\n\n\tFor example, globalalign(\"SISSI\", \"MISSISSIPPI\") returns:\n\n\trow1 = [   0,   0,   0, 'S', 'I', 'S', 'S', 'I',   0,   0,   0]\n\trow2 = [ 'M', 'I', 'S', 'S', 'I', 'S', 'S', 'I', 'P', 'P', 'I']\n\tstart1, stop1 = 0, 5\n\tstart2, stop2 = 3, 8\n\terrors = 0\n\n\tThis corresponds to the following alignment:\n\tSISSI\n\t|||||\n\tMISSISSIPPI\n\t";
static PyMethodDef __pyx_mdef_3sqt_8_helpers_3globalalign = {__Pyx_NAMESTR("globalalign"), (PyCFunction)__pyx_pw_3sqt_8_helpers_3globalalign, METH_VARARGS|METH_KEYWORDS, __Pyx_DOCSTR(__pyx_doc_3sqt_8_helpers_2globalalign)};
static PyObject *__pyx_pw_3sqt_8_helpers_3globalalign(PyObject *__pyx_self, PyObject *__pyx_args, PyObject *__pyx_kwds) {
  char *__pyx_v_s1;
  char *__pyx_v_s2;
  int __pyx_v_flags;
  int __pyx_v_match;
  int __pyx_v_mismatch;
  int __pyx_v_insertion;
  int __pyx_v_deletion;
  int __pyx_lineno = 0;
  const char *__pyx_filename = NULL;
  int __pyx_clineno = 0;
  PyObject *__pyx_r = 0;
  __Pyx_RefNannyDeclarations
  __Pyx_RefNannySetupContext("globalalign (wrapper)", 0);
  {
    static PyObject **__pyx_pyargnames[] = {&__pyx_n_s__s1,&__pyx_n_s__s2,&__pyx_n_s__flags,&__pyx_n_s__match,&__pyx_n_s__mismatch,&__pyx_n_s__insertion,&__pyx_n_s__deletion,0};
    PyObject* values[7] = {0,0,0,0,0,0,0};
    if (unlikely(__pyx_kwds)) {
      Py_ssize_t kw_args;
      const Py_ssize_t pos_args = PyTuple_GET_SIZE(__pyx_args);
      switch (pos_args) {
        case  7: values[6] = PyTuple_GET_ITEM(__pyx_args, 6);
        case  6: values[5] = PyTuple_GET_ITEM(__pyx_args, 5);
        case  5: values[4] = PyTuple_GET_ITEM(__pyx_args, 4);
        case  4: values[3] = PyTuple_GET_ITEM(__pyx_args, 3);
        case  3: values[2] = PyTuple_GET_ITEM(__pyx_args, 2);
        case  2: values[1] = PyTuple_GET_ITEM(__pyx_args, 1);
        case  1: values[0] = PyTuple_GET_ITEM(__pyx_args, 0);
        case  0: break;
        default: goto __pyx_L5_argtuple_error;
      }
      kw_args = PyDict_Size(__pyx_kwds);
      switch (pos_args) {
        case  0:
        if (likely((values[0] = PyDict_GetItem(__pyx_kwds, __pyx_n_s__s1)) != 0)) kw_args--;
        else goto __pyx_L5_argtuple_error;
        case  1:
        if (likely((values[1] = PyDict_GetItem(__pyx_kwds, __pyx_n_s__s2)) != 0)) kw_args--;
        else {
          __Pyx_RaiseArgtupleInvalid("globalalign", 0, 2, 7, 1); {__pyx_filename = __pyx_f[0]; __pyx_lineno = 61; __pyx_clineno = __LINE__; goto __pyx_L3_error;}
        }
        case  2:
        if (kw_args > 0) {
          PyObject* value = PyDict_GetItem(__pyx_kwds, __pyx_n_s__flags);
          if (value) { values[2] = value; kw_args--; }
        }
        case  3:
        if (kw_args > 0) {
          PyObject* value = PyDict_GetItem(__pyx_kwds, __pyx_n_s__match);
          if (value) { values[3] = value; kw_args--; }
        }
        case  4:
        if (kw_args > 0) {
          PyObject* value = PyDict_GetItem(__pyx_kwds, __pyx_n_s__mismatch);
          if (value) { values[4] = value; kw_args--; }
        }
        case  5:
        if (kw_args > 0) {
          PyObject* value = PyDict_GetItem(__pyx_kwds, __pyx_n_s__insertion);
          if (value) { values[5] = value; kw_args--; }
        }
        case  6:
        if (kw_args > 0) {
          PyObject* value = PyDict_GetItem(__pyx_kwds, __pyx_n_s__deletion);
          if (value) { values[6] = value; kw_args--; }
        }
      }
      if (unlikely(kw_args > 0)) {
        if (unlikely(__Pyx_ParseOptionalKeywords(__pyx_kwds, __pyx_pyargnames, 0, values, pos_args, "globalalign") < 0)) {__pyx_filename = __pyx_f[0]; __pyx_lineno = 61; __pyx_clineno = __LINE__; goto __pyx_L3_error;}
      }
    } else {
      switch (PyTuple_GET_SIZE(__pyx_args)) {
        case  7: values[6] = PyTuple_GET_ITEM(__pyx_args, 6);
        case  6: values[5] = PyTuple_GET_ITEM(__pyx_args, 5);
        case  5: values[4] = PyTuple_GET_ITEM(__pyx_args, 4);
        case  4: values[3] = PyTuple_GET_ITEM(__pyx_args, 3);
        case  3: values[2] = PyTuple_GET_ITEM(__pyx_args, 2);
        case  2: values[1] = PyTuple_GET_ITEM(__pyx_args, 1);
        values[0] = PyTuple_GET_ITEM(__pyx_args, 0);
        break;
        default: goto __pyx_L5_argtuple_error;
      }
    }
    __pyx_v_s1 = __Pyx_PyObject_AsString(values[0]); if (unlikely((!__pyx_v_s1) && PyErr_Occurred())) {__pyx_filename = __pyx_f[0]; __pyx_lineno = 61; __pyx_clineno = __LINE__; goto __pyx_L3_error;}
    __pyx_v_s2 = __Pyx_PyObject_AsString(values[1]); if (unlikely((!__pyx_v_s2) && PyErr_Occurred())) {__pyx_filename = __pyx_f[0]; __pyx_lineno = 61; __pyx_clineno = __LINE__; goto __pyx_L3_error;}
    if (values[2]) {
      __pyx_v_flags = __Pyx_PyInt_AsInt(values[2]); if (unlikely((__pyx_v_flags == (int)-1) && PyErr_Occurred())) {__pyx_filename = __pyx_f[0]; __pyx_lineno = 61; __pyx_clineno = __LINE__; goto __pyx_L3_error;}
    } else {
      __pyx_v_flags = ((int)0);
    }
    if (values[3]) {
      __pyx_v_match = __Pyx_PyInt_AsInt(values[3]); if (unlikely((__pyx_v_match == (int)-1) && PyErr_Occurred())) {__pyx_filename = __pyx_f[0]; __pyx_lineno = 61; __pyx_clineno = __LINE__; goto __pyx_L3_error;}
    } else {
      __pyx_v_match = ((int)1);
    }
    if (values[4]) {
      __pyx_v_mismatch = __Pyx_PyInt_AsInt(values[4]); if (unlikely((__pyx_v_mismatch == (int)-1) && PyErr_Occurred())) {__pyx_filename = __pyx_f[0]; __pyx_lineno = 61; __pyx_clineno = __LINE__; goto __pyx_L3_error;}
    } else {
      __pyx_v_mismatch = ((int)-2);
    }
    if (values[5]) {
      __pyx_v_insertion = __Pyx_PyInt_AsInt(values[5]); if (unlikely((__pyx_v_insertion == (int)-1) && PyErr_Occurred())) {__pyx_filename = __pyx_f[0]; __pyx_lineno = 61; __pyx_clineno = __LINE__; goto __pyx_L3_error;}
    } else {
      __pyx_v_insertion = ((int)-2);
    }
    if (values[6]) {
      __pyx_v_deletion = __Pyx_PyInt_AsInt(values[6]); if (unlikely((__pyx_v_deletion == (int)-1) && PyErr_Occurred())) {__pyx_filename = __pyx_f[0]; __pyx_lineno = 61; __pyx_clineno = __LINE__; goto __pyx_L3_error;}
    } else {
      __pyx_v_deletion = ((int)-2);
    }
  }
  goto __pyx_L4_argument_unpacking_done;
  __pyx_L5_argtuple_error:;
  __Pyx_RaiseArgtupleInvalid("globalalign", 0, 2, 7, PyTuple_GET_SIZE(__pyx_args)); {__pyx_filename = __pyx_f[0]; __pyx_lineno = 61; __pyx_clineno = __LINE__; goto __pyx_L3_error;}
  __pyx_L3_error:;
  __Pyx_AddTraceback("sqt._helpers.globalalign", __pyx_clineno, __pyx_lineno, __pyx_filename);
  __Pyx_RefNannyFinishContext();
  return NULL;
  __pyx_L4_argument_unpacking_done:;
  __pyx_r = __pyx_pf_3sqt_8_helpers_2globalalign(__pyx_self, __pyx_v_s1, __pyx_v_s2, __pyx_v_flags, __pyx_v_match, __pyx_v_mismatch, __pyx_v_insertion, __pyx_v_deletion);
  __Pyx_RefNannyFinishContext();
  return __pyx_r;
}

/* "sqt/_helpers.pyx":61
 * 
 * 
 * def globalalign(char* s1, char* s2, int flags=0, int match=1, int mismatch=-2, int insertion=-2, int deletion=-2):             # <<<<<<<<<<<<<<
 * 	"""Compute a global or semiglobal alignment of strings s1 and s2.
 * 
 */

static PyObject *__pyx_pf_3sqt_8_helpers_2globalalign(CYTHON_UNUSED PyObject *__pyx_self, char *__pyx_v_s1, char *__pyx_v_s2, int __pyx_v_flags, int __pyx_v_match, int __pyx_v_mismatch, int __pyx_v_insertion, int __pyx_v_deletion) {
  int __pyx_v_m;
  int __pyx_v_n;
  int __pyx_v_LEFT;
  int __pyx_v_UP;
  int __pyx_v_DIAG;
  __pyx_t_3sqt_8_helpers_ScoreEntry *__pyx_v_columns;
  int __pyx_v_i;
  int __pyx_v_j;
  int __pyx_v_bt;
  int __pyx_v_score;
  int __pyx_v_tmp;
  __pyx_t_3sqt_8_helpers_ScoreEntry *__pyx_v_cur_column;
  __pyx_t_3sqt_8_helpers_ScoreEntry *__pyx_v_prev_column;
  int __pyx_v_best_i;
  int __pyx_v_best_j;
  int __pyx_v_best;
  __pyx_t_3sqt_8_helpers_ScoreEntry *__pyx_v_last_column;
  char *__pyx_v_alignment1;
  char *__pyx_v_alignment2;
  char *__pyx_v_p1;
  char *__pyx_v_p2;
  int __pyx_v_errors;
  int __pyx_v_gaps_are_errors;
  int __pyx_v_direction;
  int __pyx_v_start1;
  int __pyx_v_start2;
  PyObject *__pyx_v_align1 = NULL;
  PyObject *__pyx_v_align2 = NULL;
  PyObject *__pyx_r = NULL;
  __Pyx_RefNannyDeclarations
  size_t __pyx_t_1;
  int __pyx_t_2;
  long __pyx_t_3;
  int __pyx_t_4;
  long __pyx_t_5;
  int __pyx_t_6;
  int __pyx_t_7;
  int __pyx_t_8;
  int __pyx_t_9;
  PyObject *__pyx_t_10 = NULL;
  PyObject *__pyx_t_11 = NULL;
  PyObject *__pyx_t_12 = NULL;
  PyObject *__pyx_t_13 = NULL;
  PyObject *__pyx_t_14 = NULL;
  PyObject *__pyx_t_15 = NULL;
  int __pyx_lineno = 0;
  const char *__pyx_filename = NULL;
  int __pyx_clineno = 0;
  __Pyx_RefNannySetupContext("globalalign", 0);

  /* "sqt/_helpers.pyx":102
 * 	MISSISSIPPI
 * 	"""
 * 	cdef int m = len(s1)             # <<<<<<<<<<<<<<
 * 	cdef int n = len(s2)
 * 	# DP Matrix:
 */
  __pyx_t_1 = strlen(__pyx_v_s1); 
  __pyx_v_m = __pyx_t_1;

  /* "sqt/_helpers.pyx":103
 * 	"""
 * 	cdef int m = len(s1)
 * 	cdef int n = len(s2)             # <<<<<<<<<<<<<<
 * 	# DP Matrix:
 * 	#            s2 (j)
 */
  __pyx_t_1 = strlen(__pyx_v_s2); 
  __pyx_v_n = __pyx_t_1;

  /* "sqt/_helpers.pyx":114
 * 
 * 	# direction constants for backtrace table
 * 	cdef int LEFT = 1, UP = 2, DIAG = 3             # <<<<<<<<<<<<<<
 * 
 * 	# the DP matrix is stored column-major
 */
  __pyx_v_LEFT = 1;
  __pyx_v_UP = 2;
  __pyx_v_DIAG = 3;

  /* "sqt/_helpers.pyx":117
 * 
 * 	# the DP matrix is stored column-major
 * 	cdef ScoreEntry* columns = <ScoreEntry*> PyMem_Malloc((m+1)*(n+1)*sizeof(ScoreEntry))             # <<<<<<<<<<<<<<
 * 	if not columns:
 * 		raise MemoryError()
 */
  __pyx_v_columns = ((__pyx_t_3sqt_8_helpers_ScoreEntry *)PyMem_Malloc((((__pyx_v_m + 1) * (__pyx_v_n + 1)) * (sizeof(__pyx_t_3sqt_8_helpers_ScoreEntry)))));

  /* "sqt/_helpers.pyx":118
 * 	# the DP matrix is stored column-major
 * 	cdef ScoreEntry* columns = <ScoreEntry*> PyMem_Malloc((m+1)*(n+1)*sizeof(ScoreEntry))
 * 	if not columns:             # <<<<<<<<<<<<<<
 * 		raise MemoryError()
 * 
 */
  __pyx_t_2 = ((!(__pyx_v_columns != 0)) != 0);
  if (__pyx_t_2) {

    /* "sqt/_helpers.pyx":119
 * 	cdef ScoreEntry* columns = <ScoreEntry*> PyMem_Malloc((m+1)*(n+1)*sizeof(ScoreEntry))
 * 	if not columns:
 * 		raise MemoryError()             # <<<<<<<<<<<<<<
 * 
 * 	cdef int i, j, bt, score, tmp
 */
    PyErr_NoMemory(); {__pyx_filename = __pyx_f[0]; __pyx_lineno = 119; __pyx_clineno = __LINE__; goto __pyx_L1_error;}
    goto __pyx_L3;
  }
  __pyx_L3:;

  /* "sqt/_helpers.pyx":124
 * 
 * 	# initialize first column
 * 	for i in range(m + 1):             # <<<<<<<<<<<<<<
 * 		columns[i].score = 0 if (flags & START_WITHIN_SEQ1) else i * deletion
 * 		columns[i].backtrace = UP
 */
  __pyx_t_3 = (__pyx_v_m + 1);
  for (__pyx_t_4 = 0; __pyx_t_4 < __pyx_t_3; __pyx_t_4+=1) {
    __pyx_v_i = __pyx_t_4;

    /* "sqt/_helpers.pyx":125
 * 	# initialize first column
 * 	for i in range(m + 1):
 * 		columns[i].score = 0 if (flags & START_WITHIN_SEQ1) else i * deletion             # <<<<<<<<<<<<<<
 * 		columns[i].backtrace = UP
 * 
 */
    if (((__pyx_v_flags & 1) != 0)) {
      __pyx_t_5 = 0;
    } else {
      __pyx_t_5 = (__pyx_v_i * __pyx_v_deletion);
    }
    (__pyx_v_columns[__pyx_v_i]).score = __pyx_t_5;

    /* "sqt/_helpers.pyx":126
 * 	for i in range(m + 1):
 * 		columns[i].score = 0 if (flags & START_WITHIN_SEQ1) else i * deletion
 * 		columns[i].backtrace = UP             # <<<<<<<<<<<<<<
 * 
 * 	# initialize first row
 */
    (__pyx_v_columns[__pyx_v_i]).backtrace = __pyx_v_UP;
  }

  /* "sqt/_helpers.pyx":129
 * 
 * 	# initialize first row
 * 	for j in range(n + 1):             # <<<<<<<<<<<<<<
 * 		columns[j*(m+1)].score = 0 if (flags & START_WITHIN_SEQ2) else j * insertion
 * 		columns[j*(m+1)].backtrace = LEFT
 */
  __pyx_t_3 = (__pyx_v_n + 1);
  for (__pyx_t_4 = 0; __pyx_t_4 < __pyx_t_3; __pyx_t_4+=1) {
    __pyx_v_j = __pyx_t_4;

    /* "sqt/_helpers.pyx":130
 * 	# initialize first row
 * 	for j in range(n + 1):
 * 		columns[j*(m+1)].score = 0 if (flags & START_WITHIN_SEQ2) else j * insertion             # <<<<<<<<<<<<<<
 * 		columns[j*(m+1)].backtrace = LEFT
 * 
 */
    if (((__pyx_v_flags & 2) != 0)) {
      __pyx_t_5 = 0;
    } else {
      __pyx_t_5 = (__pyx_v_j * __pyx_v_insertion);
    }
    (__pyx_v_columns[(__pyx_v_j * (__pyx_v_m + 1))]).score = __pyx_t_5;

    /* "sqt/_helpers.pyx":131
 * 	for j in range(n + 1):
 * 		columns[j*(m+1)].score = 0 if (flags & START_WITHIN_SEQ2) else j * insertion
 * 		columns[j*(m+1)].backtrace = LEFT             # <<<<<<<<<<<<<<
 * 
 * 	# fill the entire DP matrix
 */
    (__pyx_v_columns[(__pyx_v_j * (__pyx_v_m + 1))]).backtrace = __pyx_v_LEFT;
  }

  /* "sqt/_helpers.pyx":136
 * 	# outer loop goes over columns
 * 	cdef ScoreEntry* cur_column
 * 	cdef ScoreEntry* prev_column = columns             # <<<<<<<<<<<<<<
 * 	for j in range(1, n+1):
 * 		cur_column = &(columns[j*(m+1)])
 */
  __pyx_v_prev_column = __pyx_v_columns;

  /* "sqt/_helpers.pyx":137
 * 	cdef ScoreEntry* cur_column
 * 	cdef ScoreEntry* prev_column = columns
 * 	for j in range(1, n+1):             # <<<<<<<<<<<<<<
 * 		cur_column = &(columns[j*(m+1)])
 * 		for i in range(1, m+1):
 */
  __pyx_t_3 = (__pyx_v_n + 1);
  for (__pyx_t_4 = 1; __pyx_t_4 < __pyx_t_3; __pyx_t_4+=1) {
    __pyx_v_j = __pyx_t_4;

    /* "sqt/_helpers.pyx":138
 * 	cdef ScoreEntry* prev_column = columns
 * 	for j in range(1, n+1):
 * 		cur_column = &(columns[j*(m+1)])             # <<<<<<<<<<<<<<
 * 		for i in range(1, m+1):
 * 			bt = DIAG
 */
    __pyx_v_cur_column = (&(__pyx_v_columns[(__pyx_v_j * (__pyx_v_m + 1))]));

    /* "sqt/_helpers.pyx":139
 * 	for j in range(1, n+1):
 * 		cur_column = &(columns[j*(m+1)])
 * 		for i in range(1, m+1):             # <<<<<<<<<<<<<<
 * 			bt = DIAG
 * 			score = prev_column[i-1].score + (match if (s1[i-1] == s2[j-1]) else mismatch)
 */
    __pyx_t_5 = (__pyx_v_m + 1);
    for (__pyx_t_6 = 1; __pyx_t_6 < __pyx_t_5; __pyx_t_6+=1) {
      __pyx_v_i = __pyx_t_6;

      /* "sqt/_helpers.pyx":140
 * 		cur_column = &(columns[j*(m+1)])
 * 		for i in range(1, m+1):
 * 			bt = DIAG             # <<<<<<<<<<<<<<
 * 			score = prev_column[i-1].score + (match if (s1[i-1] == s2[j-1]) else mismatch)
 * 			tmp = cur_column[i-1].score + insertion
 */
      __pyx_v_bt = __pyx_v_DIAG;

      /* "sqt/_helpers.pyx":141
 * 		for i in range(1, m+1):
 * 			bt = DIAG
 * 			score = prev_column[i-1].score + (match if (s1[i-1] == s2[j-1]) else mismatch)             # <<<<<<<<<<<<<<
 * 			tmp = cur_column[i-1].score + insertion
 * 			if tmp > score:
 */
      if ((((__pyx_v_s1[(__pyx_v_i - 1)]) == (__pyx_v_s2[(__pyx_v_j - 1)])) != 0)) {
        __pyx_t_7 = __pyx_v_match;
      } else {
        __pyx_t_7 = __pyx_v_mismatch;
      }
      __pyx_v_score = ((__pyx_v_prev_column[(__pyx_v_i - 1)]).score + __pyx_t_7);

      /* "sqt/_helpers.pyx":142
 * 			bt = DIAG
 * 			score = prev_column[i-1].score + (match if (s1[i-1] == s2[j-1]) else mismatch)
 * 			tmp = cur_column[i-1].score + insertion             # <<<<<<<<<<<<<<
 * 			if tmp > score:
 * 				bt = UP
 */
      __pyx_v_tmp = ((__pyx_v_cur_column[(__pyx_v_i - 1)]).score + __pyx_v_insertion);

      /* "sqt/_helpers.pyx":143
 * 			score = prev_column[i-1].score + (match if (s1[i-1] == s2[j-1]) else mismatch)
 * 			tmp = cur_column[i-1].score + insertion
 * 			if tmp > score:             # <<<<<<<<<<<<<<
 * 				bt = UP
 * 				score = tmp
 */
      __pyx_t_2 = ((__pyx_v_tmp > __pyx_v_score) != 0);
      if (__pyx_t_2) {

        /* "sqt/_helpers.pyx":144
 * 			tmp = cur_column[i-1].score + insertion
 * 			if tmp > score:
 * 				bt = UP             # <<<<<<<<<<<<<<
 * 				score = tmp
 * 			tmp = prev_column[i].score + deletion
 */
        __pyx_v_bt = __pyx_v_UP;

        /* "sqt/_helpers.pyx":145
 * 			if tmp > score:
 * 				bt = UP
 * 				score = tmp             # <<<<<<<<<<<<<<
 * 			tmp = prev_column[i].score + deletion
 * 			if tmp > score:
 */
        __pyx_v_score = __pyx_v_tmp;
        goto __pyx_L12;
      }
      __pyx_L12:;

      /* "sqt/_helpers.pyx":146
 * 				bt = UP
 * 				score = tmp
 * 			tmp = prev_column[i].score + deletion             # <<<<<<<<<<<<<<
 * 			if tmp > score:
 * 				bt = LEFT
 */
      __pyx_v_tmp = ((__pyx_v_prev_column[__pyx_v_i]).score + __pyx_v_deletion);

      /* "sqt/_helpers.pyx":147
 * 				score = tmp
 * 			tmp = prev_column[i].score + deletion
 * 			if tmp > score:             # <<<<<<<<<<<<<<
 * 				bt = LEFT
 * 				score = tmp
 */
      __pyx_t_2 = ((__pyx_v_tmp > __pyx_v_score) != 0);
      if (__pyx_t_2) {

        /* "sqt/_helpers.pyx":148
 * 			tmp = prev_column[i].score + deletion
 * 			if tmp > score:
 * 				bt = LEFT             # <<<<<<<<<<<<<<
 * 				score = tmp
 * 			cur_column[i].score = score
 */
        __pyx_v_bt = __pyx_v_LEFT;

        /* "sqt/_helpers.pyx":149
 * 			if tmp > score:
 * 				bt = LEFT
 * 				score = tmp             # <<<<<<<<<<<<<<
 * 			cur_column[i].score = score
 * 			cur_column[i].backtrace = bt
 */
        __pyx_v_score = __pyx_v_tmp;
        goto __pyx_L13;
      }
      __pyx_L13:;

      /* "sqt/_helpers.pyx":150
 * 				bt = LEFT
 * 				score = tmp
 * 			cur_column[i].score = score             # <<<<<<<<<<<<<<
 * 			cur_column[i].backtrace = bt
 * 		prev_column = cur_column
 */
      (__pyx_v_cur_column[__pyx_v_i]).score = __pyx_v_score;

      /* "sqt/_helpers.pyx":151
 * 				score = tmp
 * 			cur_column[i].score = score
 * 			cur_column[i].backtrace = bt             # <<<<<<<<<<<<<<
 * 		prev_column = cur_column
 * 
 */
      (__pyx_v_cur_column[__pyx_v_i]).backtrace = __pyx_v_bt;
    }

    /* "sqt/_helpers.pyx":152
 * 			cur_column[i].score = score
 * 			cur_column[i].backtrace = bt
 * 		prev_column = cur_column             # <<<<<<<<<<<<<<
 * 
 * 	# initialize best score and its position to the bottomright cell
 */
    __pyx_v_prev_column = __pyx_v_cur_column;
  }

  /* "sqt/_helpers.pyx":155
 * 
 * 	# initialize best score and its position to the bottomright cell
 * 	cdef int best_i = m  # also: s1stop             # <<<<<<<<<<<<<<
 * 	cdef int best_j = n  # also: s2stop
 * 	cdef int best = columns[(n+1)*(m+1)-1].score
 */
  __pyx_v_best_i = __pyx_v_m;

  /* "sqt/_helpers.pyx":156
 * 	# initialize best score and its position to the bottomright cell
 * 	cdef int best_i = m  # also: s1stop
 * 	cdef int best_j = n  # also: s2stop             # <<<<<<<<<<<<<<
 * 	cdef int best = columns[(n+1)*(m+1)-1].score
 * 
 */
  __pyx_v_best_j = __pyx_v_n;

  /* "sqt/_helpers.pyx":157
 * 	cdef int best_i = m  # also: s1stop
 * 	cdef int best_j = n  # also: s2stop
 * 	cdef int best = columns[(n+1)*(m+1)-1].score             # <<<<<<<<<<<<<<
 * 
 * 	if flags & STOP_WITHIN_SEQ2:
 */
  __pyx_t_4 = (__pyx_v_columns[(((__pyx_v_n + 1) * (__pyx_v_m + 1)) - 1)]).score;
  __pyx_v_best = __pyx_t_4;

  /* "sqt/_helpers.pyx":159
 * 	cdef int best = columns[(n+1)*(m+1)-1].score
 * 
 * 	if flags & STOP_WITHIN_SEQ2:             # <<<<<<<<<<<<<<
 * 		# search also in last row
 * 		for j in range(n + 1):
 */
  __pyx_t_2 = ((__pyx_v_flags & 8) != 0);
  if (__pyx_t_2) {

    /* "sqt/_helpers.pyx":161
 * 	if flags & STOP_WITHIN_SEQ2:
 * 		# search also in last row
 * 		for j in range(n + 1):             # <<<<<<<<<<<<<<
 * 			if columns[j*(m+1)+m].score >= best:
 * 				best = columns[j*(m+1)+m].score
 */
    __pyx_t_3 = (__pyx_v_n + 1);
    for (__pyx_t_4 = 0; __pyx_t_4 < __pyx_t_3; __pyx_t_4+=1) {
      __pyx_v_j = __pyx_t_4;

      /* "sqt/_helpers.pyx":162
 * 		# search also in last row
 * 		for j in range(n + 1):
 * 			if columns[j*(m+1)+m].score >= best:             # <<<<<<<<<<<<<<
 * 				best = columns[j*(m+1)+m].score
 * 				best_i = m
 */
      __pyx_t_2 = (((__pyx_v_columns[((__pyx_v_j * (__pyx_v_m + 1)) + __pyx_v_m)]).score >= __pyx_v_best) != 0);
      if (__pyx_t_2) {

        /* "sqt/_helpers.pyx":163
 * 		for j in range(n + 1):
 * 			if columns[j*(m+1)+m].score >= best:
 * 				best = columns[j*(m+1)+m].score             # <<<<<<<<<<<<<<
 * 				best_i = m
 * 				best_j = j
 */
        __pyx_t_6 = (__pyx_v_columns[((__pyx_v_j * (__pyx_v_m + 1)) + __pyx_v_m)]).score;
        __pyx_v_best = __pyx_t_6;

        /* "sqt/_helpers.pyx":164
 * 			if columns[j*(m+1)+m].score >= best:
 * 				best = columns[j*(m+1)+m].score
 * 				best_i = m             # <<<<<<<<<<<<<<
 * 				best_j = j
 * 
 */
        __pyx_v_best_i = __pyx_v_m;

        /* "sqt/_helpers.pyx":165
 * 				best = columns[j*(m+1)+m].score
 * 				best_i = m
 * 				best_j = j             # <<<<<<<<<<<<<<
 * 
 * 	cdef ScoreEntry* last_column
 */
        __pyx_v_best_j = __pyx_v_j;
        goto __pyx_L17;
      }
      __pyx_L17:;
    }
    goto __pyx_L14;
  }
  __pyx_L14:;

  /* "sqt/_helpers.pyx":168
 * 
 * 	cdef ScoreEntry* last_column
 * 	if flags & STOP_WITHIN_SEQ1:             # <<<<<<<<<<<<<<
 * 		# search also in last column
 * 		last_column = &(columns[n*(m+1)])
 */
  __pyx_t_2 = ((__pyx_v_flags & 4) != 0);
  if (__pyx_t_2) {

    /* "sqt/_helpers.pyx":170
 * 	if flags & STOP_WITHIN_SEQ1:
 * 		# search also in last column
 * 		last_column = &(columns[n*(m+1)])             # <<<<<<<<<<<<<<
 * 		for i in range(m + 1):
 * 			if last_column[i].score >= best:
 */
    __pyx_v_last_column = (&(__pyx_v_columns[(__pyx_v_n * (__pyx_v_m + 1))]));

    /* "sqt/_helpers.pyx":171
 * 		# search also in last column
 * 		last_column = &(columns[n*(m+1)])
 * 		for i in range(m + 1):             # <<<<<<<<<<<<<<
 * 			if last_column[i].score >= best:
 * 				best_i = i
 */
    __pyx_t_3 = (__pyx_v_m + 1);
    for (__pyx_t_4 = 0; __pyx_t_4 < __pyx_t_3; __pyx_t_4+=1) {
      __pyx_v_i = __pyx_t_4;

      /* "sqt/_helpers.pyx":172
 * 		last_column = &(columns[n*(m+1)])
 * 		for i in range(m + 1):
 * 			if last_column[i].score >= best:             # <<<<<<<<<<<<<<
 * 				best_i = i
 * 				best_j = n
 */
      __pyx_t_2 = (((__pyx_v_last_column[__pyx_v_i]).score >= __pyx_v_best) != 0);
      if (__pyx_t_2) {

        /* "sqt/_helpers.pyx":173
 * 		for i in range(m + 1):
 * 			if last_column[i].score >= best:
 * 				best_i = i             # <<<<<<<<<<<<<<
 * 				best_j = n
 * 				best = last_column[i].score
 */
        __pyx_v_best_i = __pyx_v_i;

        /* "sqt/_helpers.pyx":174
 * 			if last_column[i].score >= best:
 * 				best_i = i
 * 				best_j = n             # <<<<<<<<<<<<<<
 * 				best = last_column[i].score
 * 
 */
        __pyx_v_best_j = __pyx_v_n;

        /* "sqt/_helpers.pyx":175
 * 				best_i = i
 * 				best_j = n
 * 				best = last_column[i].score             # <<<<<<<<<<<<<<
 * 
 * 	# trace back
 */
        __pyx_t_6 = (__pyx_v_last_column[__pyx_v_i]).score;
        __pyx_v_best = __pyx_t_6;
        goto __pyx_L21;
      }
      __pyx_L21:;
    }
    goto __pyx_L18;
  }
  __pyx_L18:;

  /* "sqt/_helpers.pyx":178
 * 
 * 	# trace back
 * 	cdef char* alignment1 = <char*>PyMem_Malloc((m+n+4)*sizeof(char))             # <<<<<<<<<<<<<<
 * 	if not alignment1:
 * 		PyMem_Free(columns)
 */
  __pyx_v_alignment1 = ((char *)PyMem_Malloc((((__pyx_v_m + __pyx_v_n) + 4) * (sizeof(char)))));

  /* "sqt/_helpers.pyx":179
 * 	# trace back
 * 	cdef char* alignment1 = <char*>PyMem_Malloc((m+n+4)*sizeof(char))
 * 	if not alignment1:             # <<<<<<<<<<<<<<
 * 		PyMem_Free(columns)
 * 		raise MemoryError()
 */
  __pyx_t_2 = ((!(__pyx_v_alignment1 != 0)) != 0);
  if (__pyx_t_2) {

    /* "sqt/_helpers.pyx":180
 * 	cdef char* alignment1 = <char*>PyMem_Malloc((m+n+4)*sizeof(char))
 * 	if not alignment1:
 * 		PyMem_Free(columns)             # <<<<<<<<<<<<<<
 * 		raise MemoryError()
 * 	cdef char* alignment2 = <char*>PyMem_Malloc((m+n+4)*sizeof(char))
 */
    PyMem_Free(__pyx_v_columns);

    /* "sqt/_helpers.pyx":181
 * 	if not alignment1:
 * 		PyMem_Free(columns)
 * 		raise MemoryError()             # <<<<<<<<<<<<<<
 * 	cdef char* alignment2 = <char*>PyMem_Malloc((m+n+4)*sizeof(char))
 * 	if not alignment2:
 */
    PyErr_NoMemory(); {__pyx_filename = __pyx_f[0]; __pyx_lineno = 181; __pyx_clineno = __LINE__; goto __pyx_L1_error;}
    goto __pyx_L22;
  }
  __pyx_L22:;

  /* "sqt/_helpers.pyx":182
 * 		PyMem_Free(columns)
 * 		raise MemoryError()
 * 	cdef char* alignment2 = <char*>PyMem_Malloc((m+n+4)*sizeof(char))             # <<<<<<<<<<<<<<
 * 	if not alignment2:
 * 		PyMem_Free(columns)
 */
  __pyx_v_alignment2 = ((char *)PyMem_Malloc((((__pyx_v_m + __pyx_v_n) + 4) * (sizeof(char)))));

  /* "sqt/_helpers.pyx":183
 * 		raise MemoryError()
 * 	cdef char* alignment2 = <char*>PyMem_Malloc((m+n+4)*sizeof(char))
 * 	if not alignment2:             # <<<<<<<<<<<<<<
 * 		PyMem_Free(columns)
 * 		PyMem_Free(alignment2)
 */
  __pyx_t_2 = ((!(__pyx_v_alignment2 != 0)) != 0);
  if (__pyx_t_2) {

    /* "sqt/_helpers.pyx":184
 * 	cdef char* alignment2 = <char*>PyMem_Malloc((m+n+4)*sizeof(char))
 * 	if not alignment2:
 * 		PyMem_Free(columns)             # <<<<<<<<<<<<<<
 * 		PyMem_Free(alignment2)
 * 		raise MemoryError()
 */
    PyMem_Free(__pyx_v_columns);

    /* "sqt/_helpers.pyx":185
 * 	if not alignment2:
 * 		PyMem_Free(columns)
 * 		PyMem_Free(alignment2)             # <<<<<<<<<<<<<<
 * 		raise MemoryError()
 * 
 */
    PyMem_Free(__pyx_v_alignment2);

    /* "sqt/_helpers.pyx":186
 * 		PyMem_Free(columns)
 * 		PyMem_Free(alignment2)
 * 		raise MemoryError()             # <<<<<<<<<<<<<<
 * 
 * 	cdef char* p1 = alignment1
 */
    PyErr_NoMemory(); {__pyx_filename = __pyx_f[0]; __pyx_lineno = 186; __pyx_clineno = __LINE__; goto __pyx_L1_error;}
    goto __pyx_L23;
  }
  __pyx_L23:;

  /* "sqt/_helpers.pyx":188
 * 		raise MemoryError()
 * 
 * 	cdef char* p1 = alignment1             # <<<<<<<<<<<<<<
 * 	cdef char* p2 = alignment2
 * 
 */
  __pyx_v_p1 = __pyx_v_alignment1;

  /* "sqt/_helpers.pyx":189
 * 
 * 	cdef char* p1 = alignment1
 * 	cdef char* p2 = alignment2             # <<<<<<<<<<<<<<
 * 
 * 	i = m
 */
  __pyx_v_p2 = __pyx_v_alignment2;

  /* "sqt/_helpers.pyx":191
 * 	cdef char* p2 = alignment2
 * 
 * 	i = m             # <<<<<<<<<<<<<<
 * 	j = n
 * 
 */
  __pyx_v_i = __pyx_v_m;

  /* "sqt/_helpers.pyx":192
 * 
 * 	i = m
 * 	j = n             # <<<<<<<<<<<<<<
 * 
 * 	# first, walk from the lower right corner to the
 */
  __pyx_v_j = __pyx_v_n;

  /* "sqt/_helpers.pyx":197
 * 	# position where we found the maximum score
 * 
 * 	cdef int errors = 0             # <<<<<<<<<<<<<<
 * 
 * 	cdef int gaps_are_errors  # if gaps are currently errors, this is 1, 0 otherwise
 */
  __pyx_v_errors = 0;

  /* "sqt/_helpers.pyx":200
 * 
 * 	cdef int gaps_are_errors  # if gaps are currently errors, this is 1, 0 otherwise
 * 	gaps_are_errors = 0 if (flags & STOP_WITHIN_SEQ2) else 1             # <<<<<<<<<<<<<<
 * 	if i == best_i:  # we are in the last row
 * 		while j > best_j:
 */
  if (((__pyx_v_flags & 8) != 0)) {
    __pyx_t_3 = 0;
  } else {
    __pyx_t_3 = 1;
  }
  __pyx_v_gaps_are_errors = __pyx_t_3;

  /* "sqt/_helpers.pyx":201
 * 	cdef int gaps_are_errors  # if gaps are currently errors, this is 1, 0 otherwise
 * 	gaps_are_errors = 0 if (flags & STOP_WITHIN_SEQ2) else 1
 * 	if i == best_i:  # we are in the last row             # <<<<<<<<<<<<<<
 * 		while j > best_j:
 * 			p1[0] = GAPCHAR
 */
  __pyx_t_2 = ((__pyx_v_i == __pyx_v_best_i) != 0);
  if (__pyx_t_2) {

    /* "sqt/_helpers.pyx":202
 * 	gaps_are_errors = 0 if (flags & STOP_WITHIN_SEQ2) else 1
 * 	if i == best_i:  # we are in the last row
 * 		while j > best_j:             # <<<<<<<<<<<<<<
 * 			p1[0] = GAPCHAR
 * 			j -= 1
 */
    while (1) {
      __pyx_t_2 = ((__pyx_v_j > __pyx_v_best_j) != 0);
      if (!__pyx_t_2) break;

      /* "sqt/_helpers.pyx":203
 * 	if i == best_i:  # we are in the last row
 * 		while j > best_j:
 * 			p1[0] = GAPCHAR             # <<<<<<<<<<<<<<
 * 			j -= 1
 * 			p2[0] = s2[j]
 */
      (__pyx_v_p1[0]) = '\x00';

      /* "sqt/_helpers.pyx":204
 * 		while j > best_j:
 * 			p1[0] = GAPCHAR
 * 			j -= 1             # <<<<<<<<<<<<<<
 * 			p2[0] = s2[j]
 * 			p1 += 1
 */
      __pyx_v_j = (__pyx_v_j - 1);

      /* "sqt/_helpers.pyx":205
 * 			p1[0] = GAPCHAR
 * 			j -= 1
 * 			p2[0] = s2[j]             # <<<<<<<<<<<<<<
 * 			p1 += 1
 * 			p2 += 1
 */
      (__pyx_v_p2[0]) = (__pyx_v_s2[__pyx_v_j]);

      /* "sqt/_helpers.pyx":206
 * 			j -= 1
 * 			p2[0] = s2[j]
 * 			p1 += 1             # <<<<<<<<<<<<<<
 * 			p2 += 1
 * 			errors += gaps_are_errors
 */
      __pyx_v_p1 = (__pyx_v_p1 + 1);

      /* "sqt/_helpers.pyx":207
 * 			p2[0] = s2[j]
 * 			p1 += 1
 * 			p2 += 1             # <<<<<<<<<<<<<<
 * 			errors += gaps_are_errors
 * 	else:  # we are in the last column
 */
      __pyx_v_p2 = (__pyx_v_p2 + 1);

      /* "sqt/_helpers.pyx":208
 * 			p1 += 1
 * 			p2 += 1
 * 			errors += gaps_are_errors             # <<<<<<<<<<<<<<
 * 	else:  # we are in the last column
 * 		gaps_are_errors = 0 if (flags & STOP_WITHIN_SEQ1) else 1
 */
      __pyx_v_errors = (__pyx_v_errors + __pyx_v_gaps_are_errors);
    }
    goto __pyx_L24;
  }
  /*else*/ {

    /* "sqt/_helpers.pyx":210
 * 			errors += gaps_are_errors
 * 	else:  # we are in the last column
 * 		gaps_are_errors = 0 if (flags & STOP_WITHIN_SEQ1) else 1             # <<<<<<<<<<<<<<
 * 		while i > best_i:
 * 			i -= 1
 */
    if (((__pyx_v_flags & 4) != 0)) {
      __pyx_t_3 = 0;
    } else {
      __pyx_t_3 = 1;
    }
    __pyx_v_gaps_are_errors = __pyx_t_3;

    /* "sqt/_helpers.pyx":211
 * 	else:  # we are in the last column
 * 		gaps_are_errors = 0 if (flags & STOP_WITHIN_SEQ1) else 1
 * 		while i > best_i:             # <<<<<<<<<<<<<<
 * 			i -= 1
 * 			p1[0] = s1[i]
 */
    while (1) {
      __pyx_t_2 = ((__pyx_v_i > __pyx_v_best_i) != 0);
      if (!__pyx_t_2) break;

      /* "sqt/_helpers.pyx":212
 * 		gaps_are_errors = 0 if (flags & STOP_WITHIN_SEQ1) else 1
 * 		while i > best_i:
 * 			i -= 1             # <<<<<<<<<<<<<<
 * 			p1[0] = s1[i]
 * 			p2[0] = GAPCHAR
 */
      __pyx_v_i = (__pyx_v_i - 1);

      /* "sqt/_helpers.pyx":213
 * 		while i > best_i:
 * 			i -= 1
 * 			p1[0] = s1[i]             # <<<<<<<<<<<<<<
 * 			p2[0] = GAPCHAR
 * 			p1 += 1
 */
      (__pyx_v_p1[0]) = (__pyx_v_s1[__pyx_v_i]);

      /* "sqt/_helpers.pyx":214
 * 			i -= 1
 * 			p1[0] = s1[i]
 * 			p2[0] = GAPCHAR             # <<<<<<<<<<<<<<
 * 			p1 += 1
 * 			p2 += 1
 */
      (__pyx_v_p2[0]) = '\x00';

      /* "sqt/_helpers.pyx":215
 * 			p1[0] = s1[i]
 * 			p2[0] = GAPCHAR
 * 			p1 += 1             # <<<<<<<<<<<<<<
 * 			p2 += 1
 * 			errors += gaps_are_errors
 */
      __pyx_v_p1 = (__pyx_v_p1 + 1);

      /* "sqt/_helpers.pyx":216
 * 			p2[0] = GAPCHAR
 * 			p1 += 1
 * 			p2 += 1             # <<<<<<<<<<<<<<
 * 			errors += gaps_are_errors
 * 
 */
      __pyx_v_p2 = (__pyx_v_p2 + 1);

      /* "sqt/_helpers.pyx":217
 * 			p1 += 1
 * 			p2 += 1
 * 			errors += gaps_are_errors             # <<<<<<<<<<<<<<
 * 
 * 	assert i == best_i and j == best_j
 */
      __pyx_v_errors = (__pyx_v_errors + __pyx_v_gaps_are_errors);
    }
  }
  __pyx_L24:;

  /* "sqt/_helpers.pyx":219
 * 			errors += gaps_are_errors
 * 
 * 	assert i == best_i and j == best_j             # <<<<<<<<<<<<<<
 * 
 * 	# the actual backtracing
 */
  #ifndef CYTHON_WITHOUT_ASSERTIONS
  __pyx_t_2 = ((__pyx_v_i == __pyx_v_best_i) != 0);
  if (__pyx_t_2) {
    __pyx_t_8 = ((__pyx_v_j == __pyx_v_best_j) != 0);
    __pyx_t_9 = __pyx_t_8;
  } else {
    __pyx_t_9 = __pyx_t_2;
  }
  if (unlikely(!__pyx_t_9)) {
    PyErr_SetNone(PyExc_AssertionError);
    {__pyx_filename = __pyx_f[0]; __pyx_lineno = 219; __pyx_clineno = __LINE__; goto __pyx_L1_error;}
  }
  #endif

  /* "sqt/_helpers.pyx":225
 * 	# and this is undone afterwards.
 * 	cdef int direction
 * 	while i > 0 and j > 0:             # <<<<<<<<<<<<<<
 * 		direction = columns[j*(m+1)+i].backtrace
 * 		if direction == DIAG:
 */
  while (1) {
    __pyx_t_9 = ((__pyx_v_i > 0) != 0);
    if (__pyx_t_9) {
      __pyx_t_2 = ((__pyx_v_j > 0) != 0);
      __pyx_t_8 = __pyx_t_2;
    } else {
      __pyx_t_8 = __pyx_t_9;
    }
    if (!__pyx_t_8) break;

    /* "sqt/_helpers.pyx":226
 * 	cdef int direction
 * 	while i > 0 and j > 0:
 * 		direction = columns[j*(m+1)+i].backtrace             # <<<<<<<<<<<<<<
 * 		if direction == DIAG:
 * 			i -= 1
 */
    __pyx_t_4 = (__pyx_v_columns[((__pyx_v_j * (__pyx_v_m + 1)) + __pyx_v_i)]).backtrace;
    __pyx_v_direction = __pyx_t_4;

    /* "sqt/_helpers.pyx":227
 * 	while i > 0 and j > 0:
 * 		direction = columns[j*(m+1)+i].backtrace
 * 		if direction == DIAG:             # <<<<<<<<<<<<<<
 * 			i -= 1
 * 			j -= 1
 */
    __pyx_t_8 = ((__pyx_v_direction == __pyx_v_DIAG) != 0);
    if (__pyx_t_8) {

      /* "sqt/_helpers.pyx":228
 * 		direction = columns[j*(m+1)+i].backtrace
 * 		if direction == DIAG:
 * 			i -= 1             # <<<<<<<<<<<<<<
 * 			j -= 1
 * 			if s1[i] != s2[j]:
 */
      __pyx_v_i = (__pyx_v_i - 1);

      /* "sqt/_helpers.pyx":229
 * 		if direction == DIAG:
 * 			i -= 1
 * 			j -= 1             # <<<<<<<<<<<<<<
 * 			if s1[i] != s2[j]:
 * 				errors += 1
 */
      __pyx_v_j = (__pyx_v_j - 1);

      /* "sqt/_helpers.pyx":230
 * 			i -= 1
 * 			j -= 1
 * 			if s1[i] != s2[j]:             # <<<<<<<<<<<<<<
 * 				errors += 1
 * 			p1[0] = s1[i]
 */
      __pyx_t_8 = (((__pyx_v_s1[__pyx_v_i]) != (__pyx_v_s2[__pyx_v_j])) != 0);
      if (__pyx_t_8) {

        /* "sqt/_helpers.pyx":231
 * 			j -= 1
 * 			if s1[i] != s2[j]:
 * 				errors += 1             # <<<<<<<<<<<<<<
 * 			p1[0] = s1[i]
 * 			p2[0] = s2[j]
 */
        __pyx_v_errors = (__pyx_v_errors + 1);
        goto __pyx_L32;
      }
      __pyx_L32:;

      /* "sqt/_helpers.pyx":232
 * 			if s1[i] != s2[j]:
 * 				errors += 1
 * 			p1[0] = s1[i]             # <<<<<<<<<<<<<<
 * 			p2[0] = s2[j]
 * 			p1 += 1
 */
      (__pyx_v_p1[0]) = (__pyx_v_s1[__pyx_v_i]);

      /* "sqt/_helpers.pyx":233
 * 				errors += 1
 * 			p1[0] = s1[i]
 * 			p2[0] = s2[j]             # <<<<<<<<<<<<<<
 * 			p1 += 1
 * 			p2 += 1
 */
      (__pyx_v_p2[0]) = (__pyx_v_s2[__pyx_v_j]);

      /* "sqt/_helpers.pyx":234
 * 			p1[0] = s1[i]
 * 			p2[0] = s2[j]
 * 			p1 += 1             # <<<<<<<<<<<<<<
 * 			p2 += 1
 * 		elif direction == LEFT:
 */
      __pyx_v_p1 = (__pyx_v_p1 + 1);

      /* "sqt/_helpers.pyx":235
 * 			p2[0] = s2[j]
 * 			p1 += 1
 * 			p2 += 1             # <<<<<<<<<<<<<<
 * 		elif direction == LEFT:
 * 			errors += 1
 */
      __pyx_v_p2 = (__pyx_v_p2 + 1);
      goto __pyx_L31;
    }

    /* "sqt/_helpers.pyx":236
 * 			p1 += 1
 * 			p2 += 1
 * 		elif direction == LEFT:             # <<<<<<<<<<<<<<
 * 			errors += 1
 * 			p1[0] = GAPCHAR
 */
    __pyx_t_8 = ((__pyx_v_direction == __pyx_v_LEFT) != 0);
    if (__pyx_t_8) {

      /* "sqt/_helpers.pyx":237
 * 			p2 += 1
 * 		elif direction == LEFT:
 * 			errors += 1             # <<<<<<<<<<<<<<
 * 			p1[0] = GAPCHAR
 * 			j -= 1
 */
      __pyx_v_errors = (__pyx_v_errors + 1);

      /* "sqt/_helpers.pyx":238
 * 		elif direction == LEFT:
 * 			errors += 1
 * 			p1[0] = GAPCHAR             # <<<<<<<<<<<<<<
 * 			j -= 1
 * 			p2[0] = s2[j]
 */
      (__pyx_v_p1[0]) = '\x00';

      /* "sqt/_helpers.pyx":239
 * 			errors += 1
 * 			p1[0] = GAPCHAR
 * 			j -= 1             # <<<<<<<<<<<<<<
 * 			p2[0] = s2[j]
 * 			p1 += 1
 */
      __pyx_v_j = (__pyx_v_j - 1);

      /* "sqt/_helpers.pyx":240
 * 			p1[0] = GAPCHAR
 * 			j -= 1
 * 			p2[0] = s2[j]             # <<<<<<<<<<<<<<
 * 			p1 += 1
 * 			p2 += 1
 */
      (__pyx_v_p2[0]) = (__pyx_v_s2[__pyx_v_j]);

      /* "sqt/_helpers.pyx":241
 * 			j -= 1
 * 			p2[0] = s2[j]
 * 			p1 += 1             # <<<<<<<<<<<<<<
 * 			p2 += 1
 * 		elif direction == UP:
 */
      __pyx_v_p1 = (__pyx_v_p1 + 1);

      /* "sqt/_helpers.pyx":242
 * 			p2[0] = s2[j]
 * 			p1 += 1
 * 			p2 += 1             # <<<<<<<<<<<<<<
 * 		elif direction == UP:
 * 			i -= 1
 */
      __pyx_v_p2 = (__pyx_v_p2 + 1);
      goto __pyx_L31;
    }

    /* "sqt/_helpers.pyx":243
 * 			p1 += 1
 * 			p2 += 1
 * 		elif direction == UP:             # <<<<<<<<<<<<<<
 * 			i -= 1
 * 			p1[0] = s1[i]
 */
    __pyx_t_8 = ((__pyx_v_direction == __pyx_v_UP) != 0);
    if (__pyx_t_8) {

      /* "sqt/_helpers.pyx":244
 * 			p2 += 1
 * 		elif direction == UP:
 * 			i -= 1             # <<<<<<<<<<<<<<
 * 			p1[0] = s1[i]
 * 			p2[0] = GAPCHAR
 */
      __pyx_v_i = (__pyx_v_i - 1);

      /* "sqt/_helpers.pyx":245
 * 		elif direction == UP:
 * 			i -= 1
 * 			p1[0] = s1[i]             # <<<<<<<<<<<<<<
 * 			p2[0] = GAPCHAR
 * 			errors += 1
 */
      (__pyx_v_p1[0]) = (__pyx_v_s1[__pyx_v_i]);

      /* "sqt/_helpers.pyx":246
 * 			i -= 1
 * 			p1[0] = s1[i]
 * 			p2[0] = GAPCHAR             # <<<<<<<<<<<<<<
 * 			errors += 1
 * 			p1 += 1
 */
      (__pyx_v_p2[0]) = '\x00';

      /* "sqt/_helpers.pyx":247
 * 			p1[0] = s1[i]
 * 			p2[0] = GAPCHAR
 * 			errors += 1             # <<<<<<<<<<<<<<
 * 			p1 += 1
 * 			p2 += 1
 */
      __pyx_v_errors = (__pyx_v_errors + 1);

      /* "sqt/_helpers.pyx":248
 * 			p2[0] = GAPCHAR
 * 			errors += 1
 * 			p1 += 1             # <<<<<<<<<<<<<<
 * 			p2 += 1
 * 	PyMem_Free(columns)
 */
      __pyx_v_p1 = (__pyx_v_p1 + 1);

      /* "sqt/_helpers.pyx":249
 * 			errors += 1
 * 			p1 += 1
 * 			p2 += 1             # <<<<<<<<<<<<<<
 * 	PyMem_Free(columns)
 * 
 */
      __pyx_v_p2 = (__pyx_v_p2 + 1);
      goto __pyx_L31;
    }
    __pyx_L31:;
  }

  /* "sqt/_helpers.pyx":250
 * 			p1 += 1
 * 			p2 += 1
 * 	PyMem_Free(columns)             # <<<<<<<<<<<<<<
 * 
 * 	cdef int start1 = i if (flags & START_WITHIN_SEQ1) else 0
 */
  PyMem_Free(__pyx_v_columns);

  /* "sqt/_helpers.pyx":252
 * 	PyMem_Free(columns)
 * 
 * 	cdef int start1 = i if (flags & START_WITHIN_SEQ1) else 0             # <<<<<<<<<<<<<<
 * 	cdef int start2 = j if (flags & START_WITHIN_SEQ2) else 0
 * 
 */
  if (((__pyx_v_flags & 1) != 0)) {
    __pyx_t_3 = __pyx_v_i;
  } else {
    __pyx_t_3 = 0;
  }
  __pyx_v_start1 = __pyx_t_3;

  /* "sqt/_helpers.pyx":253
 * 
 * 	cdef int start1 = i if (flags & START_WITHIN_SEQ1) else 0
 * 	cdef int start2 = j if (flags & START_WITHIN_SEQ2) else 0             # <<<<<<<<<<<<<<
 * 
 * 	errors += (i - start1) + (j - start2)
 */
  if (((__pyx_v_flags & 2) != 0)) {
    __pyx_t_3 = __pyx_v_j;
  } else {
    __pyx_t_3 = 0;
  }
  __pyx_v_start2 = __pyx_t_3;

  /* "sqt/_helpers.pyx":255
 * 	cdef int start2 = j if (flags & START_WITHIN_SEQ2) else 0
 * 
 * 	errors += (i - start1) + (j - start2)             # <<<<<<<<<<<<<<
 * 
 * 	while j > 0:
 */
  __pyx_v_errors = (__pyx_v_errors + ((__pyx_v_i - __pyx_v_start1) + (__pyx_v_j - __pyx_v_start2)));

  /* "sqt/_helpers.pyx":257
 * 	errors += (i - start1) + (j - start2)
 * 
 * 	while j > 0:             # <<<<<<<<<<<<<<
 * 		p1[0] = GAPCHAR
 * 		j -= 1
 */
  while (1) {
    __pyx_t_8 = ((__pyx_v_j > 0) != 0);
    if (!__pyx_t_8) break;

    /* "sqt/_helpers.pyx":258
 * 
 * 	while j > 0:
 * 		p1[0] = GAPCHAR             # <<<<<<<<<<<<<<
 * 		j -= 1
 * 		p2[0] = s2[j]
 */
    (__pyx_v_p1[0]) = '\x00';

    /* "sqt/_helpers.pyx":259
 * 	while j > 0:
 * 		p1[0] = GAPCHAR
 * 		j -= 1             # <<<<<<<<<<<<<<
 * 		p2[0] = s2[j]
 * 		p1 += 1
 */
    __pyx_v_j = (__pyx_v_j - 1);

    /* "sqt/_helpers.pyx":260
 * 		p1[0] = GAPCHAR
 * 		j -= 1
 * 		p2[0] = s2[j]             # <<<<<<<<<<<<<<
 * 		p1 += 1
 * 		p2 += 1
 */
    (__pyx_v_p2[0]) = (__pyx_v_s2[__pyx_v_j]);

    /* "sqt/_helpers.pyx":261
 * 		j -= 1
 * 		p2[0] = s2[j]
 * 		p1 += 1             # <<<<<<<<<<<<<<
 * 		p2 += 1
 * 	while i > 0:
 */
    __pyx_v_p1 = (__pyx_v_p1 + 1);

    /* "sqt/_helpers.pyx":262
 * 		p2[0] = s2[j]
 * 		p1 += 1
 * 		p2 += 1             # <<<<<<<<<<<<<<
 * 	while i > 0:
 * 		i -= 1
 */
    __pyx_v_p2 = (__pyx_v_p2 + 1);
  }

  /* "sqt/_helpers.pyx":263
 * 		p1 += 1
 * 		p2 += 1
 * 	while i > 0:             # <<<<<<<<<<<<<<
 * 		i -= 1
 * 		p1[0] = s1[i]
 */
  while (1) {
    __pyx_t_8 = ((__pyx_v_i > 0) != 0);
    if (!__pyx_t_8) break;

    /* "sqt/_helpers.pyx":264
 * 		p2 += 1
 * 	while i > 0:
 * 		i -= 1             # <<<<<<<<<<<<<<
 * 		p1[0] = s1[i]
 * 		p2[0] = GAPCHAR
 */
    __pyx_v_i = (__pyx_v_i - 1);

    /* "sqt/_helpers.pyx":265
 * 	while i > 0:
 * 		i -= 1
 * 		p1[0] = s1[i]             # <<<<<<<<<<<<<<
 * 		p2[0] = GAPCHAR
 * 		p1 += 1
 */
    (__pyx_v_p1[0]) = (__pyx_v_s1[__pyx_v_i]);

    /* "sqt/_helpers.pyx":266
 * 		i -= 1
 * 		p1[0] = s1[i]
 * 		p2[0] = GAPCHAR             # <<<<<<<<<<<<<<
 * 		p1 += 1
 * 		p2 += 1
 */
    (__pyx_v_p2[0]) = '\x00';

    /* "sqt/_helpers.pyx":267
 * 		p1[0] = s1[i]
 * 		p2[0] = GAPCHAR
 * 		p1 += 1             # <<<<<<<<<<<<<<
 * 		p2 += 1
 * 	assert i == 0 and j == 0
 */
    __pyx_v_p1 = (__pyx_v_p1 + 1);

    /* "sqt/_helpers.pyx":268
 * 		p2[0] = GAPCHAR
 * 		p1 += 1
 * 		p2 += 1             # <<<<<<<<<<<<<<
 * 	assert i == 0 and j == 0
 * 
 */
    __pyx_v_p2 = (__pyx_v_p2 + 1);
  }

  /* "sqt/_helpers.pyx":269
 * 		p1 += 1
 * 		p2 += 1
 * 	assert i == 0 and j == 0             # <<<<<<<<<<<<<<
 * 
 * 	align1 = alignment1[:(p1-alignment1)]
 */
  #ifndef CYTHON_WITHOUT_ASSERTIONS
  __pyx_t_8 = ((__pyx_v_i == 0) != 0);
  if (__pyx_t_8) {
    __pyx_t_9 = ((__pyx_v_j == 0) != 0);
    __pyx_t_2 = __pyx_t_9;
  } else {
    __pyx_t_2 = __pyx_t_8;
  }
  if (unlikely(!__pyx_t_2)) {
    PyErr_SetNone(PyExc_AssertionError);
    {__pyx_filename = __pyx_f[0]; __pyx_lineno = 269; __pyx_clineno = __LINE__; goto __pyx_L1_error;}
  }
  #endif

  /* "sqt/_helpers.pyx":271
 * 	assert i == 0 and j == 0
 * 
 * 	align1 = alignment1[:(p1-alignment1)]             # <<<<<<<<<<<<<<
 * 	align2 = alignment2[:(p2-alignment2)]
 * 
 */
  __pyx_t_10 = __Pyx_PyBytes_FromStringAndSize(__pyx_v_alignment1 + 0, (__pyx_v_p1 - __pyx_v_alignment1) - 0); if (unlikely(!__pyx_t_10)) {__pyx_filename = __pyx_f[0]; __pyx_lineno = 271; __pyx_clineno = __LINE__; goto __pyx_L1_error;}
  __Pyx_GOTREF(((PyObject *)__pyx_t_10));
  __pyx_v_align1 = ((PyObject*)__pyx_t_10);
  __pyx_t_10 = 0;

  /* "sqt/_helpers.pyx":272
 * 
 * 	align1 = alignment1[:(p1-alignment1)]
 * 	align2 = alignment2[:(p2-alignment2)]             # <<<<<<<<<<<<<<
 * 
 * 	align1 = align1[::-1]
 */
  __pyx_t_10 = __Pyx_PyBytes_FromStringAndSize(__pyx_v_alignment2 + 0, (__pyx_v_p2 - __pyx_v_alignment2) - 0); if (unlikely(!__pyx_t_10)) {__pyx_filename = __pyx_f[0]; __pyx_lineno = 272; __pyx_clineno = __LINE__; goto __pyx_L1_error;}
  __Pyx_GOTREF(((PyObject *)__pyx_t_10));
  __pyx_v_align2 = ((PyObject*)__pyx_t_10);
  __pyx_t_10 = 0;

  /* "sqt/_helpers.pyx":274
 * 	align2 = alignment2[:(p2-alignment2)]
 * 
 * 	align1 = align1[::-1]             # <<<<<<<<<<<<<<
 * 	align2 = align2[::-1]
 * 
 */
  __pyx_t_10 = PyObject_GetItem(((PyObject *)__pyx_v_align1), __pyx_k_slice_1); if (!__pyx_t_10) {__pyx_filename = __pyx_f[0]; __pyx_lineno = 274; __pyx_clineno = __LINE__; goto __pyx_L1_error;}
  __Pyx_GOTREF(((PyObject *)__pyx_t_10));
  __Pyx_DECREF(((PyObject *)__pyx_v_align1));
  __pyx_v_align1 = ((PyObject*)__pyx_t_10);
  __pyx_t_10 = 0;

  /* "sqt/_helpers.pyx":275
 * 
 * 	align1 = align1[::-1]
 * 	align2 = align2[::-1]             # <<<<<<<<<<<<<<
 * 
 * 	PyMem_Free(alignment1)
 */
  __pyx_t_10 = PyObject_GetItem(((PyObject *)__pyx_v_align2), __pyx_k_slice_2); if (!__pyx_t_10) {__pyx_filename = __pyx_f[0]; __pyx_lineno = 275; __pyx_clineno = __LINE__; goto __pyx_L1_error;}
  __Pyx_GOTREF(((PyObject *)__pyx_t_10));
  __Pyx_DECREF(((PyObject *)__pyx_v_align2));
  __pyx_v_align2 = ((PyObject*)__pyx_t_10);
  __pyx_t_10 = 0;

  /* "sqt/_helpers.pyx":277
 * 	align2 = align2[::-1]
 * 
 * 	PyMem_Free(alignment1)             # <<<<<<<<<<<<<<
 * 	PyMem_Free(alignment2)
 * 
 */
  PyMem_Free(__pyx_v_alignment1);

  /* "sqt/_helpers.pyx":278
 * 
 * 	PyMem_Free(alignment1)
 * 	PyMem_Free(alignment2)             # <<<<<<<<<<<<<<
 * 
 * 	return (align1, align2, start1, best_i, start2, best_j, errors)
 */
  PyMem_Free(__pyx_v_alignment2);

  /* "sqt/_helpers.pyx":280
 * 	PyMem_Free(alignment2)
 * 
 * 	return (align1, align2, start1, best_i, start2, best_j, errors)             # <<<<<<<<<<<<<<
 * 
 * 
 */
  __Pyx_XDECREF(__pyx_r);
  __pyx_t_10 = PyInt_FromLong(__pyx_v_start1); if (unlikely(!__pyx_t_10)) {__pyx_filename = __pyx_f[0]; __pyx_lineno = 280; __pyx_clineno = __LINE__; goto __pyx_L1_error;}
  __Pyx_GOTREF(__pyx_t_10);
  __pyx_t_11 = PyInt_FromLong(__pyx_v_best_i); if (unlikely(!__pyx_t_11)) {__pyx_filename = __pyx_f[0]; __pyx_lineno = 280; __pyx_clineno = __LINE__; goto __pyx_L1_error;}
  __Pyx_GOTREF(__pyx_t_11);
  __pyx_t_12 = PyInt_FromLong(__pyx_v_start2); if (unlikely(!__pyx_t_12)) {__pyx_filename = __pyx_f[0]; __pyx_lineno = 280; __pyx_clineno = __LINE__; goto __pyx_L1_error;}
  __Pyx_GOTREF(__pyx_t_12);
  __pyx_t_13 = PyInt_FromLong(__pyx_v_best_j); if (unlikely(!__pyx_t_13)) {__pyx_filename = __pyx_f[0]; __pyx_lineno = 280; __pyx_clineno = __LINE__; goto __pyx_L1_error;}
  __Pyx_GOTREF(__pyx_t_13);
  __pyx_t_14 = PyInt_FromLong(__pyx_v_errors); if (unlikely(!__pyx_t_14)) {__pyx_filename = __pyx_f[0]; __pyx_lineno = 280; __pyx_clineno = __LINE__; goto __pyx_L1_error;}
  __Pyx_GOTREF(__pyx_t_14);
  __pyx_t_15 = PyTuple_New(7); if (unlikely(!__pyx_t_15)) {__pyx_filename = __pyx_f[0]; __pyx_lineno = 280; __pyx_clineno = __LINE__; goto __pyx_L1_error;}
  __Pyx_GOTREF(__pyx_t_15);
  __Pyx_INCREF(((PyObject *)__pyx_v_align1));
  PyTuple_SET_ITEM(__pyx_t_15, 0, ((PyObject *)__pyx_v_align1));
  __Pyx_GIVEREF(((PyObject *)__pyx_v_align1));
  __Pyx_INCREF(((PyObject *)__pyx_v_align2));
  PyTuple_SET_ITEM(__pyx_t_15, 1, ((PyObject *)__pyx_v_align2));
  __Pyx_GIVEREF(((PyObject *)__pyx_v_align2));
  PyTuple_SET_ITEM(__pyx_t_15, 2, __pyx_t_10);
  __Pyx_GIVEREF(__pyx_t_10);
  PyTuple_SET_ITEM(__pyx_t_15, 3, __pyx_t_11);
  __Pyx_GIVEREF(__pyx_t_11);
  PyTuple_SET_ITEM(__pyx_t_15, 4, __pyx_t_12);
  __Pyx_GIVEREF(__pyx_t_12);
  PyTuple_SET_ITEM(__pyx_t_15, 5, __pyx_t_13);
  __Pyx_GIVEREF(__pyx_t_13);
  PyTuple_SET_ITEM(__pyx_t_15, 6, __pyx_t_14);
  __Pyx_GIVEREF(__pyx_t_14);
  __pyx_t_10 = 0;
  __pyx_t_11 = 0;
  __pyx_t_12 = 0;
  __pyx_t_13 = 0;
  __pyx_t_14 = 0;
  __pyx_r = ((PyObject *)__pyx_t_15);
  __pyx_t_15 = 0;
  goto __pyx_L0;

  __pyx_r = Py_None; __Pyx_INCREF(Py_None);
  goto __pyx_L0;
  __pyx_L1_error:;
  __Pyx_XDECREF(__pyx_t_10);
  __Pyx_XDECREF(__pyx_t_11);
  __Pyx_XDECREF(__pyx_t_12);
  __Pyx_XDECREF(__pyx_t_13);
  __Pyx_XDECREF(__pyx_t_14);
  __Pyx_XDECREF(__pyx_t_15);
  __Pyx_AddTraceback("sqt._helpers.globalalign", __pyx_clineno, __pyx_lineno, __pyx_filename);
  __pyx_r = NULL;
  __pyx_L0:;
  __Pyx_XDECREF(__pyx_v_align1);
  __Pyx_XDECREF(__pyx_v_align2);
  __Pyx_XGIVEREF(__pyx_r);
  __Pyx_RefNannyFinishContext();
  return __pyx_r;
}

/* Python wrapper */
static PyObject *__pyx_pw_3sqt_8_helpers_5byte_frequencies(PyObject *__pyx_self, PyObject *__pyx_v_s); /*proto*/
static char __pyx_doc_3sqt_8_helpers_4byte_frequencies[] = "Faster replacement for collections.Counter(s) for the case when s is a bytes object.\n\n\tSpeed advantage depends on the length of the bytes object. When the length is less\n\tthan 10, speedup is at least 2x. For length 100, speedup is 14x. For length 1000, speedup is\n\tapprox 100x.\n\t";
static PyMethodDef __pyx_mdef_3sqt_8_helpers_5byte_frequencies = {__Pyx_NAMESTR("byte_frequencies"), (PyCFunction)__pyx_pw_3sqt_8_helpers_5byte_frequencies, METH_O, __Pyx_DOCSTR(__pyx_doc_3sqt_8_helpers_4byte_frequencies)};
static PyObject *__pyx_pw_3sqt_8_helpers_5byte_frequencies(PyObject *__pyx_self, PyObject *__pyx_v_s) {
  CYTHON_UNUSED int __pyx_lineno = 0;
  CYTHON_UNUSED const char *__pyx_filename = NULL;
  CYTHON_UNUSED int __pyx_clineno = 0;
  PyObject *__pyx_r = 0;
  __Pyx_RefNannyDeclarations
  __Pyx_RefNannySetupContext("byte_frequencies (wrapper)", 0);
  if (unlikely(!__Pyx_ArgTypeTest(((PyObject *)__pyx_v_s), (&PyBytes_Type), 1, "s", 1))) {__pyx_filename = __pyx_f[0]; __pyx_lineno = 283; __pyx_clineno = __LINE__; goto __pyx_L1_error;}
  __pyx_r = __pyx_pf_3sqt_8_helpers_4byte_frequencies(__pyx_self, ((PyObject*)__pyx_v_s));
  goto __pyx_L0;
  __pyx_L1_error:;
  __pyx_r = NULL;
  __pyx_L0:;
  __Pyx_RefNannyFinishContext();
  return __pyx_r;
}

/* "sqt/_helpers.pyx":283
 * 
 * 
 * def byte_frequencies(bytes s):             # <<<<<<<<<<<<<<
 * 	"""Faster replacement for collections.Counter(s) for the case when s is a bytes object.
 * 
 */

static PyObject *__pyx_pf_3sqt_8_helpers_4byte_frequencies(CYTHON_UNUSED PyObject *__pyx_self, PyObject *__pyx_v_s) {
  int __pyx_v_frequencies[256];
  int __pyx_v_i;
  unsigned char __pyx_v_c;
  PyObject *__pyx_v_counter = NULL;
  PyObject *__pyx_r = NULL;
  __Pyx_RefNannyDeclarations
  int __pyx_t_1;
  PyObject *__pyx_t_2 = NULL;
  char *__pyx_t_3;
  char *__pyx_t_4;
  char *__pyx_t_5;
  char *__pyx_t_6;
  unsigned char __pyx_t_7;
  PyObject *__pyx_t_8 = NULL;
  PyObject *__pyx_t_9 = NULL;
  int __pyx_t_10;
  int __pyx_lineno = 0;
  const char *__pyx_filename = NULL;
  int __pyx_clineno = 0;
  __Pyx_RefNannySetupContext("byte_frequencies", 0);

  /* "sqt/_helpers.pyx":293
 * 	cdef int i
 * 	cdef unsigned char c
 * 	for i in range(256):             # <<<<<<<<<<<<<<
 * 		frequencies[i] = 0
 * 	for c in s:
 */
  for (__pyx_t_1 = 0; __pyx_t_1 < 256; __pyx_t_1+=1) {
    __pyx_v_i = __pyx_t_1;

    /* "sqt/_helpers.pyx":294
 * 	cdef unsigned char c
 * 	for i in range(256):
 * 		frequencies[i] = 0             # <<<<<<<<<<<<<<
 * 	for c in s:
 * 		frequencies[c] += 1
 */
    (__pyx_v_frequencies[__pyx_v_i]) = 0;
  }

  /* "sqt/_helpers.pyx":295
 * 	for i in range(256):
 * 		frequencies[i] = 0
 * 	for c in s:             # <<<<<<<<<<<<<<
 * 		frequencies[c] += 1
 * 	counter = Counter()
 */
  if (unlikely(((PyObject *)__pyx_v_s) == Py_None)) {
    PyErr_SetString(PyExc_TypeError, "'NoneType' is not iterable");
    {__pyx_filename = __pyx_f[0]; __pyx_lineno = 295; __pyx_clineno = __LINE__; goto __pyx_L1_error;}
  }
  __Pyx_INCREF(((PyObject *)__pyx_v_s));
  __pyx_t_2 = __pyx_v_s;
  __pyx_t_4 = PyBytes_AS_STRING(__pyx_t_2);
  __pyx_t_5 = (__pyx_t_4 + PyBytes_GET_SIZE(__pyx_t_2));
  for (__pyx_t_6 = __pyx_t_4; __pyx_t_6 < __pyx_t_5; __pyx_t_6++) {
    __pyx_t_3 = __pyx_t_6;
    __pyx_v_c = (__pyx_t_3[0]);

    /* "sqt/_helpers.pyx":296
 * 		frequencies[i] = 0
 * 	for c in s:
 * 		frequencies[c] += 1             # <<<<<<<<<<<<<<
 * 	counter = Counter()
 * 	for i in range(256):
 */
    __pyx_t_7 = __pyx_v_c;
    (__pyx_v_frequencies[__pyx_t_7]) = ((__pyx_v_frequencies[__pyx_t_7]) + 1);
  }
  __Pyx_DECREF(((PyObject *)__pyx_t_2)); __pyx_t_2 = 0;

  /* "sqt/_helpers.pyx":297
 * 	for c in s:
 * 		frequencies[c] += 1
 * 	counter = Counter()             # <<<<<<<<<<<<<<
 * 	for i in range(256):
 * 		if frequencies[i] > 0:
 */
  __pyx_t_8 = __Pyx_GetModuleGlobalName(__pyx_n_s__Counter); if (unlikely(!__pyx_t_8)) {__pyx_filename = __pyx_f[0]; __pyx_lineno = 297; __pyx_clineno = __LINE__; goto __pyx_L1_error;}
  __Pyx_GOTREF(__pyx_t_8);
  __pyx_t_9 = PyObject_Call(__pyx_t_8, ((PyObject *)__pyx_empty_tuple), NULL); if (unlikely(!__pyx_t_9)) {__pyx_filename = __pyx_f[0]; __pyx_lineno = 297; __pyx_clineno = __LINE__; goto __pyx_L1_error;}
  __Pyx_GOTREF(__pyx_t_9);
  __Pyx_DECREF(__pyx_t_8); __pyx_t_8 = 0;
  __pyx_v_counter = __pyx_t_9;
  __pyx_t_9 = 0;

  /* "sqt/_helpers.pyx":298
 * 		frequencies[c] += 1
 * 	counter = Counter()
 * 	for i in range(256):             # <<<<<<<<<<<<<<
 * 		if frequencies[i] > 0:
 * 			counter[i] = frequencies[i]
 */
  for (__pyx_t_1 = 0; __pyx_t_1 < 256; __pyx_t_1+=1) {
    __pyx_v_i = __pyx_t_1;

    /* "sqt/_helpers.pyx":299
 * 	counter = Counter()
 * 	for i in range(256):
 * 		if frequencies[i] > 0:             # <<<<<<<<<<<<<<
 * 			counter[i] = frequencies[i]
 * 	return counter
 */
    __pyx_t_10 = (((__pyx_v_frequencies[__pyx_v_i]) > 0) != 0);
    if (__pyx_t_10) {

      /* "sqt/_helpers.pyx":300
 * 	for i in range(256):
 * 		if frequencies[i] > 0:
 * 			counter[i] = frequencies[i]             # <<<<<<<<<<<<<<
 * 	return counter
 */
      __pyx_t_9 = PyInt_FromLong((__pyx_v_frequencies[__pyx_v_i])); if (unlikely(!__pyx_t_9)) {__pyx_filename = __pyx_f[0]; __pyx_lineno = 300; __pyx_clineno = __LINE__; goto __pyx_L1_error;}
      __Pyx_GOTREF(__pyx_t_9);
      if (__Pyx_SetItemInt(__pyx_v_counter, __pyx_v_i, __pyx_t_9, sizeof(int), PyInt_FromLong, 0, 1, 1) < 0) {__pyx_filename = __pyx_f[0]; __pyx_lineno = 300; __pyx_clineno = __LINE__; goto __pyx_L1_error;}
      __Pyx_DECREF(__pyx_t_9); __pyx_t_9 = 0;
      goto __pyx_L9;
    }
    __pyx_L9:;
  }

  /* "sqt/_helpers.pyx":301
 * 		if frequencies[i] > 0:
 * 			counter[i] = frequencies[i]
 * 	return counter             # <<<<<<<<<<<<<<
 */
  __Pyx_XDECREF(__pyx_r);
  __Pyx_INCREF(__pyx_v_counter);
  __pyx_r = __pyx_v_counter;
  goto __pyx_L0;

  __pyx_r = Py_None; __Pyx_INCREF(Py_None);
  goto __pyx_L0;
  __pyx_L1_error:;
  __Pyx_XDECREF(((PyObject *)__pyx_t_2));
  __Pyx_XDECREF(__pyx_t_8);
  __Pyx_XDECREF(__pyx_t_9);
  __Pyx_AddTraceback("sqt._helpers.byte_frequencies", __pyx_clineno, __pyx_lineno, __pyx_filename);
  __pyx_r = NULL;
  __pyx_L0:;
  __Pyx_XDECREF(__pyx_v_counter);
  __Pyx_XGIVEREF(__pyx_r);
  __Pyx_RefNannyFinishContext();
  return __pyx_r;
}

static PyMethodDef __pyx_methods[] = {
  {0, 0, 0, 0}
};

#if PY_MAJOR_VERSION >= 3
static struct PyModuleDef __pyx_moduledef = {
  #if PY_VERSION_HEX < 0x03020000
    { PyObject_HEAD_INIT(NULL) NULL, 0, NULL },
  #else
    PyModuleDef_HEAD_INIT,
  #endif
    __Pyx_NAMESTR("_helpers"),
    0, /* m_doc */
    -1, /* m_size */
    __pyx_methods /* m_methods */,
    NULL, /* m_reload */
    NULL, /* m_traverse */
    NULL, /* m_clear */
    NULL /* m_free */
};
#endif

static __Pyx_StringTabEntry __pyx_string_tab[] = {
  {&__pyx_kp_s_5, __pyx_k_5, sizeof(__pyx_k_5), 0, 0, 1, 0},
  {&__pyx_n_s_6, __pyx_k_6, sizeof(__pyx_k_6), 0, 0, 1, 1},
  {&__pyx_n_s__Counter, __pyx_k__Counter, sizeof(__pyx_k__Counter), 0, 0, 1, 1},
  {&__pyx_n_s__DIAG, __pyx_k__DIAG, sizeof(__pyx_k__DIAG), 0, 0, 1, 1},
  {&__pyx_n_s__LEFT, __pyx_k__LEFT, sizeof(__pyx_k__LEFT), 0, 0, 1, 1},
  {&__pyx_n_s__MemoryError, __pyx_k__MemoryError, sizeof(__pyx_k__MemoryError), 0, 0, 1, 1},
  {&__pyx_n_s__UP, __pyx_k__UP, sizeof(__pyx_k__UP), 0, 0, 1, 1},
  {&__pyx_n_s____import__, __pyx_k____import__, sizeof(__pyx_k____import__), 0, 0, 1, 1},
  {&__pyx_n_s____main__, __pyx_k____main__, sizeof(__pyx_k____main__), 0, 0, 1, 1},
  {&__pyx_n_s____test__, __pyx_k____test__, sizeof(__pyx_k____test__), 0, 0, 1, 1},
  {&__pyx_n_s__align1, __pyx_k__align1, sizeof(__pyx_k__align1), 0, 0, 1, 1},
  {&__pyx_n_s__align2, __pyx_k__align2, sizeof(__pyx_k__align2), 0, 0, 1, 1},
  {&__pyx_n_s__alignment1, __pyx_k__alignment1, sizeof(__pyx_k__alignment1), 0, 0, 1, 1},
  {&__pyx_n_s__alignment2, __pyx_k__alignment2, sizeof(__pyx_k__alignment2), 0, 0, 1, 1},
  {&__pyx_n_s__best, __pyx_k__best, sizeof(__pyx_k__best), 0, 0, 1, 1},
  {&__pyx_n_s__best_i, __pyx_k__best_i, sizeof(__pyx_k__best_i), 0, 0, 1, 1},
  {&__pyx_n_s__best_j, __pyx_k__best_j, sizeof(__pyx_k__best_j), 0, 0, 1, 1},
  {&__pyx_n_s__bt, __pyx_k__bt, sizeof(__pyx_k__bt), 0, 0, 1, 1},
  {&__pyx_n_s__byte_frequencies, __pyx_k__byte_frequencies, sizeof(__pyx_k__byte_frequencies), 0, 0, 1, 1},
  {&__pyx_n_s__c, __pyx_k__c, sizeof(__pyx_k__c), 0, 0, 1, 1},
  {&__pyx_n_s__collections, __pyx_k__collections, sizeof(__pyx_k__collections), 0, 0, 1, 1},
  {&__pyx_n_s__columns, __pyx_k__columns, sizeof(__pyx_k__columns), 0, 0, 1, 1},
  {&__pyx_n_s__costs, __pyx_k__costs, sizeof(__pyx_k__costs), 0, 0, 1, 1},
  {&__pyx_n_s__counter, __pyx_k__counter, sizeof(__pyx_k__counter), 0, 0, 1, 1},
  {&__pyx_n_s__cur_column, __pyx_k__cur_column, sizeof(__pyx_k__cur_column), 0, 0, 1, 1},
  {&__pyx_n_s__deletion, __pyx_k__deletion, sizeof(__pyx_k__deletion), 0, 0, 1, 1},
  {&__pyx_n_s__direction, __pyx_k__direction, sizeof(__pyx_k__direction), 0, 0, 1, 1},
  {&__pyx_n_s__edit_distance, __pyx_k__edit_distance, sizeof(__pyx_k__edit_distance), 0, 0, 1, 1},
  {&__pyx_n_s__errors, __pyx_k__errors, sizeof(__pyx_k__errors), 0, 0, 1, 1},
  {&__pyx_n_s__flags, __pyx_k__flags, sizeof(__pyx_k__flags), 0, 0, 1, 1},
  {&__pyx_n_s__frequencies, __pyx_k__frequencies, sizeof(__pyx_k__frequencies), 0, 0, 1, 1},
  {&__pyx_n_s__gaps_are_errors, __pyx_k__gaps_are_errors, sizeof(__pyx_k__gaps_are_errors), 0, 0, 1, 1},
  {&__pyx_n_s__globalalign, __pyx_k__globalalign, sizeof(__pyx_k__globalalign), 0, 0, 1, 1},
  {&__pyx_n_s__i, __pyx_k__i, sizeof(__pyx_k__i), 0, 0, 1, 1},
  {&__pyx_n_s__insertion, __pyx_k__insertion, sizeof(__pyx_k__insertion), 0, 0, 1, 1},
  {&__pyx_n_s__j, __pyx_k__j, sizeof(__pyx_k__j), 0, 0, 1, 1},
  {&__pyx_n_s__last_column, __pyx_k__last_column, sizeof(__pyx_k__last_column), 0, 0, 1, 1},
  {&__pyx_n_s__m, __pyx_k__m, sizeof(__pyx_k__m), 0, 0, 1, 1},
  {&__pyx_n_s__match, __pyx_k__match, sizeof(__pyx_k__match), 0, 0, 1, 1},
  {&__pyx_n_s__mismatch, __pyx_k__mismatch, sizeof(__pyx_k__mismatch), 0, 0, 1, 1},
  {&__pyx_n_s__n, __pyx_k__n, sizeof(__pyx_k__n), 0, 0, 1, 1},
  {&__pyx_n_s__p1, __pyx_k__p1, sizeof(__pyx_k__p1), 0, 0, 1, 1},
  {&__pyx_n_s__p2, __pyx_k__p2, sizeof(__pyx_k__p2), 0, 0, 1, 1},
  {&__pyx_n_s__prev, __pyx_k__prev, sizeof(__pyx_k__prev), 0, 0, 1, 1},
  {&__pyx_n_s__prev_column, __pyx_k__prev_column, sizeof(__pyx_k__prev_column), 0, 0, 1, 1},
  {&__pyx_n_s__range, __pyx_k__range, sizeof(__pyx_k__range), 0, 0, 1, 1},
  {&__pyx_n_s__s, __pyx_k__s, sizeof(__pyx_k__s), 0, 0, 1, 1},
  {&__pyx_n_s__s1, __pyx_k__s1, sizeof(__pyx_k__s1), 0, 0, 1, 1},
  {&__pyx_n_s__s2, __pyx_k__s2, sizeof(__pyx_k__s2), 0, 0, 1, 1},
  {&__pyx_n_s__score, __pyx_k__score, sizeof(__pyx_k__score), 0, 0, 1, 1},
  {&__pyx_n_s__start1, __pyx_k__start1, sizeof(__pyx_k__start1), 0, 0, 1, 1},
  {&__pyx_n_s__start2, __pyx_k__start2, sizeof(__pyx_k__start2), 0, 0, 1, 1},
  {&__pyx_n_s__t, __pyx_k__t, sizeof(__pyx_k__t), 0, 0, 1, 1},
  {&__pyx_n_s__tmp, __pyx_k__tmp, sizeof(__pyx_k__tmp), 0, 0, 1, 1},
  {0, 0, 0, 0, 0, 0, 0}
};
static int __Pyx_InitCachedBuiltins(void) {
  __pyx_builtin_MemoryError = __Pyx_GetBuiltinName(__pyx_n_s__MemoryError); if (!__pyx_builtin_MemoryError) {__pyx_filename = __pyx_f[0]; __pyx_lineno = 42; __pyx_clineno = __LINE__; goto __pyx_L1_error;}
  __pyx_builtin_range = __Pyx_GetBuiltinName(__pyx_n_s__range); if (!__pyx_builtin_range) {__pyx_filename = __pyx_f[0]; __pyx_lineno = 43; __pyx_clineno = __LINE__; goto __pyx_L1_error;}
  return 0;
  __pyx_L1_error:;
  return -1;
}

static int __Pyx_InitCachedConstants(void) {
  __Pyx_RefNannyDeclarations
  __Pyx_RefNannySetupContext("__Pyx_InitCachedConstants", 0);

  /* "sqt/_helpers.pyx":274
 * 	align2 = alignment2[:(p2-alignment2)]
 * 
 * 	align1 = align1[::-1]             # <<<<<<<<<<<<<<
 * 	align2 = align2[::-1]
 * 
 */
  __pyx_k_slice_1 = PySlice_New(Py_None, Py_None, __pyx_int_neg_1); if (unlikely(!__pyx_k_slice_1)) {__pyx_filename = __pyx_f[0]; __pyx_lineno = 274; __pyx_clineno = __LINE__; goto __pyx_L1_error;}
  __Pyx_GOTREF(__pyx_k_slice_1);
  __Pyx_GIVEREF(__pyx_k_slice_1);

  /* "sqt/_helpers.pyx":275
 * 
 * 	align1 = align1[::-1]
 * 	align2 = align2[::-1]             # <<<<<<<<<<<<<<
 * 
 * 	PyMem_Free(alignment1)
 */
  __pyx_k_slice_2 = PySlice_New(Py_None, Py_None, __pyx_int_neg_1); if (unlikely(!__pyx_k_slice_2)) {__pyx_filename = __pyx_f[0]; __pyx_lineno = 275; __pyx_clineno = __LINE__; goto __pyx_L1_error;}
  __Pyx_GOTREF(__pyx_k_slice_2);
  __Pyx_GIVEREF(__pyx_k_slice_2);

  /* "sqt/_helpers.pyx":29
 * 
 * 
 * def edit_distance(char* s, char* t):             # <<<<<<<<<<<<<<
 * 	"""
 * 	Return the edit distance between the strings s and t.
 */
  __pyx_k_tuple_3 = PyTuple_Pack(9, ((PyObject *)__pyx_n_s__s), ((PyObject *)__pyx_n_s__t), ((PyObject *)__pyx_n_s__m), ((PyObject *)__pyx_n_s__n), ((PyObject *)__pyx_n_s__i), ((PyObject *)__pyx_n_s__j), ((PyObject *)__pyx_n_s__c), ((PyObject *)__pyx_n_s__costs), ((PyObject *)__pyx_n_s__prev)); if (unlikely(!__pyx_k_tuple_3)) {__pyx_filename = __pyx_f[0]; __pyx_lineno = 29; __pyx_clineno = __LINE__; goto __pyx_L1_error;}
  __Pyx_GOTREF(__pyx_k_tuple_3);
  __Pyx_GIVEREF(((PyObject *)__pyx_k_tuple_3));
  __pyx_k_codeobj_4 = (PyObject*)__Pyx_PyCode_New(2, 0, 9, 0, 0, __pyx_empty_bytes, __pyx_empty_tuple, __pyx_empty_tuple, __pyx_k_tuple_3, __pyx_empty_tuple, __pyx_empty_tuple, __pyx_kp_s_5, __pyx_n_s__edit_distance, 29, __pyx_empty_bytes); if (unlikely(!__pyx_k_codeobj_4)) {__pyx_filename = __pyx_f[0]; __pyx_lineno = 29; __pyx_clineno = __LINE__; goto __pyx_L1_error;}

  /* "sqt/_helpers.pyx":61
 * 
 * 
 * def globalalign(char* s1, char* s2, int flags=0, int match=1, int mismatch=-2, int insertion=-2, int deletion=-2):             # <<<<<<<<<<<<<<
 * 	"""Compute a global or semiglobal alignment of strings s1 and s2.
 * 
 */
  __pyx_k_tuple_7 = PyTuple_Pack(35, ((PyObject *)__pyx_n_s__s1), ((PyObject *)__pyx_n_s__s2), ((PyObject *)__pyx_n_s__flags), ((PyObject *)__pyx_n_s__match), ((PyObject *)__pyx_n_s__mismatch), ((PyObject *)__pyx_n_s__insertion), ((PyObject *)__pyx_n_s__deletion), ((PyObject *)__pyx_n_s__m), ((PyObject *)__pyx_n_s__n), ((PyObject *)__pyx_n_s__LEFT), ((PyObject *)__pyx_n_s__UP), ((PyObject *)__pyx_n_s__DIAG), ((PyObject *)__pyx_n_s__columns), ((PyObject *)__pyx_n_s__i), ((PyObject *)__pyx_n_s__j), ((PyObject *)__pyx_n_s__bt), ((PyObject *)__pyx_n_s__score), ((PyObject *)__pyx_n_s__tmp), ((PyObject *)__pyx_n_s__cur_column), ((PyObject *)__pyx_n_s__prev_column), ((PyObject *)__pyx_n_s__best_i), ((PyObject *)__pyx_n_s__best_j), ((PyObject *)__pyx_n_s__best), ((PyObject *)__pyx_n_s__last_column), ((PyObject *)__pyx_n_s__alignment1), ((PyObject *)__pyx_n_s__alignment2), ((PyObject *)__pyx_n_s__p1), ((PyObject *)__pyx_n_s__p2), ((PyObject *)__pyx_n_s__errors), ((PyObject *)__pyx_n_s__gaps_are_errors), ((PyObject *)__pyx_n_s__direction), ((PyObject *)__pyx_n_s__start1), ((PyObject *)__pyx_n_s__start2), ((PyObject *)__pyx_n_s__align1), ((PyObject *)__pyx_n_s__align2)); if (unlikely(!__pyx_k_tuple_7)) {__pyx_filename = __pyx_f[0]; __pyx_lineno = 61; __pyx_clineno = __LINE__; goto __pyx_L1_error;}
  __Pyx_GOTREF(__pyx_k_tuple_7);
  __Pyx_GIVEREF(((PyObject *)__pyx_k_tuple_7));
  __pyx_k_codeobj_8 = (PyObject*)__Pyx_PyCode_New(7, 0, 35, 0, 0, __pyx_empty_bytes, __pyx_empty_tuple, __pyx_empty_tuple, __pyx_k_tuple_7, __pyx_empty_tuple, __pyx_empty_tuple, __pyx_kp_s_5, __pyx_n_s__globalalign, 61, __pyx_empty_bytes); if (unlikely(!__pyx_k_codeobj_8)) {__pyx_filename = __pyx_f[0]; __pyx_lineno = 61; __pyx_clineno = __LINE__; goto __pyx_L1_error;}

  /* "sqt/_helpers.pyx":283
 * 
 * 
 * def byte_frequencies(bytes s):             # <<<<<<<<<<<<<<
 * 	"""Faster replacement for collections.Counter(s) for the case when s is a bytes object.
 * 
 */
  __pyx_k_tuple_9 = PyTuple_Pack(5, ((PyObject *)__pyx_n_s__s), ((PyObject *)__pyx_n_s__frequencies), ((PyObject *)__pyx_n_s__i), ((PyObject *)__pyx_n_s__c), ((PyObject *)__pyx_n_s__counter)); if (unlikely(!__pyx_k_tuple_9)) {__pyx_filename = __pyx_f[0]; __pyx_lineno = 283; __pyx_clineno = __LINE__; goto __pyx_L1_error;}
  __Pyx_GOTREF(__pyx_k_tuple_9);
  __Pyx_GIVEREF(((PyObject *)__pyx_k_tuple_9));
  __pyx_k_codeobj_10 = (PyObject*)__Pyx_PyCode_New(1, 0, 5, 0, 0, __pyx_empty_bytes, __pyx_empty_tuple, __pyx_empty_tuple, __pyx_k_tuple_9, __pyx_empty_tuple, __pyx_empty_tuple, __pyx_kp_s_5, __pyx_n_s__byte_frequencies, 283, __pyx_empty_bytes); if (unlikely(!__pyx_k_codeobj_10)) {__pyx_filename = __pyx_f[0]; __pyx_lineno = 283; __pyx_clineno = __LINE__; goto __pyx_L1_error;}
  __Pyx_RefNannyFinishContext();
  return 0;
  __pyx_L1_error:;
  __Pyx_RefNannyFinishContext();
  return -1;
}

static int __Pyx_InitGlobals(void) {
  if (__Pyx_InitStrings(__pyx_string_tab) < 0) {__pyx_filename = __pyx_f[0]; __pyx_lineno = 1; __pyx_clineno = __LINE__; goto __pyx_L1_error;};
  __pyx_int_neg_1 = PyInt_FromLong(-1); if (unlikely(!__pyx_int_neg_1)) {__pyx_filename = __pyx_f[0]; __pyx_lineno = 1; __pyx_clineno = __LINE__; goto __pyx_L1_error;};
  return 0;
  __pyx_L1_error:;
  return -1;
}

#if PY_MAJOR_VERSION < 3
PyMODINIT_FUNC init_helpers(void); /*proto*/
PyMODINIT_FUNC init_helpers(void)
#else
PyMODINIT_FUNC PyInit__helpers(void); /*proto*/
PyMODINIT_FUNC PyInit__helpers(void)
#endif
{
  PyObject *__pyx_t_1 = NULL;
  PyObject *__pyx_t_2 = NULL;
  int __pyx_lineno = 0;
  const char *__pyx_filename = NULL;
  int __pyx_clineno = 0;
  __Pyx_RefNannyDeclarations
  #if CYTHON_REFNANNY
  __Pyx_RefNanny = __Pyx_RefNannyImportAPI("refnanny");
  if (!__Pyx_RefNanny) {
      PyErr_Clear();
      __Pyx_RefNanny = __Pyx_RefNannyImportAPI("Cython.Runtime.refnanny");
      if (!__Pyx_RefNanny)
          Py_FatalError("failed to import 'refnanny' module");
  }
  #endif
  __Pyx_RefNannySetupContext("PyMODINIT_FUNC PyInit__helpers(void)", 0);
  if ( __Pyx_check_binary_version() < 0) {__pyx_filename = __pyx_f[0]; __pyx_lineno = 1; __pyx_clineno = __LINE__; goto __pyx_L1_error;}
  __pyx_empty_tuple = PyTuple_New(0); if (unlikely(!__pyx_empty_tuple)) {__pyx_filename = __pyx_f[0]; __pyx_lineno = 1; __pyx_clineno = __LINE__; goto __pyx_L1_error;}
  __pyx_empty_bytes = PyBytes_FromStringAndSize("", 0); if (unlikely(!__pyx_empty_bytes)) {__pyx_filename = __pyx_f[0]; __pyx_lineno = 1; __pyx_clineno = __LINE__; goto __pyx_L1_error;}
  #ifdef __Pyx_CyFunction_USED
  if (__Pyx_CyFunction_init() < 0) {__pyx_filename = __pyx_f[0]; __pyx_lineno = 1; __pyx_clineno = __LINE__; goto __pyx_L1_error;}
  #endif
  #ifdef __Pyx_FusedFunction_USED
  if (__pyx_FusedFunction_init() < 0) {__pyx_filename = __pyx_f[0]; __pyx_lineno = 1; __pyx_clineno = __LINE__; goto __pyx_L1_error;}
  #endif
  #ifdef __Pyx_Generator_USED
  if (__pyx_Generator_init() < 0) {__pyx_filename = __pyx_f[0]; __pyx_lineno = 1; __pyx_clineno = __LINE__; goto __pyx_L1_error;}
  #endif
  /*--- Library function declarations ---*/
  /*--- Threads initialization code ---*/
  #if defined(__PYX_FORCE_INIT_THREADS) && __PYX_FORCE_INIT_THREADS
  #ifdef WITH_THREAD /* Python build with threading support? */
  PyEval_InitThreads();
  #endif
  #endif
  /*--- Module creation code ---*/
  #if PY_MAJOR_VERSION < 3
  __pyx_m = Py_InitModule4(__Pyx_NAMESTR("_helpers"), __pyx_methods, 0, 0, PYTHON_API_VERSION); Py_XINCREF(__pyx_m);
  #else
  __pyx_m = PyModule_Create(&__pyx_moduledef);
  #endif
  if (unlikely(!__pyx_m)) {__pyx_filename = __pyx_f[0]; __pyx_lineno = 1; __pyx_clineno = __LINE__; goto __pyx_L1_error;}
  __pyx_d = PyModule_GetDict(__pyx_m); if (unlikely(!__pyx_d)) {__pyx_filename = __pyx_f[0]; __pyx_lineno = 1; __pyx_clineno = __LINE__; goto __pyx_L1_error;}
  Py_INCREF(__pyx_d);
  #if PY_MAJOR_VERSION >= 3
  {
    PyObject *modules = PyImport_GetModuleDict(); if (unlikely(!modules)) {__pyx_filename = __pyx_f[0]; __pyx_lineno = 1; __pyx_clineno = __LINE__; goto __pyx_L1_error;}
    if (!PyDict_GetItemString(modules, "sqt._helpers")) {
      if (unlikely(PyDict_SetItemString(modules, "sqt._helpers", __pyx_m) < 0)) {__pyx_filename = __pyx_f[0]; __pyx_lineno = 1; __pyx_clineno = __LINE__; goto __pyx_L1_error;}
    }
  }
  #endif
  __pyx_b = PyImport_AddModule(__Pyx_NAMESTR(__Pyx_BUILTIN_MODULE_NAME)); if (unlikely(!__pyx_b)) {__pyx_filename = __pyx_f[0]; __pyx_lineno = 1; __pyx_clineno = __LINE__; goto __pyx_L1_error;}
  #if CYTHON_COMPILING_IN_PYPY
  Py_INCREF(__pyx_b);
  #endif
  if (__Pyx_SetAttrString(__pyx_m, "__builtins__", __pyx_b) < 0) {__pyx_filename = __pyx_f[0]; __pyx_lineno = 1; __pyx_clineno = __LINE__; goto __pyx_L1_error;};
  /*--- Initialize various global constants etc. ---*/
  if (unlikely(__Pyx_InitGlobals() < 0)) {__pyx_filename = __pyx_f[0]; __pyx_lineno = 1; __pyx_clineno = __LINE__; goto __pyx_L1_error;}
  #if PY_MAJOR_VERSION < 3 && (__PYX_DEFAULT_STRING_ENCODING_IS_ASCII || __PYX_DEFAULT_STRING_ENCODING_IS_DEFAULT)
  if (__Pyx_init_sys_getdefaultencoding_params() < 0) {__pyx_filename = __pyx_f[0]; __pyx_lineno = 1; __pyx_clineno = __LINE__; goto __pyx_L1_error;}
  #endif
  if (__pyx_module_is_main_sqt___helpers) {
    if (__Pyx_SetAttrString(__pyx_m, "__name__", __pyx_n_s____main__) < 0) {__pyx_filename = __pyx_f[0]; __pyx_lineno = 1; __pyx_clineno = __LINE__; goto __pyx_L1_error;};
  }
  /*--- Builtin init code ---*/
  if (unlikely(__Pyx_InitCachedBuiltins() < 0)) {__pyx_filename = __pyx_f[0]; __pyx_lineno = 1; __pyx_clineno = __LINE__; goto __pyx_L1_error;}
  /*--- Constants init code ---*/
  if (unlikely(__Pyx_InitCachedConstants() < 0)) {__pyx_filename = __pyx_f[0]; __pyx_lineno = 1; __pyx_clineno = __LINE__; goto __pyx_L1_error;}
  /*--- Global init code ---*/
  /*--- Variable export code ---*/
  /*--- Function export code ---*/
  /*--- Type init code ---*/
  /*--- Type import code ---*/
  /*--- Variable import code ---*/
  /*--- Function import code ---*/
  /*--- Execution code ---*/

  /* "sqt/_helpers.pyx":3
 * # kate: syntax Python;
 * from cpython.mem cimport PyMem_Malloc, PyMem_Free
 * from collections import Counter             # <<<<<<<<<<<<<<
 * 
 * DEF START_WITHIN_SEQ1 = 1
 */
  __pyx_t_1 = PyList_New(1); if (unlikely(!__pyx_t_1)) {__pyx_filename = __pyx_f[0]; __pyx_lineno = 3; __pyx_clineno = __LINE__; goto __pyx_L1_error;}
  __Pyx_GOTREF(__pyx_t_1);
  __Pyx_INCREF(((PyObject *)__pyx_n_s__Counter));
  PyList_SET_ITEM(__pyx_t_1, 0, ((PyObject *)__pyx_n_s__Counter));
  __Pyx_GIVEREF(((PyObject *)__pyx_n_s__Counter));
  __pyx_t_2 = __Pyx_Import(((PyObject *)__pyx_n_s__collections), ((PyObject *)__pyx_t_1), -1); if (unlikely(!__pyx_t_2)) {__pyx_filename = __pyx_f[0]; __pyx_lineno = 3; __pyx_clineno = __LINE__; goto __pyx_L1_error;}
  __Pyx_GOTREF(__pyx_t_2);
  __Pyx_DECREF(((PyObject *)__pyx_t_1)); __pyx_t_1 = 0;
  __pyx_t_1 = __Pyx_ImportFrom(__pyx_t_2, __pyx_n_s__Counter); if (unlikely(!__pyx_t_1)) {__pyx_filename = __pyx_f[0]; __pyx_lineno = 3; __pyx_clineno = __LINE__; goto __pyx_L1_error;}
  __Pyx_GOTREF(__pyx_t_1);
  if (PyDict_SetItem(__pyx_d, __pyx_n_s__Counter, __pyx_t_1) < 0) {__pyx_filename = __pyx_f[0]; __pyx_lineno = 3; __pyx_clineno = __LINE__; goto __pyx_L1_error;}
  __Pyx_DECREF(__pyx_t_1); __pyx_t_1 = 0;
  __Pyx_DECREF(__pyx_t_2); __pyx_t_2 = 0;

  /* "sqt/_helpers.pyx":29
 * 
 * 
 * def edit_distance(char* s, char* t):             # <<<<<<<<<<<<<<
 * 	"""
 * 	Return the edit distance between the strings s and t.
 */
  __pyx_t_2 = PyCFunction_NewEx(&__pyx_mdef_3sqt_8_helpers_1edit_distance, NULL, __pyx_n_s_6); if (unlikely(!__pyx_t_2)) {__pyx_filename = __pyx_f[0]; __pyx_lineno = 29; __pyx_clineno = __LINE__; goto __pyx_L1_error;}
  __Pyx_GOTREF(__pyx_t_2);
  if (PyDict_SetItem(__pyx_d, __pyx_n_s__edit_distance, __pyx_t_2) < 0) {__pyx_filename = __pyx_f[0]; __pyx_lineno = 29; __pyx_clineno = __LINE__; goto __pyx_L1_error;}
  __Pyx_DECREF(__pyx_t_2); __pyx_t_2 = 0;

  /* "sqt/_helpers.pyx":61
 * 
 * 
 * def globalalign(char* s1, char* s2, int flags=0, int match=1, int mismatch=-2, int insertion=-2, int deletion=-2):             # <<<<<<<<<<<<<<
 * 	"""Compute a global or semiglobal alignment of strings s1 and s2.
 * 
 */
  __pyx_t_2 = PyCFunction_NewEx(&__pyx_mdef_3sqt_8_helpers_3globalalign, NULL, __pyx_n_s_6); if (unlikely(!__pyx_t_2)) {__pyx_filename = __pyx_f[0]; __pyx_lineno = 61; __pyx_clineno = __LINE__; goto __pyx_L1_error;}
  __Pyx_GOTREF(__pyx_t_2);
  if (PyDict_SetItem(__pyx_d, __pyx_n_s__globalalign, __pyx_t_2) < 0) {__pyx_filename = __pyx_f[0]; __pyx_lineno = 61; __pyx_clineno = __LINE__; goto __pyx_L1_error;}
  __Pyx_DECREF(__pyx_t_2); __pyx_t_2 = 0;

  /* "sqt/_helpers.pyx":283
 * 
 * 
 * def byte_frequencies(bytes s):             # <<<<<<<<<<<<<<
 * 	"""Faster replacement for collections.Counter(s) for the case when s is a bytes object.
 * 
 */
  __pyx_t_2 = PyCFunction_NewEx(&__pyx_mdef_3sqt_8_helpers_5byte_frequencies, NULL, __pyx_n_s_6); if (unlikely(!__pyx_t_2)) {__pyx_filename = __pyx_f[0]; __pyx_lineno = 283; __pyx_clineno = __LINE__; goto __pyx_L1_error;}
  __Pyx_GOTREF(__pyx_t_2);
  if (PyDict_SetItem(__pyx_d, __pyx_n_s__byte_frequencies, __pyx_t_2) < 0) {__pyx_filename = __pyx_f[0]; __pyx_lineno = 283; __pyx_clineno = __LINE__; goto __pyx_L1_error;}
  __Pyx_DECREF(__pyx_t_2); __pyx_t_2 = 0;

  /* "sqt/_helpers.pyx":1
 * # kate: syntax Python;             # <<<<<<<<<<<<<<
 * from cpython.mem cimport PyMem_Malloc, PyMem_Free
 * from collections import Counter
 */
  __pyx_t_2 = PyDict_New(); if (unlikely(!__pyx_t_2)) {__pyx_filename = __pyx_f[0]; __pyx_lineno = 1; __pyx_clineno = __LINE__; goto __pyx_L1_error;}
  __Pyx_GOTREF(((PyObject *)__pyx_t_2));
  if (PyDict_SetItem(__pyx_d, __pyx_n_s____test__, ((PyObject *)__pyx_t_2)) < 0) {__pyx_filename = __pyx_f[0]; __pyx_lineno = 1; __pyx_clineno = __LINE__; goto __pyx_L1_error;}
  __Pyx_DECREF(((PyObject *)__pyx_t_2)); __pyx_t_2 = 0;
  goto __pyx_L0;
  __pyx_L1_error:;
  __Pyx_XDECREF(__pyx_t_1);
  __Pyx_XDECREF(__pyx_t_2);
  if (__pyx_m) {
    __Pyx_AddTraceback("init sqt._helpers", __pyx_clineno, __pyx_lineno, __pyx_filename);
    Py_DECREF(__pyx_m); __pyx_m = 0;
  } else if (!PyErr_Occurred()) {
    PyErr_SetString(PyExc_ImportError, "init sqt._helpers");
  }
  __pyx_L0:;
  __Pyx_RefNannyFinishContext();
  #if PY_MAJOR_VERSION < 3
  return;
  #else
  return __pyx_m;
  #endif
}

/* Runtime support code */
#if CYTHON_REFNANNY
static __Pyx_RefNannyAPIStruct *__Pyx_RefNannyImportAPI(const char *modname) {
    PyObject *m = NULL, *p = NULL;
    void *r = NULL;
    m = PyImport_ImportModule((char *)modname);
    if (!m) goto end;
    p = PyObject_GetAttrString(m, (char *)"RefNannyAPI");
    if (!p) goto end;
    r = PyLong_AsVoidPtr(p);
end:
    Py_XDECREF(p);
    Py_XDECREF(m);
    return (__Pyx_RefNannyAPIStruct *)r;
}
#endif /* CYTHON_REFNANNY */

static PyObject *__Pyx_GetBuiltinName(PyObject *name) {
    PyObject* result = __Pyx_PyObject_GetAttrStr(__pyx_b, name);
    if (unlikely(!result)) {
        PyErr_Format(PyExc_NameError,
#if PY_MAJOR_VERSION >= 3
            "name '%U' is not defined", name);
#else
            "name '%s' is not defined", PyString_AS_STRING(name));
#endif
    }
    return result;
}

static void __Pyx_RaiseArgtupleInvalid(
    const char* func_name,
    int exact,
    Py_ssize_t num_min,
    Py_ssize_t num_max,
    Py_ssize_t num_found)
{
    Py_ssize_t num_expected;
    const char *more_or_less;
    if (num_found < num_min) {
        num_expected = num_min;
        more_or_less = "at least";
    } else {
        num_expected = num_max;
        more_or_less = "at most";
    }
    if (exact) {
        more_or_less = "exactly";
    }
    PyErr_Format(PyExc_TypeError,
                 "%s() takes %s %" CYTHON_FORMAT_SSIZE_T "d positional argument%s (%" CYTHON_FORMAT_SSIZE_T "d given)",
                 func_name, more_or_less, num_expected,
                 (num_expected == 1) ? "" : "s", num_found);
}

static void __Pyx_RaiseDoubleKeywordsError(
    const char* func_name,
    PyObject* kw_name)
{
    PyErr_Format(PyExc_TypeError,
        #if PY_MAJOR_VERSION >= 3
        "%s() got multiple values for keyword argument '%U'", func_name, kw_name);
        #else
        "%s() got multiple values for keyword argument '%s'", func_name,
        PyString_AsString(kw_name));
        #endif
}

static int __Pyx_ParseOptionalKeywords(
    PyObject *kwds,
    PyObject **argnames[],
    PyObject *kwds2,
    PyObject *values[],
    Py_ssize_t num_pos_args,
    const char* function_name)
{
    PyObject *key = 0, *value = 0;
    Py_ssize_t pos = 0;
    PyObject*** name;
    PyObject*** first_kw_arg = argnames + num_pos_args;
    while (PyDict_Next(kwds, &pos, &key, &value)) {
        name = first_kw_arg;
        while (*name && (**name != key)) name++;
        if (*name) {
            values[name-argnames] = value;
            continue;
        }
        name = first_kw_arg;
        #if PY_MAJOR_VERSION < 3
        if (likely(PyString_CheckExact(key)) || likely(PyString_Check(key))) {
            while (*name) {
                if ((CYTHON_COMPILING_IN_PYPY || PyString_GET_SIZE(**name) == PyString_GET_SIZE(key))
                        && _PyString_Eq(**name, key)) {
                    values[name-argnames] = value;
                    break;
                }
                name++;
            }
            if (*name) continue;
            else {
                PyObject*** argname = argnames;
                while (argname != first_kw_arg) {
                    if ((**argname == key) || (
                            (CYTHON_COMPILING_IN_PYPY || PyString_GET_SIZE(**argname) == PyString_GET_SIZE(key))
                             && _PyString_Eq(**argname, key))) {
                        goto arg_passed_twice;
                    }
                    argname++;
                }
            }
        } else
        #endif
        if (likely(PyUnicode_Check(key))) {
            while (*name) {
                int cmp = (**name == key) ? 0 :
                #if !CYTHON_COMPILING_IN_PYPY && PY_MAJOR_VERSION >= 3
                    (PyUnicode_GET_SIZE(**name) != PyUnicode_GET_SIZE(key)) ? 1 :
                #endif
                    PyUnicode_Compare(**name, key);
                if (cmp < 0 && unlikely(PyErr_Occurred())) goto bad;
                if (cmp == 0) {
                    values[name-argnames] = value;
                    break;
                }
                name++;
            }
            if (*name) continue;
            else {
                PyObject*** argname = argnames;
                while (argname != first_kw_arg) {
                    int cmp = (**argname == key) ? 0 :
                    #if !CYTHON_COMPILING_IN_PYPY && PY_MAJOR_VERSION >= 3
                        (PyUnicode_GET_SIZE(**argname) != PyUnicode_GET_SIZE(key)) ? 1 :
                    #endif
                        PyUnicode_Compare(**argname, key);
                    if (cmp < 0 && unlikely(PyErr_Occurred())) goto bad;
                    if (cmp == 0) goto arg_passed_twice;
                    argname++;
                }
            }
        } else
            goto invalid_keyword_type;
        if (kwds2) {
            if (unlikely(PyDict_SetItem(kwds2, key, value))) goto bad;
        } else {
            goto invalid_keyword;
        }
    }
    return 0;
arg_passed_twice:
    __Pyx_RaiseDoubleKeywordsError(function_name, key);
    goto bad;
invalid_keyword_type:
    PyErr_Format(PyExc_TypeError,
        "%s() keywords must be strings", function_name);
    goto bad;
invalid_keyword:
    PyErr_Format(PyExc_TypeError,
    #if PY_MAJOR_VERSION < 3
        "%s() got an unexpected keyword argument '%s'",
        function_name, PyString_AsString(key));
    #else
        "%s() got an unexpected keyword argument '%U'",
        function_name, key);
    #endif
bad:
    return -1;
}

static int __Pyx_ArgTypeTest(PyObject *obj, PyTypeObject *type, int none_allowed,
    const char *name, int exact)
{
    if (!type) {
        PyErr_Format(PyExc_SystemError, "Missing type object");
        return 0;
    }
    if (none_allowed && obj == Py_None) return 1;
    else if (exact) {
        if (Py_TYPE(obj) == type) return 1;
    }
    else {
        if (PyObject_TypeCheck(obj, type)) return 1;
    }
    PyErr_Format(PyExc_TypeError,
        "Argument '%s' has incorrect type (expected %s, got %s)",
        name, type->tp_name, Py_TYPE(obj)->tp_name);
    return 0;
}

static CYTHON_INLINE PyObject *__Pyx_GetModuleGlobalName(PyObject *name) {
    PyObject *result;
#if CYTHON_COMPILING_IN_CPYTHON
    result = PyDict_GetItem(__pyx_d, name);
    if (result) {
        Py_INCREF(result);
    } else {
#else
    result = PyObject_GetItem(__pyx_d, name);
    if (!result) {
        PyErr_Clear();
#endif
        result = __Pyx_GetBuiltinName(name);
    }
    return result;
}

static CYTHON_INLINE int __Pyx_SetItemInt_Generic(PyObject *o, PyObject *j, PyObject *v) {
    int r;
    if (!j) return -1;
    r = PyObject_SetItem(o, j, v);
    Py_DECREF(j);
    return r;
}
static CYTHON_INLINE int __Pyx_SetItemInt_Fast(PyObject *o, Py_ssize_t i, PyObject *v,
                                               int is_list, int wraparound, int boundscheck) {
#if CYTHON_COMPILING_IN_CPYTHON
    if (is_list || PyList_CheckExact(o)) {
        Py_ssize_t n = (!wraparound) ? i : ((likely(i >= 0)) ? i : i + PyList_GET_SIZE(o));
        if ((!boundscheck) || likely((n >= 0) & (n < PyList_GET_SIZE(o)))) {
            PyObject* old = PyList_GET_ITEM(o, n);
            Py_INCREF(v);
            PyList_SET_ITEM(o, n, v);
            Py_DECREF(old);
            return 1;
        }
    } else {
        PySequenceMethods *m = Py_TYPE(o)->tp_as_sequence;
        if (likely(m && m->sq_ass_item)) {
            if (wraparound && unlikely(i < 0) && likely(m->sq_length)) {
                Py_ssize_t l = m->sq_length(o);
                if (likely(l >= 0)) {
                    i += l;
                } else {
                    if (PyErr_ExceptionMatches(PyExc_OverflowError))
                        PyErr_Clear();
                    else
                        return -1;
                }
            }
            return m->sq_ass_item(o, i, v);
        }
    }
#else
#if CYTHON_COMPILING_IN_PYPY
    if (is_list || (PySequence_Check(o) && !PyDict_Check(o))) {
#else
    if (is_list || PySequence_Check(o)) {
#endif
        return PySequence_SetItem(o, i, v);
    }
#endif
    return __Pyx_SetItemInt_Generic(o, PyInt_FromSsize_t(i), v);
}

static PyObject* __Pyx_ImportFrom(PyObject* module, PyObject* name) {
    PyObject* value = __Pyx_PyObject_GetAttrStr(module, name);
    if (unlikely(!value) && PyErr_ExceptionMatches(PyExc_AttributeError)) {
        PyErr_Format(PyExc_ImportError,
        #if PY_MAJOR_VERSION < 3
            "cannot import name %.230s", PyString_AS_STRING(name));
        #else
            "cannot import name %S", name);
        #endif
    }
    return value;
}

static PyObject *__Pyx_Import(PyObject *name, PyObject *from_list, int level) {
    PyObject *empty_list = 0;
    PyObject *module = 0;
    PyObject *global_dict = 0;
    PyObject *empty_dict = 0;
    PyObject *list;
    #if PY_VERSION_HEX < 0x03030000
    PyObject *py_import;
    py_import = __Pyx_PyObject_GetAttrStr(__pyx_b, __pyx_n_s____import__);
    if (!py_import)
        goto bad;
    #endif
    if (from_list)
        list = from_list;
    else {
        empty_list = PyList_New(0);
        if (!empty_list)
            goto bad;
        list = empty_list;
    }
    global_dict = PyModule_GetDict(__pyx_m);
    if (!global_dict)
        goto bad;
    empty_dict = PyDict_New();
    if (!empty_dict)
        goto bad;
    #if PY_VERSION_HEX >= 0x02050000
    {
        #if PY_MAJOR_VERSION >= 3
        if (level == -1) {
            if (strchr(__Pyx_MODULE_NAME, '.')) {
                #if PY_VERSION_HEX < 0x03030000
                PyObject *py_level = PyInt_FromLong(1);
                if (!py_level)
                    goto bad;
                module = PyObject_CallFunctionObjArgs(py_import,
                    name, global_dict, empty_dict, list, py_level, NULL);
                Py_DECREF(py_level);
                #else
                module = PyImport_ImportModuleLevelObject(
                    name, global_dict, empty_dict, list, 1);
                #endif
                if (!module) {
                    if (!PyErr_ExceptionMatches(PyExc_ImportError))
                        goto bad;
                    PyErr_Clear();
                }
            }
            level = 0; /* try absolute import on failure */
        }
        #endif
        if (!module) {
            #if PY_VERSION_HEX < 0x03030000
            PyObject *py_level = PyInt_FromLong(level);
            if (!py_level)
                goto bad;
            module = PyObject_CallFunctionObjArgs(py_import,
                name, global_dict, empty_dict, list, py_level, NULL);
            Py_DECREF(py_level);
            #else
            module = PyImport_ImportModuleLevelObject(
                name, global_dict, empty_dict, list, level);
            #endif
        }
    }
    #else
    if (level>0) {
        PyErr_SetString(PyExc_RuntimeError, "Relative import is not supported for Python <=2.4.");
        goto bad;
    }
    module = PyObject_CallFunctionObjArgs(py_import,
        name, global_dict, empty_dict, list, NULL);
    #endif
bad:
    #if PY_VERSION_HEX < 0x03030000
    Py_XDECREF(py_import);
    #endif
    Py_XDECREF(empty_list);
    Py_XDECREF(empty_dict);
    return module;
}

static CYTHON_INLINE unsigned char __Pyx_PyInt_AsUnsignedChar(PyObject* x) {
    const unsigned char neg_one = (unsigned char)-1, const_zero = 0;
    const int is_unsigned = neg_one > const_zero;
    if (sizeof(unsigned char) < sizeof(long)) {
        long val = __Pyx_PyInt_AsLong(x);
        if (unlikely(val != (long)(unsigned char)val)) {
            if (!unlikely(val == -1 && PyErr_Occurred())) {
                PyErr_SetString(PyExc_OverflowError,
                    (is_unsigned && unlikely(val < 0)) ?
                    "can't convert negative value to unsigned char" :
                    "value too large to convert to unsigned char");
            }
            return (unsigned char)-1;
        }
        return (unsigned char)val;
    }
    return (unsigned char)__Pyx_PyInt_AsUnsignedLong(x);
}

static CYTHON_INLINE unsigned short __Pyx_PyInt_AsUnsignedShort(PyObject* x) {
    const unsigned short neg_one = (unsigned short)-1, const_zero = 0;
    const int is_unsigned = neg_one > const_zero;
    if (sizeof(unsigned short) < sizeof(long)) {
        long val = __Pyx_PyInt_AsLong(x);
        if (unlikely(val != (long)(unsigned short)val)) {
            if (!unlikely(val == -1 && PyErr_Occurred())) {
                PyErr_SetString(PyExc_OverflowError,
                    (is_unsigned && unlikely(val < 0)) ?
                    "can't convert negative value to unsigned short" :
                    "value too large to convert to unsigned short");
            }
            return (unsigned short)-1;
        }
        return (unsigned short)val;
    }
    return (unsigned short)__Pyx_PyInt_AsUnsignedLong(x);
}

static CYTHON_INLINE unsigned int __Pyx_PyInt_AsUnsignedInt(PyObject* x) {
    const unsigned int neg_one = (unsigned int)-1, const_zero = 0;
    const int is_unsigned = neg_one > const_zero;
    if (sizeof(unsigned int) < sizeof(long)) {
        long val = __Pyx_PyInt_AsLong(x);
        if (unlikely(val != (long)(unsigned int)val)) {
            if (!unlikely(val == -1 && PyErr_Occurred())) {
                PyErr_SetString(PyExc_OverflowError,
                    (is_unsigned && unlikely(val < 0)) ?
                    "can't convert negative value to unsigned int" :
                    "value too large to convert to unsigned int");
            }
            return (unsigned int)-1;
        }
        return (unsigned int)val;
    }
    return (unsigned int)__Pyx_PyInt_AsUnsignedLong(x);
}

static CYTHON_INLINE char __Pyx_PyInt_AsChar(PyObject* x) {
    const char neg_one = (char)-1, const_zero = 0;
    const int is_unsigned = neg_one > const_zero;
    if (sizeof(char) < sizeof(long)) {
        long val = __Pyx_PyInt_AsLong(x);
        if (unlikely(val != (long)(char)val)) {
            if (!unlikely(val == -1 && PyErr_Occurred())) {
                PyErr_SetString(PyExc_OverflowError,
                    (is_unsigned && unlikely(val < 0)) ?
                    "can't convert negative value to char" :
                    "value too large to convert to char");
            }
            return (char)-1;
        }
        return (char)val;
    }
    return (char)__Pyx_PyInt_AsLong(x);
}

static CYTHON_INLINE short __Pyx_PyInt_AsShort(PyObject* x) {
    const short neg_one = (short)-1, const_zero = 0;
    const int is_unsigned = neg_one > const_zero;
    if (sizeof(short) < sizeof(long)) {
        long val = __Pyx_PyInt_AsLong(x);
        if (unlikely(val != (long)(short)val)) {
            if (!unlikely(val == -1 && PyErr_Occurred())) {
                PyErr_SetString(PyExc_OverflowError,
                    (is_unsigned && unlikely(val < 0)) ?
                    "can't convert negative value to short" :
                    "value too large to convert to short");
            }
            return (short)-1;
        }
        return (short)val;
    }
    return (short)__Pyx_PyInt_AsLong(x);
}

static CYTHON_INLINE int __Pyx_PyInt_AsInt(PyObject* x) {
    const int neg_one = (int)-1, const_zero = 0;
    const int is_unsigned = neg_one > const_zero;
    if (sizeof(int) < sizeof(long)) {
        long val = __Pyx_PyInt_AsLong(x);
        if (unlikely(val != (long)(int)val)) {
            if (!unlikely(val == -1 && PyErr_Occurred())) {
                PyErr_SetString(PyExc_OverflowError,
                    (is_unsigned && unlikely(val < 0)) ?
                    "can't convert negative value to int" :
                    "value too large to convert to int");
            }
            return (int)-1;
        }
        return (int)val;
    }
    return (int)__Pyx_PyInt_AsLong(x);
}

static CYTHON_INLINE signed char __Pyx_PyInt_AsSignedChar(PyObject* x) {
    const signed char neg_one = (signed char)-1, const_zero = 0;
    const int is_unsigned = neg_one > const_zero;
    if (sizeof(signed char) < sizeof(long)) {
        long val = __Pyx_PyInt_AsLong(x);
        if (unlikely(val != (long)(signed char)val)) {
            if (!unlikely(val == -1 && PyErr_Occurred())) {
                PyErr_SetString(PyExc_OverflowError,
                    (is_unsigned && unlikely(val < 0)) ?
                    "can't convert negative value to signed char" :
                    "value too large to convert to signed char");
            }
            return (signed char)-1;
        }
        return (signed char)val;
    }
    return (signed char)__Pyx_PyInt_AsSignedLong(x);
}

static CYTHON_INLINE signed short __Pyx_PyInt_AsSignedShort(PyObject* x) {
    const signed short neg_one = (signed short)-1, const_zero = 0;
    const int is_unsigned = neg_one > const_zero;
    if (sizeof(signed short) < sizeof(long)) {
        long val = __Pyx_PyInt_AsLong(x);
        if (unlikely(val != (long)(signed short)val)) {
            if (!unlikely(val == -1 && PyErr_Occurred())) {
                PyErr_SetString(PyExc_OverflowError,
                    (is_unsigned && unlikely(val < 0)) ?
                    "can't convert negative value to signed short" :
                    "value too large to convert to signed short");
            }
            return (signed short)-1;
        }
        return (signed short)val;
    }
    return (signed short)__Pyx_PyInt_AsSignedLong(x);
}

static CYTHON_INLINE signed int __Pyx_PyInt_AsSignedInt(PyObject* x) {
    const signed int neg_one = (signed int)-1, const_zero = 0;
    const int is_unsigned = neg_one > const_zero;
    if (sizeof(signed int) < sizeof(long)) {
        long val = __Pyx_PyInt_AsLong(x);
        if (unlikely(val != (long)(signed int)val)) {
            if (!unlikely(val == -1 && PyErr_Occurred())) {
                PyErr_SetString(PyExc_OverflowError,
                    (is_unsigned && unlikely(val < 0)) ?
                    "can't convert negative value to signed int" :
                    "value too large to convert to signed int");
            }
            return (signed int)-1;
        }
        return (signed int)val;
    }
    return (signed int)__Pyx_PyInt_AsSignedLong(x);
}

static CYTHON_INLINE int __Pyx_PyInt_AsLongDouble(PyObject* x) {
    const int neg_one = (int)-1, const_zero = 0;
    const int is_unsigned = neg_one > const_zero;
    if (sizeof(int) < sizeof(long)) {
        long val = __Pyx_PyInt_AsLong(x);
        if (unlikely(val != (long)(int)val)) {
            if (!unlikely(val == -1 && PyErr_Occurred())) {
                PyErr_SetString(PyExc_OverflowError,
                    (is_unsigned && unlikely(val < 0)) ?
                    "can't convert negative value to int" :
                    "value too large to convert to int");
            }
            return (int)-1;
        }
        return (int)val;
    }
    return (int)__Pyx_PyInt_AsLong(x);
}

#if CYTHON_COMPILING_IN_CPYTHON && PY_MAJOR_VERSION >= 3
#if CYTHON_USE_PYLONG_INTERNALS
#include "longintrepr.h"
#endif
#endif
static CYTHON_INLINE unsigned long __Pyx_PyInt_AsUnsignedLong(PyObject* x) {
    const unsigned long neg_one = (unsigned long)-1, const_zero = 0;
    const int is_unsigned = neg_one > const_zero;
#if PY_MAJOR_VERSION < 3
    if (likely(PyInt_Check(x))) {
        long val = PyInt_AS_LONG(x);
        if (is_unsigned && unlikely(val < 0)) {
            PyErr_SetString(PyExc_OverflowError,
                            "can't convert negative value to unsigned long");
            return (unsigned long)-1;
        }
        return (unsigned long)val;
    } else
#endif
    if (likely(PyLong_Check(x))) {
        if (is_unsigned) {
#if CYTHON_COMPILING_IN_CPYTHON && PY_MAJOR_VERSION >= 3
#if CYTHON_USE_PYLONG_INTERNALS
            if (sizeof(digit) <= sizeof(unsigned long)) {
                switch (Py_SIZE(x)) {
                    case  0: return 0;
                    case  1: return (unsigned long) ((PyLongObject*)x)->ob_digit[0];
                }
            }
#endif
#endif
            if (unlikely(Py_SIZE(x) < 0)) {
                PyErr_SetString(PyExc_OverflowError,
                                "can't convert negative value to unsigned long");
                return (unsigned long)-1;
            }
            return (unsigned long)PyLong_AsUnsignedLong(x);
        } else {
#if CYTHON_COMPILING_IN_CPYTHON && PY_MAJOR_VERSION >= 3
#if CYTHON_USE_PYLONG_INTERNALS
            if (sizeof(digit) <= sizeof(unsigned long)) {
                switch (Py_SIZE(x)) {
                    case  0: return 0;
                    case  1: return +(unsigned long) ((PyLongObject*)x)->ob_digit[0];
                    case -1: return -(unsigned long) ((PyLongObject*)x)->ob_digit[0];
                }
            }
#endif
#endif
            return (unsigned long)PyLong_AsLong(x);
        }
    } else {
        unsigned long val;
        PyObject *tmp = __Pyx_PyNumber_Int(x);
        if (!tmp) return (unsigned long)-1;
        val = __Pyx_PyInt_AsUnsignedLong(tmp);
        Py_DECREF(tmp);
        return val;
    }
}

#if CYTHON_COMPILING_IN_CPYTHON && PY_MAJOR_VERSION >= 3
#if CYTHON_USE_PYLONG_INTERNALS
#include "longintrepr.h"
#endif
#endif
static CYTHON_INLINE unsigned PY_LONG_LONG __Pyx_PyInt_AsUnsignedLongLong(PyObject* x) {
    const unsigned PY_LONG_LONG neg_one = (unsigned PY_LONG_LONG)-1, const_zero = 0;
    const int is_unsigned = neg_one > const_zero;
#if PY_MAJOR_VERSION < 3
    if (likely(PyInt_Check(x))) {
        long val = PyInt_AS_LONG(x);
        if (is_unsigned && unlikely(val < 0)) {
            PyErr_SetString(PyExc_OverflowError,
                            "can't convert negative value to unsigned PY_LONG_LONG");
            return (unsigned PY_LONG_LONG)-1;
        }
        return (unsigned PY_LONG_LONG)val;
    } else
#endif
    if (likely(PyLong_Check(x))) {
        if (is_unsigned) {
#if CYTHON_COMPILING_IN_CPYTHON && PY_MAJOR_VERSION >= 3
#if CYTHON_USE_PYLONG_INTERNALS
            if (sizeof(digit) <= sizeof(unsigned PY_LONG_LONG)) {
                switch (Py_SIZE(x)) {
                    case  0: return 0;
                    case  1: return (unsigned PY_LONG_LONG) ((PyLongObject*)x)->ob_digit[0];
                }
            }
#endif
#endif
            if (unlikely(Py_SIZE(x) < 0)) {
                PyErr_SetString(PyExc_OverflowError,
                                "can't convert negative value to unsigned PY_LONG_LONG");
                return (unsigned PY_LONG_LONG)-1;
            }
            return (unsigned PY_LONG_LONG)PyLong_AsUnsignedLongLong(x);
        } else {
#if CYTHON_COMPILING_IN_CPYTHON && PY_MAJOR_VERSION >= 3
#if CYTHON_USE_PYLONG_INTERNALS
            if (sizeof(digit) <= sizeof(unsigned PY_LONG_LONG)) {
                switch (Py_SIZE(x)) {
                    case  0: return 0;
                    case  1: return +(unsigned PY_LONG_LONG) ((PyLongObject*)x)->ob_digit[0];
                    case -1: return -(unsigned PY_LONG_LONG) ((PyLongObject*)x)->ob_digit[0];
                }
            }
#endif
#endif
            return (unsigned PY_LONG_LONG)PyLong_AsLongLong(x);
        }
    } else {
        unsigned PY_LONG_LONG val;
        PyObject *tmp = __Pyx_PyNumber_Int(x);
        if (!tmp) return (unsigned PY_LONG_LONG)-1;
        val = __Pyx_PyInt_AsUnsignedLongLong(tmp);
        Py_DECREF(tmp);
        return val;
    }
}

#if CYTHON_COMPILING_IN_CPYTHON && PY_MAJOR_VERSION >= 3
#if CYTHON_USE_PYLONG_INTERNALS
#include "longintrepr.h"
#endif
#endif
static CYTHON_INLINE long __Pyx_PyInt_AsLong(PyObject* x) {
    const long neg_one = (long)-1, const_zero = 0;
    const int is_unsigned = neg_one > const_zero;
#if PY_MAJOR_VERSION < 3
    if (likely(PyInt_Check(x))) {
        long val = PyInt_AS_LONG(x);
        if (is_unsigned && unlikely(val < 0)) {
            PyErr_SetString(PyExc_OverflowError,
                            "can't convert negative value to long");
            return (long)-1;
        }
        return (long)val;
    } else
#endif
    if (likely(PyLong_Check(x))) {
        if (is_unsigned) {
#if CYTHON_COMPILING_IN_CPYTHON && PY_MAJOR_VERSION >= 3
#if CYTHON_USE_PYLONG_INTERNALS
            if (sizeof(digit) <= sizeof(long)) {
                switch (Py_SIZE(x)) {
                    case  0: return 0;
                    case  1: return (long) ((PyLongObject*)x)->ob_digit[0];
                }
            }
#endif
#endif
            if (unlikely(Py_SIZE(x) < 0)) {
                PyErr_SetString(PyExc_OverflowError,
                                "can't convert negative value to long");
                return (long)-1;
            }
            return (long)PyLong_AsUnsignedLong(x);
        } else {
#if CYTHON_COMPILING_IN_CPYTHON && PY_MAJOR_VERSION >= 3
#if CYTHON_USE_PYLONG_INTERNALS
            if (sizeof(digit) <= sizeof(long)) {
                switch (Py_SIZE(x)) {
                    case  0: return 0;
                    case  1: return +(long) ((PyLongObject*)x)->ob_digit[0];
                    case -1: return -(long) ((PyLongObject*)x)->ob_digit[0];
                }
            }
#endif
#endif
            return (long)PyLong_AsLong(x);
        }
    } else {
        long val;
        PyObject *tmp = __Pyx_PyNumber_Int(x);
        if (!tmp) return (long)-1;
        val = __Pyx_PyInt_AsLong(tmp);
        Py_DECREF(tmp);
        return val;
    }
}

#if CYTHON_COMPILING_IN_CPYTHON && PY_MAJOR_VERSION >= 3
#if CYTHON_USE_PYLONG_INTERNALS
#include "longintrepr.h"
#endif
#endif
static CYTHON_INLINE PY_LONG_LONG __Pyx_PyInt_AsLongLong(PyObject* x) {
    const PY_LONG_LONG neg_one = (PY_LONG_LONG)-1, const_zero = 0;
    const int is_unsigned = neg_one > const_zero;
#if PY_MAJOR_VERSION < 3
    if (likely(PyInt_Check(x))) {
        long val = PyInt_AS_LONG(x);
        if (is_unsigned && unlikely(val < 0)) {
            PyErr_SetString(PyExc_OverflowError,
                            "can't convert negative value to PY_LONG_LONG");
            return (PY_LONG_LONG)-1;
        }
        return (PY_LONG_LONG)val;
    } else
#endif
    if (likely(PyLong_Check(x))) {
        if (is_unsigned) {
#if CYTHON_COMPILING_IN_CPYTHON && PY_MAJOR_VERSION >= 3
#if CYTHON_USE_PYLONG_INTERNALS
            if (sizeof(digit) <= sizeof(PY_LONG_LONG)) {
                switch (Py_SIZE(x)) {
                    case  0: return 0;
                    case  1: return (PY_LONG_LONG) ((PyLongObject*)x)->ob_digit[0];
                }
            }
#endif
#endif
            if (unlikely(Py_SIZE(x) < 0)) {
                PyErr_SetString(PyExc_OverflowError,
                                "can't convert negative value to PY_LONG_LONG");
                return (PY_LONG_LONG)-1;
            }
            return (PY_LONG_LONG)PyLong_AsUnsignedLongLong(x);
        } else {
#if CYTHON_COMPILING_IN_CPYTHON && PY_MAJOR_VERSION >= 3
#if CYTHON_USE_PYLONG_INTERNALS
            if (sizeof(digit) <= sizeof(PY_LONG_LONG)) {
                switch (Py_SIZE(x)) {
                    case  0: return 0;
                    case  1: return +(PY_LONG_LONG) ((PyLongObject*)x)->ob_digit[0];
                    case -1: return -(PY_LONG_LONG) ((PyLongObject*)x)->ob_digit[0];
                }
            }
#endif
#endif
            return (PY_LONG_LONG)PyLong_AsLongLong(x);
        }
    } else {
        PY_LONG_LONG val;
        PyObject *tmp = __Pyx_PyNumber_Int(x);
        if (!tmp) return (PY_LONG_LONG)-1;
        val = __Pyx_PyInt_AsLongLong(tmp);
        Py_DECREF(tmp);
        return val;
    }
}

#if CYTHON_COMPILING_IN_CPYTHON && PY_MAJOR_VERSION >= 3
#if CYTHON_USE_PYLONG_INTERNALS
#include "longintrepr.h"
#endif
#endif
static CYTHON_INLINE signed long __Pyx_PyInt_AsSignedLong(PyObject* x) {
    const signed long neg_one = (signed long)-1, const_zero = 0;
    const int is_unsigned = neg_one > const_zero;
#if PY_MAJOR_VERSION < 3
    if (likely(PyInt_Check(x))) {
        long val = PyInt_AS_LONG(x);
        if (is_unsigned && unlikely(val < 0)) {
            PyErr_SetString(PyExc_OverflowError,
                            "can't convert negative value to signed long");
            return (signed long)-1;
        }
        return (signed long)val;
    } else
#endif
    if (likely(PyLong_Check(x))) {
        if (is_unsigned) {
#if CYTHON_COMPILING_IN_CPYTHON && PY_MAJOR_VERSION >= 3
#if CYTHON_USE_PYLONG_INTERNALS
            if (sizeof(digit) <= sizeof(signed long)) {
                switch (Py_SIZE(x)) {
                    case  0: return 0;
                    case  1: return (signed long) ((PyLongObject*)x)->ob_digit[0];
                }
            }
#endif
#endif
            if (unlikely(Py_SIZE(x) < 0)) {
                PyErr_SetString(PyExc_OverflowError,
                                "can't convert negative value to signed long");
                return (signed long)-1;
            }
            return (signed long)PyLong_AsUnsignedLong(x);
        } else {
#if CYTHON_COMPILING_IN_CPYTHON && PY_MAJOR_VERSION >= 3
#if CYTHON_USE_PYLONG_INTERNALS
            if (sizeof(digit) <= sizeof(signed long)) {
                switch (Py_SIZE(x)) {
                    case  0: return 0;
                    case  1: return +(signed long) ((PyLongObject*)x)->ob_digit[0];
                    case -1: return -(signed long) ((PyLongObject*)x)->ob_digit[0];
                }
            }
#endif
#endif
            return (signed long)PyLong_AsLong(x);
        }
    } else {
        signed long val;
        PyObject *tmp = __Pyx_PyNumber_Int(x);
        if (!tmp) return (signed long)-1;
        val = __Pyx_PyInt_AsSignedLong(tmp);
        Py_DECREF(tmp);
        return val;
    }
}

#if CYTHON_COMPILING_IN_CPYTHON && PY_MAJOR_VERSION >= 3
#if CYTHON_USE_PYLONG_INTERNALS
#include "longintrepr.h"
#endif
#endif
static CYTHON_INLINE signed PY_LONG_LONG __Pyx_PyInt_AsSignedLongLong(PyObject* x) {
    const signed PY_LONG_LONG neg_one = (signed PY_LONG_LONG)-1, const_zero = 0;
    const int is_unsigned = neg_one > const_zero;
#if PY_MAJOR_VERSION < 3
    if (likely(PyInt_Check(x))) {
        long val = PyInt_AS_LONG(x);
        if (is_unsigned && unlikely(val < 0)) {
            PyErr_SetString(PyExc_OverflowError,
                            "can't convert negative value to signed PY_LONG_LONG");
            return (signed PY_LONG_LONG)-1;
        }
        return (signed PY_LONG_LONG)val;
    } else
#endif
    if (likely(PyLong_Check(x))) {
        if (is_unsigned) {
#if CYTHON_COMPILING_IN_CPYTHON && PY_MAJOR_VERSION >= 3
#if CYTHON_USE_PYLONG_INTERNALS
            if (sizeof(digit) <= sizeof(signed PY_LONG_LONG)) {
                switch (Py_SIZE(x)) {
                    case  0: return 0;
                    case  1: return (signed PY_LONG_LONG) ((PyLongObject*)x)->ob_digit[0];
                }
            }
#endif
#endif
            if (unlikely(Py_SIZE(x) < 0)) {
                PyErr_SetString(PyExc_OverflowError,
                                "can't convert negative value to signed PY_LONG_LONG");
                return (signed PY_LONG_LONG)-1;
            }
            return (signed PY_LONG_LONG)PyLong_AsUnsignedLongLong(x);
        } else {
#if CYTHON_COMPILING_IN_CPYTHON && PY_MAJOR_VERSION >= 3
#if CYTHON_USE_PYLONG_INTERNALS
            if (sizeof(digit) <= sizeof(signed PY_LONG_LONG)) {
                switch (Py_SIZE(x)) {
                    case  0: return 0;
                    case  1: return +(signed PY_LONG_LONG) ((PyLongObject*)x)->ob_digit[0];
                    case -1: return -(signed PY_LONG_LONG) ((PyLongObject*)x)->ob_digit[0];
                }
            }
#endif
#endif
            return (signed PY_LONG_LONG)PyLong_AsLongLong(x);
        }
    } else {
        signed PY_LONG_LONG val;
        PyObject *tmp = __Pyx_PyNumber_Int(x);
        if (!tmp) return (signed PY_LONG_LONG)-1;
        val = __Pyx_PyInt_AsSignedLongLong(tmp);
        Py_DECREF(tmp);
        return val;
    }
}

static int __Pyx_check_binary_version(void) {
    char ctversion[4], rtversion[4];
    PyOS_snprintf(ctversion, 4, "%d.%d", PY_MAJOR_VERSION, PY_MINOR_VERSION);
    PyOS_snprintf(rtversion, 4, "%s", Py_GetVersion());
    if (ctversion[0] != rtversion[0] || ctversion[2] != rtversion[2]) {
        char message[200];
        PyOS_snprintf(message, sizeof(message),
                      "compiletime version %s of module '%.100s' "
                      "does not match runtime version %s",
                      ctversion, __Pyx_MODULE_NAME, rtversion);
        #if PY_VERSION_HEX < 0x02050000
        return PyErr_Warn(NULL, message);
        #else
        return PyErr_WarnEx(NULL, message, 1);
        #endif
    }
    return 0;
}

static int __pyx_bisect_code_objects(__Pyx_CodeObjectCacheEntry* entries, int count, int code_line) {
    int start = 0, mid = 0, end = count - 1;
    if (end >= 0 && code_line > entries[end].code_line) {
        return count;
    }
    while (start < end) {
        mid = (start + end) / 2;
        if (code_line < entries[mid].code_line) {
            end = mid;
        } else if (code_line > entries[mid].code_line) {
             start = mid + 1;
        } else {
            return mid;
        }
    }
    if (code_line <= entries[mid].code_line) {
        return mid;
    } else {
        return mid + 1;
    }
}
static PyCodeObject *__pyx_find_code_object(int code_line) {
    PyCodeObject* code_object;
    int pos;
    if (unlikely(!code_line) || unlikely(!__pyx_code_cache.entries)) {
        return NULL;
    }
    pos = __pyx_bisect_code_objects(__pyx_code_cache.entries, __pyx_code_cache.count, code_line);
    if (unlikely(pos >= __pyx_code_cache.count) || unlikely(__pyx_code_cache.entries[pos].code_line != code_line)) {
        return NULL;
    }
    code_object = __pyx_code_cache.entries[pos].code_object;
    Py_INCREF(code_object);
    return code_object;
}
static void __pyx_insert_code_object(int code_line, PyCodeObject* code_object) {
    int pos, i;
    __Pyx_CodeObjectCacheEntry* entries = __pyx_code_cache.entries;
    if (unlikely(!code_line)) {
        return;
    }
    if (unlikely(!entries)) {
        entries = (__Pyx_CodeObjectCacheEntry*)PyMem_Malloc(64*sizeof(__Pyx_CodeObjectCacheEntry));
        if (likely(entries)) {
            __pyx_code_cache.entries = entries;
            __pyx_code_cache.max_count = 64;
            __pyx_code_cache.count = 1;
            entries[0].code_line = code_line;
            entries[0].code_object = code_object;
            Py_INCREF(code_object);
        }
        return;
    }
    pos = __pyx_bisect_code_objects(__pyx_code_cache.entries, __pyx_code_cache.count, code_line);
    if ((pos < __pyx_code_cache.count) && unlikely(__pyx_code_cache.entries[pos].code_line == code_line)) {
        PyCodeObject* tmp = entries[pos].code_object;
        entries[pos].code_object = code_object;
        Py_DECREF(tmp);
        return;
    }
    if (__pyx_code_cache.count == __pyx_code_cache.max_count) {
        int new_max = __pyx_code_cache.max_count + 64;
        entries = (__Pyx_CodeObjectCacheEntry*)PyMem_Realloc(
            __pyx_code_cache.entries, new_max*sizeof(__Pyx_CodeObjectCacheEntry));
        if (unlikely(!entries)) {
            return;
        }
        __pyx_code_cache.entries = entries;
        __pyx_code_cache.max_count = new_max;
    }
    for (i=__pyx_code_cache.count; i>pos; i--) {
        entries[i] = entries[i-1];
    }
    entries[pos].code_line = code_line;
    entries[pos].code_object = code_object;
    __pyx_code_cache.count++;
    Py_INCREF(code_object);
}

#include "compile.h"
#include "frameobject.h"
#include "traceback.h"
static PyCodeObject* __Pyx_CreateCodeObjectForTraceback(
            const char *funcname, int c_line,
            int py_line, const char *filename) {
    PyCodeObject *py_code = 0;
    PyObject *py_srcfile = 0;
    PyObject *py_funcname = 0;
    #if PY_MAJOR_VERSION < 3
    py_srcfile = PyString_FromString(filename);
    #else
    py_srcfile = PyUnicode_FromString(filename);
    #endif
    if (!py_srcfile) goto bad;
    if (c_line) {
        #if PY_MAJOR_VERSION < 3
        py_funcname = PyString_FromFormat( "%s (%s:%d)", funcname, __pyx_cfilenm, c_line);
        #else
        py_funcname = PyUnicode_FromFormat( "%s (%s:%d)", funcname, __pyx_cfilenm, c_line);
        #endif
    }
    else {
        #if PY_MAJOR_VERSION < 3
        py_funcname = PyString_FromString(funcname);
        #else
        py_funcname = PyUnicode_FromString(funcname);
        #endif
    }
    if (!py_funcname) goto bad;
    py_code = __Pyx_PyCode_New(
        0,            /*int argcount,*/
        0,            /*int kwonlyargcount,*/
        0,            /*int nlocals,*/
        0,            /*int stacksize,*/
        0,            /*int flags,*/
        __pyx_empty_bytes, /*PyObject *code,*/
        __pyx_empty_tuple, /*PyObject *consts,*/
        __pyx_empty_tuple, /*PyObject *names,*/
        __pyx_empty_tuple, /*PyObject *varnames,*/
        __pyx_empty_tuple, /*PyObject *freevars,*/
        __pyx_empty_tuple, /*PyObject *cellvars,*/
        py_srcfile,   /*PyObject *filename,*/
        py_funcname,  /*PyObject *name,*/
        py_line,      /*int firstlineno,*/
        __pyx_empty_bytes  /*PyObject *lnotab*/
    );
    Py_DECREF(py_srcfile);
    Py_DECREF(py_funcname);
    return py_code;
bad:
    Py_XDECREF(py_srcfile);
    Py_XDECREF(py_funcname);
    return NULL;
}
static void __Pyx_AddTraceback(const char *funcname, int c_line,
                               int py_line, const char *filename) {
    PyCodeObject *py_code = 0;
    PyObject *py_globals = 0;
    PyFrameObject *py_frame = 0;
    py_code = __pyx_find_code_object(c_line ? c_line : py_line);
    if (!py_code) {
        py_code = __Pyx_CreateCodeObjectForTraceback(
            funcname, c_line, py_line, filename);
        if (!py_code) goto bad;
        __pyx_insert_code_object(c_line ? c_line : py_line, py_code);
    }
    py_globals = PyModule_GetDict(__pyx_m);
    if (!py_globals) goto bad;
    py_frame = PyFrame_New(
        PyThreadState_GET(), /*PyThreadState *tstate,*/
        py_code,             /*PyCodeObject *code,*/
        py_globals,          /*PyObject *globals,*/
        0                    /*PyObject *locals*/
    );
    if (!py_frame) goto bad;
    py_frame->f_lineno = py_line;
    PyTraceBack_Here(py_frame);
bad:
    Py_XDECREF(py_code);
    Py_XDECREF(py_frame);
}

static int __Pyx_InitStrings(__Pyx_StringTabEntry *t) {
    while (t->p) {
        #if PY_MAJOR_VERSION < 3
        if (t->is_unicode) {
            *t->p = PyUnicode_DecodeUTF8(t->s, t->n - 1, NULL);
        } else if (t->intern) {
            *t->p = PyString_InternFromString(t->s);
        } else {
            *t->p = PyString_FromStringAndSize(t->s, t->n - 1);
        }
        #else  /* Python 3+ has unicode identifiers */
        if (t->is_unicode | t->is_str) {
            if (t->intern) {
                *t->p = PyUnicode_InternFromString(t->s);
            } else if (t->encoding) {
                *t->p = PyUnicode_Decode(t->s, t->n - 1, t->encoding, NULL);
            } else {
                *t->p = PyUnicode_FromStringAndSize(t->s, t->n - 1);
            }
        } else {
            *t->p = PyBytes_FromStringAndSize(t->s, t->n - 1);
        }
        #endif
        if (!*t->p)
            return -1;
        ++t;
    }
    return 0;
}

static CYTHON_INLINE PyObject* __Pyx_PyUnicode_FromString(char* c_str) {
    return __Pyx_PyUnicode_FromStringAndSize(c_str, strlen(c_str));
}
static CYTHON_INLINE char* __Pyx_PyObject_AsString(PyObject* o) {
    Py_ssize_t ignore;
    return __Pyx_PyObject_AsStringAndSize(o, &ignore);
}
static CYTHON_INLINE char* __Pyx_PyObject_AsStringAndSize(PyObject* o, Py_ssize_t *length) {
#if __PYX_DEFAULT_STRING_ENCODING_IS_ASCII || __PYX_DEFAULT_STRING_ENCODING_IS_DEFAULT
    if (
#if PY_MAJOR_VERSION < 3 && __PYX_DEFAULT_STRING_ENCODING_IS_ASCII
            __Pyx_sys_getdefaultencoding_not_ascii &&
#endif
            PyUnicode_Check(o)) {
#if PY_VERSION_HEX < 0x03030000
        char* defenc_c;
        PyObject* defenc = _PyUnicode_AsDefaultEncodedString(o, NULL);
        if (!defenc) return NULL;
        defenc_c = PyBytes_AS_STRING(defenc);
#if __PYX_DEFAULT_STRING_ENCODING_IS_ASCII
        {
            char* end = defenc_c + PyBytes_GET_SIZE(defenc);
            char* c;
            for (c = defenc_c; c < end; c++) {
                if ((unsigned char) (*c) >= 128) {
                    PyUnicode_AsASCIIString(o);
                    return NULL;
                }
            }
        }
#endif /*__PYX_DEFAULT_STRING_ENCODING_IS_ASCII*/
        *length = PyBytes_GET_SIZE(defenc);
        return defenc_c;
#else /* PY_VERSION_HEX < 0x03030000 */
        if (PyUnicode_READY(o) == -1) return NULL;
#if __PYX_DEFAULT_STRING_ENCODING_IS_ASCII
        if (PyUnicode_IS_ASCII(o)) {
            *length = PyUnicode_GET_DATA_SIZE(o);
            return PyUnicode_AsUTF8(o);
        } else {
            PyUnicode_AsASCIIString(o);
            return NULL;
        }
#else /* __PYX_DEFAULT_STRING_ENCODING_IS_ASCII */
        return PyUnicode_AsUTF8AndSize(o, length);
#endif /* __PYX_DEFAULT_STRING_ENCODING_IS_ASCII */
#endif /* PY_VERSION_HEX < 0x03030000 */
    } else
#endif /* __PYX_DEFAULT_STRING_ENCODING_IS_ASCII  || __PYX_DEFAULT_STRING_ENCODING_IS_DEFAULT */
    {
        char* result;
        int r = PyBytes_AsStringAndSize(o, &result, length);
        if (r < 0) {
            return NULL;
        } else {
            return result;
        }
    }
}
static CYTHON_INLINE int __Pyx_PyObject_IsTrue(PyObject* x) {
   int is_true = x == Py_True;
   if (is_true | (x == Py_False) | (x == Py_None)) return is_true;
   else return PyObject_IsTrue(x);
}
static CYTHON_INLINE PyObject* __Pyx_PyNumber_Int(PyObject* x) {
  PyNumberMethods *m;
  const char *name = NULL;
  PyObject *res = NULL;
#if PY_MAJOR_VERSION < 3
  if (PyInt_Check(x) || PyLong_Check(x))
#else
  if (PyLong_Check(x))
#endif
    return Py_INCREF(x), x;
  m = Py_TYPE(x)->tp_as_number;
#if PY_MAJOR_VERSION < 3
  if (m && m->nb_int) {
    name = "int";
    res = PyNumber_Int(x);
  }
  else if (m && m->nb_long) {
    name = "long";
    res = PyNumber_Long(x);
  }
#else
  if (m && m->nb_int) {
    name = "int";
    res = PyNumber_Long(x);
  }
#endif
  if (res) {
#if PY_MAJOR_VERSION < 3
    if (!PyInt_Check(res) && !PyLong_Check(res)) {
#else
    if (!PyLong_Check(res)) {
#endif
      PyErr_Format(PyExc_TypeError,
                   "__%s__ returned non-%s (type %.200s)",
                   name, name, Py_TYPE(res)->tp_name);
      Py_DECREF(res);
      return NULL;
    }
  }
  else if (!PyErr_Occurred()) {
    PyErr_SetString(PyExc_TypeError,
                    "an integer is required");
  }
  return res;
}
static CYTHON_INLINE Py_ssize_t __Pyx_PyIndex_AsSsize_t(PyObject* b) {
  Py_ssize_t ival;
  PyObject* x = PyNumber_Index(b);
  if (!x) return -1;
  ival = PyInt_AsSsize_t(x);
  Py_DECREF(x);
  return ival;
}
static CYTHON_INLINE PyObject * __Pyx_PyInt_FromSize_t(size_t ival) {
#if PY_VERSION_HEX < 0x02050000
   if (ival <= LONG_MAX)
       return PyInt_FromLong((long)ival);
   else {
       unsigned char *bytes = (unsigned char *) &ival;
       int one = 1; int little = (int)*(unsigned char*)&one;
       return _PyLong_FromByteArray(bytes, sizeof(size_t), little, 0);
   }
#else
   return PyInt_FromSize_t(ival);
#endif
}
static CYTHON_INLINE size_t __Pyx_PyInt_AsSize_t(PyObject* x) {
   unsigned PY_LONG_LONG val = __Pyx_PyInt_AsUnsignedLongLong(x);
   if (unlikely(val != (unsigned PY_LONG_LONG)(size_t)val)) {
       if ((val != (unsigned PY_LONG_LONG)-1) || !PyErr_Occurred())
           PyErr_SetString(PyExc_OverflowError,
                           "value too large to convert to size_t");
       return (size_t)-1;
   }
   return (size_t)val;
}


#endif /* Py_PYTHON_H */
